## openwrt/21.02/qca/feeds/afc/qti-mfg-provision/Config.in
```kconfig
config FEATURE_IPQ_PROVISION_SUPPORT
        bool "Enables device provisioning in FTM"
        default no
        select PACKAGE_qti-mfg-provision
        help
                Enables Device provisioning in FTM
```

## openwrt/21.02/qca/feeds/hyfi/qca-hyfi-networking/qca-hyd/Config.in
```kconfig
choice
    prompt "Ethernet Speed"
    default HYD_GIGABIT_ETHERNET
    help
        set Ethernet speed

config HYD_GIGABIT_ETHERNET
    bool "Gigabit Ethernet"
    help
        use gigabit ethernet

config HYD_FAST_ETHERNET
    bool "Fast Ethernet"
    help
        use fast ethernet

endchoice

config HYD_WIFI_LOAD_BALANCING
	bool "Enable Wi-Fi Load Balancing Feature"
	default y
	help
	  This enables Wi-Fi load balancing (aka. steering) in hyd

config HYD_SUPPORT_VHT160
	bool "Support VHT 160 MHz"
	depends on PACKAGE_kmod-qca-wifi-akronite-perf||PACKAGE_kmod-qca-wifi-dakota-perf||PACKAGE_kmod-qca-wifi-perf||PACKAGE_kmod-qca-wifi-unified-perf||PACKAGE_kmod-qca-wifi-unified-profile||PACKAGE_kmod-qca-wifi-custc-profile||PACKAGE_kmod-qca-wifi-lowmem-profile||PACKAGE_kmod-qca-wifi-flash_16mb-profile||PACKAGE_kmod-qca-wifi-unified-profile-nonss||PACKAGE_kmod-qca-wifi-lowmem-profile-nonss||PACKAGE_kmod-qca-wifi-wkk-profile
	default y
	help
	  This enables the HYD support for 160 MHz

config HYD_SUPPORT_CFG80211
	bool "Flag cfg80211 based config layer for HYD"
	depends on PACKAGE_qca-cfg80211
	default y
	help
	  CFG80211 support for HYD

config HYD_SUPPORT_CALLTRACE
        bool "Enable calltrace support for HYD"
        help
          calltrace support for HYD

config HYD_SUPPORT_BREAKPAD
	bool "Enable Breakpad Debugging Support for HYD"
	default y
	help
	  Breakpad Debugging Support for HYD

config SUPPORT_WIFISON_EXT_LIB
	bool "Enable QCA Wifi-SON Extended library"
	default y
	help
	  Extended library support for SON event service in HYD

config HYD_DPP_ONBOARD_ENABLE
	bool "Device Provisioning Protocol for onboarding for EasyMesh Devices"
	default y
	help
	  This enables Device Provisioning Protocol for onboarding EasyMesh Devices

config HYD_SUPPORT_MULTICAST
	bool "Enable mcManager and Hyfi multicast suport"
	default n
	help
	  Enable Hyfi multicast support

config HYD_SUPPORT_11BE
	bool "Support 11BE EHT 320 MHz"
	depends on PACKAGE_kmod-qca-wifi-perf||PACKAGE_kmod-qca-wifi-unified-perf||PACKAGE_kmod-qca-wifi-unified-profile||PACKAGE_kmod-qca-wifi-custc-profile||PACKAGE_kmod-qca-wifi-unified-profile-nonss||PACKAGE_kmod-qca-wifi-wkk-profile||PACKAGE_kmod-qca-wifi-lowmem-profile||PACKAGE_kmod-qca-wifi-lowmem-profile-nonss
	default y
	help
	  This enables the HYD support for 320 MHz

config EZMESH_MODULE_ATF
	bool "Atf support for Hyd, Ezmesh"
	default y
	help
	  This enabled the ATF support for ezmesh

config EZMESH_MODULE_PUNCTURE
    bool "Enable puncturing support in ezmesh"
    depends on PACKAGE_kmod-qca-wifi-perf||PACKAGE_kmod-qca-wifi-unified-perf||PACKAGE_kmod-qca-wifi-unified-profile||PACKAGE_kmod-qca-wifi-custc-profile||PACKAGE_kmod-qca-wifi-unified-profile-nonss||PACKAGE_kmod-qca-wifi-wkk-profile||PACKAGE_kmod-qca-wifi-lowmem-profile||PACKAGE_kmod-qca-wifi-lowmem-profile-nonss
    default y
    help
      puncturing support for ezmesh
```

## openwrt/21.02/qca/feeds/ieee1905-security/qca-ieee1905-security-config/qca-wsplcd/Config.in
```kconfig
config WSPLCD_SUPPORT_PLC
    bool "Support PLC credential cloning"
    depends on PACKAGE_qca-plc-serv
    default y
    help
        This enables the WSPLCD support for PLC interfaces

config WSPLCD_SUPPORT_CFG80211
        bool "Support cfg80211 config layer for WSPLCD"
        depends on PACKAGE_qca-cfg80211
        default y
        help
            CFG80211 support for WSPLCD

config WSPLCD_SUPPORT_CALLTRACE
        bool "Enable calltrace support for WSPLCD"
        help
            Calltrace support for WSPLCD

config DOT1X_SUPPORT
    bool "Enable dot1x support for WSPLCD"
    default y
    help
        dot1x support for WSPLCD

config WSPLCD_SUPPORT_11BE
    bool "Support 11BE EHT 320 MHz for WSPLCD"
    depends on PACKAGE_kmod-qca-wifi-perf||PACKAGE_kmod-qca-wifi-unified-perf||PACKAGE_kmod-qca-wifi-unified-profile||PACKAGE_kmod-qca-wifi-custc-profile||PACKAGE_kmod-qca-wifi-unified-profile-nonss||PACKAGE_kmod-qca-wifi-wkk-profile||PACKAGE_kmod-qca-wifi-lowmem-profile||PACKAGE_kmod-qca-wifi-lowmem-profile-nonss
    default y
    help
        This enables the Support for 11BE EHT 320 MHz
```

## openwrt/21.02/qca/feeds/qca-lib/libwifisoncfg/Config.in
```kconfig
# LIBWIFISONCFG configs
config LIBCFG80211_SUPPORT
	bool "libwifison CFG80211 support"
	depends on PACKAGE_qca-cfg80211
	default y
	help
		Enable CFG80211 support for libwifisoncfg library

config WIFISON_SUPPORT_ATH10K
	bool "Support ATH10K"
	depends on PACKAGE_kmod-mac80211&&!CONFIG_WIFISON_SUPPORT_QSDK
	default y
	help
		This enables SON Libraries support for Ath10k driver

config WIFISON_SUPPORT_QSDK
	bool "Support QSDK"
	depends on PACKAGE_kmod-qca-wifi-unified-profile||PACKAGE_kmod-qca-wifi-custc-profile||PACKAGE_kmod-qca-wifi-lowmem-profile||PACKAGE_kmod-qca-wifi-akronite-perf||PACKAGE_kmod-qca-wifi-dakota-perf||PACKAGE_kmod-qca-wifi-perf||PACKAGE_kmod-qca-wifi-unified-perf&&!CONFIG_WIFISON_SUPPORT_ATH10K||PACKAGE_kmod-qca-wifi-flash_16mb-profile||PACKAGE_kmod-qca-wifi-unified-profile-nonss||PACKAGE_kmod-qca-wifi-lowmem-profile-nonss||PACKAGE_kmod-qca-wifi-wkk-profile
	default y
	help
		This enables SON Libraries support for Qualcomm Technologies Inc driver

config WIFISON_SUPPORT_11BE
	bool "Support for 11BE in libwifisoncfg"
	depends on PACKAGE_kmod-qca-wifi-perf||PACKAGE_kmod-qca-wifi-unified-perf||PACKAGE_kmod-qca-wifi-unified-profile||PACKAGE_kmod-qca-wifi-custc-profile||PACKAGE_kmod-qca-wifi-unified-profile-nonss||PACKAGE_kmod-qca-wifi-wkk-profile||PACKAGE_kmod-qca-wifi-lowmem-profile||PACKAGE_kmod-qca-wifi-lowmem-profile-nonss
	default y
	help
		This enables the 11BE support

config WIFISON_MODULE_PUNCTURE
    bool "Enable puncturing support in ezmesh"
    depends on PACKAGE_kmod-qca-wifi-akronite-perf||PACKAGE_kmod-qca-wifi-dakota-perf||PACKAGE_kmod-qca-wifi-perf||PACKAGE_kmod-qca-wifi-unified-perf||PACKAGE_kmod-qca-wifi-unified-profile||PACKAGE_kmod-qca-wifi-custc-profile||PACKAGE_kmod-qca-wifi-flash_16mb-profile||PACKAGE_kmod-qca-wifi-unified-profile-nonss||PACKAGE_kmod-qca-wifi-wkk-profile||PACKAGE_kmod-qca-wifi-lowmem-profile||PACKAGE_kmod-qca-wifi-lowmem-profile-nonss
    default y
    help
      puncturing support for ezmesh
```

## openwrt/21.02/target/linux/ipq53xx/ipq53xx_32/R65/sysupgrade-ubi.its
```
/dts-v1/;

/ {
        description = "R65";
        images {
                u-boot {
                        description = "u-boot image";
                        data = /incbin/("./oem-uboot.mbn");
                        type = "firmware";
                        arch = "arm";
                        compression = "none";
                        hash@1 { algo = "crc32"; };
				};
                sbl1 {
                        description = "sbl1 image";
                        data = /incbin/("./xbl_nand.elf");
                        type = "firmware";
                        arch = "arm";
                        compression = "none";
                        hash@1 { algo = "crc32"; };
				};
                tz {
                        description = "sbl1 image";
                        data = /incbin/("./tz.mbn");
                        type = "firmware";
                        arch = "arm";
                        compression = "none";
                        hash@1 { algo = "crc32"; };
				};
                devcfg {
                        description = "sbl1 image";
                        data = /incbin/("./devcfg.mbn");
                        type = "firmware";
                        arch = "arm";
                        compression = "none";
                        hash@1 { algo = "crc32"; };
				};
                tme {
                        description = "sbl1 image";
                        data = /incbin/("./tmel-ipq53xx-patch.elf");
                        type = "firmware";
                        arch = "arm";
                        compression = "none";
                        hash@1 { algo = "crc32"; };
				};
                ddr-AP-MI01.6_512M16_DDR4 {
                        description = "sbl1 image";
                        data = /incbin/("./cdt-AP-MI01.6_256M16_DDR4.bin");
                        type = "firmware";
                        arch = "arm";
                        compression = "none";
                        hash@1 { algo = "crc32"; };
				};
				/* the node name ubi is used for uboot upgrade, do not change the name */
                ubi {
                        description = "ubi-root image";
                        data = /incbin/("./openwrt-ipq53xx-ipq53xx_32-ubi-root.img");
                        type = "firmware";
                        arch = "arm";
                        compression = "none";
                        hash@1 { algo = "crc32"; };
                };

        };
};
```
