;=============================================================================
;
; cd.cmm 
;
; Script to execute a single ClockDriver.cmm sequence (and leave its window
; displayed).
;
; Intended to serve as an alternative to using the interactice ClockDriver.cmm
; directly. This method allows users to avoid PRACTICE script interference and
; to leverage the T32 main command line history utility.
;
; ============================================================================
;
; Copyright (c) 2015, 2021 Qualcomm Technologies Incorporated.  All Rights Reserved.  
; QUALCOMM Proprietary and Confidential. 
;
; ============================================================================
; $Header: //components/dev/boot.xf/0.3.1.1/priyma.boot.xf.0.3.1.1.initial_change/QcomPkg/IPQ9574Pkg/Tools/clock/cd.cmm#1 $
; $DateTime: 2022/03/07 01:02:20 $
; $Author: priyma $
; ============================================================================

local &cd_ret
local &script_dir
local &launch_line

entry %LINE &launch_line

; Get the absolute path to this script's directory.
&script_dir=OS.PPD()

; Run a single ClockDriver sequence and leave its window displayed.
do &script_dir\ClockDriver.cmm __cd__ &launch_line x
entry &cd_ret

enddo &cd_ret
