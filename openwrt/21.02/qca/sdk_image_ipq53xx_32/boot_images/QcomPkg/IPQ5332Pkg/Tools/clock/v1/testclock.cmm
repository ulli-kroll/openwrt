
;============================================================================
;
; *************** THIS SCRIPT WAS AUTOGENERATED ****************
;
; TARGET
;
;
; SCRIPT
;   TESTCLOCK.CMM
;
; GENERAL DESCRIPTION
;   This script can be used to route specific clocks to the clock test output.
;
; FUNCTIONS
;   N/A
;
;    Copyright (c) 2018 by QUALCOMM Technologies Inc.  All Rights Reserved.
;============================================================================



;-----------------------------------------------------------------------------
; Local variables
;-----------------------------------------------------------------------------

local &clk
local &clk_name
local &clk_state
local &clk_state_filter
local &clk_freq
local &header_printed
local &clk_test
local &clk_reg
local &clk_reg_str
local &clk_reg_name
local &clk_reg_cbcr_type
local &state_change
local &clock_count
local &multiplier
local &tcxo_count
local &match
local &clk_access_mode
local &clk_cmd_rcgr_addr
local &clk_cfg_rcgr_addr
local &clk_cmd_rcgr_val
local &clk_cfg_rcgr_val
local &clk_src_name
local &clk_src_sel
local &clk_src_div
local &clk_m_addr
local &clk_n_addr
local &clk_d_addr
local &clk_m_val
local &clk_n_val
local &clk_2d_val
local &chipset_name
local &frq_measure_ctl_addr
local &frq_measure_status_addr
local &xo_div4_cbcr_addr
local &dbg_clk_ctl_addr


;-----------------------------------------------------------------------------
; Initialize autogenerated constants
;-----------------------------------------------------------------------------

goto Init_Constants


Init_Constants:

; Chipset Name
&chipset_name="qcs405"

; Default Access Mode
&access_mode="ezaxi"

; Mux-specific Access Modes
&APCS_access_mode="ezaxi"
&GCC_access_mode="ezaxi"


;GCC clock registers
&HWIO_GCC_GCC_AHB_CBCR_ADDR=0x1830014
&HWIO_GCC_APSS_AHB_CBCR_ADDR=0x184601c
&HWIO_GCC_APSS_AXI_CBCR_ADDR=0x1846020
&HWIO_GCC_APSS_TCU_ASYNC_CBCR_ADDR=0x1812018
&HWIO_GCC_BIMC_APSS_AXI_CBCR_ADDR=0x1831020
&HWIO_GCC_BIMC_APSS_TCU_CBCR_ADDR=0x185b004
&HWIO_GCC_BIMC_CDSP_CBCR_ADDR=0x1831030
&HWIO_GCC_BIMC_CFG_AHB_CBCR_ADDR=0x183100c
&HWIO_GCC_BIMC_CBCR_ADDR=0x183101c
&HWIO_GCC_BIMC_GFX_CBCR_ADDR=0x1859034
&HWIO_GCC_BIMC_GPU_CBCR_ADDR=0x1859030
&HWIO_GCC_BIMC_LPASS_CBCR_ADDR=0x1831034
&HWIO_GCC_BIMC_MDSS_CBCR_ADDR=0x1831038
&HWIO_GCC_BIMC_SLEEP_CBCR_ADDR=0x1831010
&HWIO_GCC_BIMC_SYSNOC_AXI_CBCR_ADDR=0x1831014
&HWIO_GCC_BIMC_XO_CBCR_ADDR=0x1831008
&HWIO_GCC_BLSP1_AHB_CBCR_ADDR=0x1801008
&HWIO_GCC_BLSP1_QUP0_I2C_APPS_CBCR_ADDR=0x1806028
&HWIO_GCC_BLSP1_QUP0_SPI_APPS_CBCR_ADDR=0x1806024
&HWIO_GCC_BLSP1_QUP1_I2C_APPS_CBCR_ADDR=0x1802008
&HWIO_GCC_BLSP1_QUP1_SPI_APPS_CBCR_ADDR=0x1802004
&HWIO_GCC_BLSP1_QUP2_I2C_APPS_CBCR_ADDR=0x1803010
&HWIO_GCC_BLSP1_QUP2_SPI_APPS_CBCR_ADDR=0x180300c
&HWIO_GCC_BLSP1_QUP3_I2C_APPS_CBCR_ADDR=0x1804020
&HWIO_GCC_BLSP1_QUP3_SPI_APPS_CBCR_ADDR=0x180401c
&HWIO_GCC_BLSP1_QUP4_I2C_APPS_CBCR_ADDR=0x1805020
&HWIO_GCC_BLSP1_QUP4_SPI_APPS_CBCR_ADDR=0x180501c
&HWIO_GCC_BLSP1_SLEEP_CBCR_ADDR=0x1801004
&HWIO_GCC_BLSP1_UART0_APPS_CBCR_ADDR=0x1806004
&HWIO_GCC_BLSP1_UART0_SIM_CBCR_ADDR=0x1806008
&HWIO_GCC_BLSP1_UART1_APPS_CBCR_ADDR=0x180203c
&HWIO_GCC_BLSP1_UART1_SIM_CBCR_ADDR=0x1802040
&HWIO_GCC_BLSP1_UART2_APPS_CBCR_ADDR=0x180302c
&HWIO_GCC_BLSP1_UART2_SIM_CBCR_ADDR=0x1803030
&HWIO_GCC_BLSP1_UART3_APPS_CBCR_ADDR=0x180400c
&HWIO_GCC_BLSP1_UART3_SIM_CBCR_ADDR=0x1804010
&HWIO_GCC_BLSP2_AHB_CBCR_ADDR=0x180b008
&HWIO_GCC_BLSP2_QUP0_I2C_APPS_CBCR_ADDR=0x180c008
&HWIO_GCC_BLSP2_QUP0_SPI_APPS_CBCR_ADDR=0x180c004
&HWIO_GCC_BLSP2_SLEEP_CBCR_ADDR=0x180b004
&HWIO_GCC_BLSP2_UART0_APPS_CBCR_ADDR=0x180c03c
&HWIO_GCC_BLSP2_UART0_SIM_CBCR_ADDR=0x180c040
&HWIO_GCC_BOOT_ROM_AHB_CBCR_ADDR=0x181300c
&HWIO_GCC_CDSP_BIMC_CBCR_ADDR=0x185e008
&HWIO_GCC_CDSP_CFG_AHB_CBCR_ADDR=0x185e004
&HWIO_GCC_CDSP_TBU_CBCR_ADDR=0x181203c
&HWIO_GCC_CRYPTO_AHB_CBCR_ADDR=0x1816024
&HWIO_GCC_CRYPTO_AXI_CBCR_ADDR=0x1816020
&HWIO_GCC_CRYPTO_CBCR_ADDR=0x181601c
&HWIO_GCC_DCC_CBCR_ADDR=0x1877004
&HWIO_GCC_DCC_XO_CBCR_ADDR=0x1877008
&HWIO_GCC_DCD_XO_CBCR_ADDR=0x182a004
&HWIO_GCC_DDR_DIM_CFG_CBCR_ADDR=0x183201c
&HWIO_GCC_DDR_DIM_SLEEP_CBCR_ADDR=0x1832020
&HWIO_GCC_EMAC_TBU_AXI_CBCR_ADDR=0x1812024
&HWIO_GCC_ETH_AXI_CBCR_ADDR=0x184e010
&HWIO_GCC_ETH_PTP_CBCR_ADDR=0x184e004
&HWIO_GCC_ETH_RGMII_CBCR_ADDR=0x184e008
&HWIO_GCC_ETH_SLAVE_AHB_CBCR_ADDR=0x184e00c
&HWIO_GCC_GENI_IR_S_CBCR_ADDR=0x180f008
&HWIO_GCC_GENI_IR_XPU_CBCR_ADDR=0x181701c
&HWIO_GCC_GFX_TBU_CBCR_ADDR=0x1812010
&HWIO_GCC_GFX_TCU_CBCR_ADDR=0x1812020
&HWIO_GCC_GP1_CBCR_ADDR=0x1808000
&HWIO_GCC_GP2_CBCR_ADDR=0x1809000
&HWIO_GCC_GP3_CBCR_ADDR=0x180a000
&HWIO_GCC_GTCU_AHB_CBCR_ADDR=0x1812044
&HWIO_GCC_GCC_IM_SLEEP_CBCR_ADDR=0x1830038
&HWIO_GCC_IMEM_AXI_CBCR_ADDR=0x180e004
&HWIO_GCC_IMEM_CFG_AHB_CBCR_ADDR=0x180e008
&HWIO_GCC_LPASS_AGNOC_CFG_CBCR_ADDR=0x1872028
&HWIO_GCC_LPASS_AGNOC_CBCR_ADDR=0x1872008
&HWIO_GCC_LPASS_AGNOC_MPU_CFG_CBCR_ADDR=0x1817014
&HWIO_GCC_LPASS_AT_CBCR_ADDR=0x1872004
&HWIO_GCC_LPASS_CORE_MPORT_CBCR_ADDR=0x187202c
&HWIO_GCC_LPASS_HW_AF_CBCR_ADDR=0x1872034
&HWIO_GCC_LPASS_MPU_CFG_CBCR_ADDR=0x1817018
&HWIO_GCC_LPASS_Q6_AXIM_CBCR_ADDR=0x1872030
&HWIO_GCC_LPASS_Q6_AXIS_CBCR_ADDR=0x1872000
&HWIO_GCC_LPASS_SWAY_CBCR_ADDR=0x1872014
&HWIO_GCC_LPASS_TBU_CBCR_ADDR=0x1812094
&HWIO_GCC_MDP_TBU_CBCR_ADDR=0x181201c
&HWIO_GCC_MDSS_AHB_CBCR_ADDR=0x184d07c
&HWIO_GCC_MDSS_AXI_CBCR_ADDR=0x184d080
&HWIO_GCC_MDSS_BYTE0_CBCR_ADDR=0x184d094
&HWIO_GCC_MDSS_ESC0_CBCR_ADDR=0x184d098
&HWIO_GCC_MDSS_HDMI_APP_CBCR_ADDR=0x184d0d8
&HWIO_GCC_MDSS_HDMI_PCLK_CBCR_ADDR=0x184d0d4
&HWIO_GCC_MDSS_MDP_CBCR_ADDR=0x184d088
&HWIO_GCC_MDSS_PCLK0_CBCR_ADDR=0x184d084
&HWIO_GCC_MDSS_VSYNC_CBCR_ADDR=0x184d090
&HWIO_GCC_MPM_AHB_CBCR_ADDR=0x182c008
&HWIO_GCC_MSG_RAM_AHB_CBCR_ADDR=0x182b004
&HWIO_GCC_NOC_CONF_XPU_AHB_CBCR_ADDR=0x1817000
&HWIO_GCC_OXILI_AHB_CBCR_ADDR=0x1859028
&HWIO_GCC_OXILI_GFX3D_CBCR_ADDR=0x1859020
&HWIO_GCC_PCIE_0_AUX_CBCR_ADDR=0x183e014
&HWIO_GCC_PCIE_0_CFG_AHB_CBCR_ADDR=0x183e008
&HWIO_GCC_PCIE_0_MSTR_AXI_CBCR_ADDR=0x183e018
&HWIO_GCC_PCIE_0_PIPE_CBCR_ADDR=0x183e00c
&HWIO_GCC_PCIE_0_SLV_AXI_CBCR_ADDR=0x183e010
&HWIO_GCC_PCIE_TBU_CBCR_ADDR=0x1812014
&HWIO_GCC_PCNOC_AHB_CBCR_ADDR=0x182701c
&HWIO_GCC_PCNOC_AT_CBCR_ADDR=0x1827028
&HWIO_GCC_PCNOC_BUS_TIMEOUT0_AHB_CBCR_ADDR=0x1848004
&HWIO_GCC_PCNOC_BUS_TIMEOUT10_AHB_CBCR_ADDR=0x1848054
&HWIO_GCC_PCNOC_BUS_TIMEOUT11_AHB_CBCR_ADDR=0x184805c
&HWIO_GCC_PCNOC_BUS_TIMEOUT1_AHB_CBCR_ADDR=0x184800c
&HWIO_GCC_PCNOC_BUS_TIMEOUT2_AHB_CBCR_ADDR=0x1848014
&HWIO_GCC_PCNOC_BUS_TIMEOUT3_AHB_CBCR_ADDR=0x184801c
&HWIO_GCC_PCNOC_BUS_TIMEOUT4_AHB_CBCR_ADDR=0x1848024
&HWIO_GCC_PCNOC_BUS_TIMEOUT6_AHB_CBCR_ADDR=0x1848034
&HWIO_GCC_PCNOC_BUS_TIMEOUT7_AHB_CBCR_ADDR=0x184803c
&HWIO_GCC_PCNOC_BUS_TIMEOUT8_AHB_CBCR_ADDR=0x1848044
&HWIO_GCC_PCNOC_BUS_TIMEOUT9_AHB_CBCR_ADDR=0x184804c
&HWIO_GCC_PCNOC_DDR_CFG_CBCR_ADDR=0x1832090
&HWIO_GCC_PCNOC_EAST_AHB_CBCR_ADDR=0x1827020
&HWIO_GCC_PCNOC_MPU_CFG_AHB_CBCR_ADDR=0x181700c
&HWIO_GCC_PCNOC_MST_RPM_BRIDGE_CBCR_ADDR=0x1827030
&HWIO_GCC_PCNOC_NORTH_AHB_CBCR_ADDR=0x1827034
&HWIO_GCC_PCNOC_SLV_RPM_BRIDGE_CBCR_ADDR=0x182702c
&HWIO_GCC_PCNOC_SOUTH_AHB_CBCR_ADDR=0x1827038
&HWIO_GCC_PCNOC_TBU_CBCR_ADDR=0x1812030
&HWIO_GCC_PCNOC_USB2_CBCR_ADDR=0x1827008
&HWIO_GCC_PCNOC_USB3_CBCR_ADDR=0x182700c
&HWIO_GCC_PCNOC_WEST_AHB_CBCR_ADDR=0x1827024
&HWIO_GCC_PDM2_CBCR_ADDR=0x184400c
&HWIO_GCC_PDM_AHB_CBCR_ADDR=0x1844004
&HWIO_GCC_PDM_XO4_CBCR_ADDR=0x1844008
&HWIO_GCC_PRNG_AHB_CBCR_ADDR=0x1813004
&HWIO_GCC_PWM0_XO512_CBCR_ADDR=0x1844018
&HWIO_GCC_PWM1_XO512_CBCR_ADDR=0x1849004
&HWIO_GCC_PWM2_XO512_CBCR_ADDR=0x184a004
&HWIO_GCC_QDSS_APB2JTAG_CBCR_ADDR=0x1829094
&HWIO_GCC_QDSS_AT_CBCR_ADDR=0x1829024
&HWIO_GCC_QDSS_CFG_AHB_CBCR_ADDR=0x1829008
&HWIO_GCC_QDSS_DAP_AHB_CBCR_ADDR=0x1829004
&HWIO_GCC_QDSS_DAP_CBCR_ADDR=0x1829084
&HWIO_GCC_QDSS_ETR_USB_CBCR_ADDR=0x1829028
&HWIO_GCC_QDSS_STM_CBCR_ADDR=0x1829044
&HWIO_GCC_QDSS_TRACECLKIN_CBCR_ADDR=0x1829060
&HWIO_GCC_QDSS_TRIG_CBCR_ADDR=0x1829070
&HWIO_GCC_QDSS_TSCTR_CBCR_ADDR=0x182907c
&HWIO_GCC_QPIC_AHB_CBCR_ADDR=0x183b00c
&HWIO_GCC_QPIC_CBCR_ADDR=0x183b008
&HWIO_GCC_QPIC_SYSTEM_CBCR_ADDR=0x183b004
&HWIO_GCC_RBCPR_AHB_CBCR_ADDR=0x1833008
&HWIO_GCC_RBCPR_CBCR_ADDR=0x1833004
&HWIO_GCC_RPM_BUS_AHB_CBCR_ADDR=0x182d004
&HWIO_GCC_RPM_CFG_XPU_CBCR_ADDR=0x1817004
&HWIO_GCC_RPM_PROC_HCLK_CBCR_ADDR=0x182d000
&HWIO_GCC_RPM_SLEEP_CBCR_ADDR=0x182d008
&HWIO_GCC_RPM_TIMER_CBCR_ADDR=0x182d00c
&HWIO_GCC_SDCC1_AHB_CBCR_ADDR=0x184201c
&HWIO_GCC_SDCC1_APPS_CBCR_ADDR=0x1842018
&HWIO_GCC_SDCC1_ICE_CORE_CBCR_ADDR=0x185d014
&HWIO_GCC_SDCC2_AHB_CBCR_ADDR=0x184301c
&HWIO_GCC_SDCC2_APPS_CBCR_ADDR=0x1843018
&HWIO_GCC_SEC_CTRL_ACC_CBCR_ADDR=0x181a020
&HWIO_GCC_SEC_CTRL_AHB_CBCR_ADDR=0x181a024
&HWIO_GCC_SEC_CTRL_BOOT_ROM_PATCH_CBCR_ADDR=0x181a030
&HWIO_GCC_SEC_CTRL_CBCR_ADDR=0x181a028
&HWIO_GCC_SEC_CTRL_SENSE_CBCR_ADDR=0x181a02c
&HWIO_GCC_SMMU_CATS_CBCR_ADDR=0x187c004
&HWIO_GCC_SMMU_CFG_CBCR_ADDR=0x1812038
&HWIO_GCC_SMMU_XPU_CBCR_ADDR=0x1817010
&HWIO_GCC_SNOC_BUS_TIMEOUT0_AHB_CBCR_ADDR=0x1847004
&HWIO_GCC_SNOC_BUS_TIMEOUT1_AHB_CBCR_ADDR=0x1847014
&HWIO_GCC_SNOC_BUS_TIMEOUT2_AHB_CBCR_ADDR=0x184700c
&HWIO_GCC_SNOC_PCNOC_AHB_CBCR_ADDR=0x182602c
&HWIO_GCC_SPDM_BIMC_CY_CBCR_ADDR=0x182f010
&HWIO_GCC_SPDM_CFG_AHB_CBCR_ADDR=0x182f004
&HWIO_GCC_SPDM_DEBUG_CY_CBCR_ADDR=0x182f018
&HWIO_GCC_SPDM_FF_CBCR_ADDR=0x182f00c
&HWIO_GCC_SPDM_GFX3D_CBCR_ADDR=0x182f03c
&HWIO_GCC_SPDM_MDP_CBCR_ADDR=0x182f02c
&HWIO_GCC_SPDM_MSTR_AHB_CBCR_ADDR=0x182f008
&HWIO_GCC_SPDM_PCLK0_CBCR_ADDR=0x182f044
&HWIO_GCC_SPDM_PCNOC_CY_CBCR_ADDR=0x182f01c
&HWIO_GCC_SPDM_RPM_CY_CBCR_ADDR=0x182f020
&HWIO_GCC_SPDM_SNOC_CY_CBCR_ADDR=0x182f014
&HWIO_GCC_SPMI_AHB_CBCR_ADDR=0x182e03c
&HWIO_GCC_SPMI_PCNOC_AHB_CBCR_ADDR=0x182e020
&HWIO_GCC_SPMI_SER_CBCR_ADDR=0x182e01c
&HWIO_GCC_SYS_NOC_APSS_AHB_CBCR_ADDR=0x1826028
&HWIO_GCC_SYS_NOC_AT_CBCR_ADDR=0x1826030
&HWIO_GCC_SYS_NOC_AXI_CBCR_ADDR=0x1826020
&HWIO_GCC_SYS_NOC_LPASS_CBCR_ADDR=0x1826018
&HWIO_GCC_SYS_NOC_QDSS_STM_AXI_CBCR_ADDR=0x1826024
&HWIO_GCC_SYS_NOC_TPRB_CBCR_ADDR=0x1826034
&HWIO_GCC_SYS_NOC_USB3_CBCR_ADDR=0x1826014
&HWIO_GCC_SYS_NOC_WCSS_CBCR_ADDR=0x1826010
&HWIO_GCC_TCSR_AHB_CBCR_ADDR=0x1828004
&HWIO_GCC_TIC_CFG_AHB_CBCR_ADDR=0x187d000
&HWIO_GCC_TLMM_CBCR_ADDR=0x1834008
&HWIO_GCC_TLMM_EAST_AHB_CBCR_ADDR=0x1834004
&HWIO_GCC_TLMM_EAST_CBCR_ADDR=0x1834014
&HWIO_GCC_TLMM_NORTH_AHB_CBCR_ADDR=0x1834010
&HWIO_GCC_TLMM_NORTH_CBCR_ADDR=0x1834018
&HWIO_GCC_TLMM_SOUTH_AHB_CBCR_ADDR=0x183400c
&HWIO_GCC_TLMM_SOUTH_CBCR_ADDR=0x183401c
&HWIO_GCC_USB20_MOCK_UTMI_CBCR_ADDR=0x1841044
&HWIO_GCC_USB2A_PHY_SLEEP_CBCR_ADDR=0x184102c
&HWIO_GCC_USB30_MASTER_CBCR_ADDR=0x183900c
&HWIO_GCC_USB30_MOCK_UTMI_CBCR_ADDR=0x1839014
&HWIO_GCC_USB30_PHY_PIPE_CBCR_ADDR=0x1839018
&HWIO_GCC_USB30_SLEEP_CBCR_ADDR=0x1839010
&HWIO_GCC_USB3_PHY_AUX_CBCR_ADDR=0x1839044
&HWIO_GCC_USB3_TBU_AXI_CBCR_ADDR=0x1812028
&HWIO_GCC_USB_HS_INACTIVITY_TIMERS_CBCR_ADDR=0x184100c
&HWIO_GCC_USB_HS_PHY_CFG_AHB_CBCR_ADDR=0x1841030
&HWIO_GCC_USB_HS_SYSTEM_CBCR_ADDR=0x1841004
&HWIO_GCC_WCSS_AHB_S0_CBCR_ADDR=0x181c004
&HWIO_GCC_WCSS_APB_CBCR_ADDR=0x181c01c
&HWIO_GCC_WCSS_AT_CBCR_ADDR=0x181c014
&HWIO_GCC_WCSS_AXI_M_CBCR_ADDR=0x181c008
&HWIO_GCC_WCSS_ECAHB_CBCR_ADDR=0x181c00c
&HWIO_GCC_WCSS_SHDREG_AHB_CBCR_ADDR=0x181c010
&HWIO_GCC_WCSS_TBU_CBCR_ADDR=0x1812048
&HWIO_GCC_WCSS_TSCTR_CBCR_ADDR=0x181c018
&HWIO_GCC_WDSP_Q6SS_AHBS_CBCR_ADDR=0x181e004
&HWIO_GCC_WDSP_Q6SS_AON_CBCR_ADDR=0x181e024
&HWIO_GCC_WDSP_Q6SS_AXIM_CBCR_ADDR=0x181e008
&HWIO_GCC_WDSP_Q6SS_QOS_CBCR_ADDR=0x181e028
&HWIO_GCC_WDSP_XPU_CBCR_ADDR=0x1812040
&HWIO_GCC_GCC_XO_CBCR_ADDR=0x1830030
&HWIO_GCC_GCC_XO_DIV4_CBCR_ADDR=0x1830034
&HWIO_GCC_LPASS_SLEEP_CBCR_ADDR=0x183003c

; CMD and CFG RCGRs for clocks with configurable frequencies
&HWIO_GCC_ACC_CMD_RCGR_ADDR=0x181a004
&HWIO_GCC_ACC_CFG_RCGR_ADDR=0x181a008
&HWIO_GCC_APSS_AHB_CMD_RCGR_ADDR=0x1846000
&HWIO_GCC_APSS_AHB_CFG_RCGR_ADDR=0x1846004
&HWIO_GCC_APSS_AXI_CMD_RCGR_ADDR=0x1838048
&HWIO_GCC_APSS_AXI_CFG_RCGR_ADDR=0x183804c
&HWIO_GCC_APSS_TCU_CMD_RCGR_ADDR=0x1838000
&HWIO_GCC_APSS_TCU_CFG_RCGR_ADDR=0x1838004
&HWIO_GCC_BIMC_DDR_CMD_RCGR_ADDR=0x1832004
&HWIO_GCC_BIMC_DDR_CFG_RCGR_ADDR=0x1832008
&HWIO_GCC_BIMC_GPU_CMD_RCGR_ADDR=0x1831028
&HWIO_GCC_BIMC_GPU_CFG_RCGR_ADDR=0x183102c
&HWIO_GCC_BLSP1_QUP0_I2C_APPS_CMD_RCGR_ADDR=0x180602c
&HWIO_GCC_BLSP1_QUP0_I2C_APPS_CFG_RCGR_ADDR=0x1806030
&HWIO_GCC_BLSP1_QUP0_SPI_APPS_CMD_RCGR_ADDR=0x1806034
&HWIO_GCC_BLSP1_QUP0_SPI_APPS_CFG_RCGR_ADDR=0x1806038
&HWIO_GCC_BLSP1_QUP1_I2C_APPS_CMD_RCGR_ADDR=0x180200c
&HWIO_GCC_BLSP1_QUP1_I2C_APPS_CFG_RCGR_ADDR=0x1802010
&HWIO_GCC_BLSP1_QUP1_SPI_APPS_CMD_RCGR_ADDR=0x1802024
&HWIO_GCC_BLSP1_QUP1_SPI_APPS_CFG_RCGR_ADDR=0x1802028
&HWIO_GCC_BLSP1_QUP2_I2C_APPS_CMD_RCGR_ADDR=0x1803000
&HWIO_GCC_BLSP1_QUP2_I2C_APPS_CFG_RCGR_ADDR=0x1803004
&HWIO_GCC_BLSP1_QUP2_SPI_APPS_CMD_RCGR_ADDR=0x1803014
&HWIO_GCC_BLSP1_QUP2_SPI_APPS_CFG_RCGR_ADDR=0x1803018
&HWIO_GCC_BLSP1_QUP3_I2C_APPS_CMD_RCGR_ADDR=0x1804000
&HWIO_GCC_BLSP1_QUP3_I2C_APPS_CFG_RCGR_ADDR=0x1804004
&HWIO_GCC_BLSP1_QUP3_SPI_APPS_CMD_RCGR_ADDR=0x1804024
&HWIO_GCC_BLSP1_QUP3_SPI_APPS_CFG_RCGR_ADDR=0x1804028
&HWIO_GCC_BLSP1_QUP4_I2C_APPS_CMD_RCGR_ADDR=0x1805000
&HWIO_GCC_BLSP1_QUP4_I2C_APPS_CFG_RCGR_ADDR=0x1805004
&HWIO_GCC_BLSP1_QUP4_SPI_APPS_CMD_RCGR_ADDR=0x1805024
&HWIO_GCC_BLSP1_QUP4_SPI_APPS_CFG_RCGR_ADDR=0x1805028
&HWIO_GCC_BLSP1_UART0_APPS_CMD_RCGR_ADDR=0x180600c
&HWIO_GCC_BLSP1_UART0_APPS_CFG_RCGR_ADDR=0x1806010
&HWIO_GCC_BLSP1_UART1_APPS_CMD_RCGR_ADDR=0x1802044
&HWIO_GCC_BLSP1_UART1_APPS_CFG_RCGR_ADDR=0x1802048
&HWIO_GCC_BLSP1_UART2_APPS_CMD_RCGR_ADDR=0x1803034
&HWIO_GCC_BLSP1_UART2_APPS_CFG_RCGR_ADDR=0x1803038
&HWIO_GCC_BLSP1_UART3_APPS_CMD_RCGR_ADDR=0x1804014
&HWIO_GCC_BLSP1_UART3_APPS_CFG_RCGR_ADDR=0x1804038
&HWIO_GCC_BLSP2_QUP0_I2C_APPS_CMD_RCGR_ADDR=0x180c00c
&HWIO_GCC_BLSP2_QUP0_I2C_APPS_CFG_RCGR_ADDR=0x180c010
&HWIO_GCC_BLSP2_QUP0_SPI_APPS_CMD_RCGR_ADDR=0x180c024
&HWIO_GCC_BLSP2_QUP0_SPI_APPS_CFG_RCGR_ADDR=0x180c028
&HWIO_GCC_BLSP2_UART0_APPS_CMD_RCGR_ADDR=0x180c044
&HWIO_GCC_BLSP2_UART0_APPS_CFG_RCGR_ADDR=0x180c048
&HWIO_GCC_BLSP_UART_SIM_CMD_RCGR_ADDR=0x180100c
&HWIO_GCC_BLSP_UART_SIM_CFG_RCGR_ADDR=0x1801010
&HWIO_GCC_BYTE0_CMD_RCGR_ADDR=0x184d044
&HWIO_GCC_BYTE0_CFG_RCGR_ADDR=0x184d048
&HWIO_GCC_CDSP_BIMC_CMD_RCGR_ADDR=0x185e00c
&HWIO_GCC_CDSP_BIMC_CFG_RCGR_ADDR=0x185e010
&HWIO_GCC_CRYPTO_CMD_RCGR_ADDR=0x1816004
&HWIO_GCC_CRYPTO_CFG_RCGR_ADDR=0x1816008
&HWIO_GCC_EMAC_CMD_RCGR_ADDR=0x184e01c
&HWIO_GCC_EMAC_CFG_RCGR_ADDR=0x184e020
&HWIO_GCC_EMAC_PTP_CMD_RCGR_ADDR=0x184e014
&HWIO_GCC_EMAC_PTP_CFG_RCGR_ADDR=0x184e018
&HWIO_GCC_ESC0_CMD_RCGR_ADDR=0x184d05c
&HWIO_GCC_ESC0_CFG_RCGR_ADDR=0x184d060
&HWIO_GCC_GFX3D_CMD_RCGR_ADDR=0x1859000
&HWIO_GCC_GFX3D_CFG_RCGR_ADDR=0x1859004
&HWIO_GCC_GP1_CMD_RCGR_ADDR=0x1808004
&HWIO_GCC_GP1_CFG_RCGR_ADDR=0x1808008
&HWIO_GCC_GP2_CMD_RCGR_ADDR=0x1809004
&HWIO_GCC_GP2_CFG_RCGR_ADDR=0x1809008
&HWIO_GCC_GP3_CMD_RCGR_ADDR=0x180a004
&HWIO_GCC_GP3_CFG_RCGR_ADDR=0x180a008
&HWIO_GCC_HDMI_APP_CMD_RCGR_ADDR=0x184d0e4
&HWIO_GCC_HDMI_APP_CFG_RCGR_ADDR=0x184d0e8
&HWIO_GCC_HDMI_PCLK_CMD_RCGR_ADDR=0x184d0dc
&HWIO_GCC_HDMI_PCLK_CFG_RCGR_ADDR=0x184d0e0
&HWIO_GCC_LPASS_BIMC_CMD_RCGR_ADDR=0x187200c
&HWIO_GCC_LPASS_BIMC_CFG_RCGR_ADDR=0x1872010
&HWIO_GCC_MDP_CMD_RCGR_ADDR=0x184d014
&HWIO_GCC_MDP_CFG_RCGR_ADDR=0x184d018
&HWIO_GCC_MDSS_BIMC_CMD_RCGR_ADDR=0x184d0ec
&HWIO_GCC_MDSS_BIMC_CFG_RCGR_ADDR=0x184d0f0
&HWIO_GCC_PCIE_0_AUX_CMD_RCGR_ADDR=0x183e024
&HWIO_GCC_PCIE_0_AUX_CFG_RCGR_ADDR=0x183e028
&HWIO_GCC_PCIE_0_PIPE_CMD_RCGR_ADDR=0x183e01c
&HWIO_GCC_PCIE_0_PIPE_CFG_RCGR_ADDR=0x183e020
&HWIO_GCC_PCLK0_CMD_RCGR_ADDR=0x184d000
&HWIO_GCC_PCLK0_CFG_RCGR_ADDR=0x184d004
&HWIO_GCC_PCNOC_BFDCD_CMD_RCGR_ADDR=0x1827000
&HWIO_GCC_PCNOC_BFDCD_CFG_RCGR_ADDR=0x1827004
&HWIO_GCC_PDM2_CMD_RCGR_ADDR=0x1844010
&HWIO_GCC_PDM2_CFG_RCGR_ADDR=0x1844014
&HWIO_GCC_QDSS_APB_TSCTR_CMD_RCGR_ADDR=0x1829064
&HWIO_GCC_QDSS_APB_TSCTR_CFG_RCGR_ADDR=0x1829068
&HWIO_GCC_QDSS_AT_CMD_RCGR_ADDR=0x182900c
&HWIO_GCC_QDSS_AT_CFG_RCGR_ADDR=0x1829010
&HWIO_GCC_QDSS_STM_CMD_RCGR_ADDR=0x182902c
&HWIO_GCC_QDSS_STM_CFG_RCGR_ADDR=0x1829030
&HWIO_GCC_QDSS_TRACECLKIN_CMD_RCGR_ADDR=0x1829048
&HWIO_GCC_QDSS_TRACECLKIN_CFG_RCGR_ADDR=0x182904c
&HWIO_GCC_QDSS_TRIG_CMD_RCGR_ADDR=0x1829050
&HWIO_GCC_QDSS_TRIG_CFG_RCGR_ADDR=0x1829054
&HWIO_GCC_QPIC_CMD_RCGR_ADDR=0x183b010
&HWIO_GCC_QPIC_CFG_RCGR_ADDR=0x183b014
&HWIO_GCC_RBCPR_CMD_RCGR_ADDR=0x183300c
&HWIO_GCC_RBCPR_CFG_RCGR_ADDR=0x1833010
&HWIO_GCC_RPM_CMD_RCGR_ADDR=0x182d010
&HWIO_GCC_RPM_CFG_RCGR_ADDR=0x182d014
&HWIO_GCC_SDCC1_APPS_CMD_RCGR_ADDR=0x1842004
&HWIO_GCC_SDCC1_APPS_CFG_RCGR_ADDR=0x1842008
&HWIO_GCC_SDCC1_ICE_CORE_CMD_RCGR_ADDR=0x185d000
&HWIO_GCC_SDCC1_ICE_CORE_CFG_RCGR_ADDR=0x185d004
&HWIO_GCC_SDCC2_APPS_CMD_RCGR_ADDR=0x1843004
&HWIO_GCC_SDCC2_APPS_CFG_RCGR_ADDR=0x1843008
&HWIO_GCC_SEC_CTRL_CMD_RCGR_ADDR=0x181a034
&HWIO_GCC_SEC_CTRL_CFG_RCGR_ADDR=0x181a038
&HWIO_GCC_SPMI_AHB_CMD_RCGR_ADDR=0x182e024
&HWIO_GCC_SPMI_AHB_CFG_RCGR_ADDR=0x182e028
&HWIO_GCC_SPMI_SER_CMD_RCGR_ADDR=0x182e004
&HWIO_GCC_SPMI_SER_CFG_RCGR_ADDR=0x182e008
&HWIO_GCC_SYSTEM_NOC_BFDCD_CMD_RCGR_ADDR=0x1826004
&HWIO_GCC_SYSTEM_NOC_BFDCD_CFG_RCGR_ADDR=0x1826008
&HWIO_GCC_USB20_MOCK_UTMI_CMD_RCGR_ADDR=0x1841048
&HWIO_GCC_USB20_MOCK_UTMI_CFG_RCGR_ADDR=0x184104c
&HWIO_GCC_USB30_MASTER_CMD_RCGR_ADDR=0x1839028
&HWIO_GCC_USB30_MASTER_CFG_RCGR_ADDR=0x183902c
&HWIO_GCC_USB30_MOCK_UTMI_CMD_RCGR_ADDR=0x183901c
&HWIO_GCC_USB30_MOCK_UTMI_CFG_RCGR_ADDR=0x1839020
&HWIO_GCC_USB3_PHY_AUX_CMD_RCGR_ADDR=0x183903c
&HWIO_GCC_USB3_PHY_AUX_CFG_RCGR_ADDR=0x1839040
&HWIO_GCC_USB_HS_SYSTEM_CMD_RCGR_ADDR=0x1841010
&HWIO_GCC_USB_HS_SYSTEM_CFG_RCGR_ADDR=0x1841014
&HWIO_GCC_VSYNC_CMD_RCGR_ADDR=0x184d02c
&HWIO_GCC_VSYNC_CFG_RCGR_ADDR=0x184d030
&HWIO_GCC_WDSP_Q6SS_AON_CMD_RCGR_ADDR=0x181e014
&HWIO_GCC_WDSP_Q6SS_AON_CFG_RCGR_ADDR=0x181e018
&HWIO_GCC_WDSP_Q6SS_QOS_CMD_RCGR_ADDR=0x181e01c
&HWIO_GCC_WDSP_Q6SS_QOS_CFG_RCGR_ADDR=0x181e020

; Utility registers
&HWIO_GCC_GCC_XO_DIV4_CBCR_ADDR=0x1830034
&HWIO_GCC_PLLTEST_PAD_CFG_ADDR=0x187400c
&HWIO_TLMM_GPIO_CFG53_ADDR=0x7B35000
&HWIO_GCC_CLOCK_FRQ_MEASURE_STATUS_ADDR=0x1874008
&HWIO_GCC_CLOCK_FRQ_MEASURE_CTL_ADDR=0x1874004
&HWIO_GCC_GCC_DEBUG_CLK_CTL_ADDR=0x1874000
; Vote registers
v.new int[1] \vote_regs
v.a \vote_regs[0]=0x1800004

; Constants for setting clock frequencies
&HAL_CLK_CMD_CFG_UPDATE_FMSK=0x1
&HAL_CLK_CFG_CGR_SRC_SEL_SHFT=0x8
&HAL_CLK_CFG_CGR_SRC_DIV_SHFT=0x0
&HAL_CLK_CFG_CGR_SRC_SEL_FMSK=0x700
&HAL_CLK_CFG_CGR_SRC_DIV_FMSK=0x1f
&HAL_CLK_CFG_CGR_MODE_FMSK=0x3000
&HAL_CLK_CFG_CFG_DUAL_EDGE_MODE_VAL=0x2
&HAL_CLK_CFG_CGR_MODE_SHFT=0xc
&HAL_CLK_M_REG_OFFSET=0x8
&HAL_CLK_N_REG_OFFSET=0xc
&HAL_CLK_D_REG_OFFSET=0x10


; Test Masks
&CLK_TEST_TYPE_MASK=(0x00007FFF)
&CLK_TEST_SEL_MASK=(0x000F0000)
&CLK_TEST_SUB_MUX_MASK=(0xF0000000)

; APCS Debug register
&HWIO_APCS_ALIAS1_GLB_CLK_DIAG_ADDR=0xb01101c

; APCS Test Mask
&CLK_APCS_TEST=(0x1<<0x10)

; GCC Debug register
&HWIO_GCC_GCC_DEBUG_CLK_CTL_ADDR=0x1874000

; GCC Test Mask
&CLK_GCC_TEST=(0x2<<0x10)


; APCS test clocks
&CLK_TEST_APC0_SYSLEAF_CLK=(&CLK_APCS_TEST|0x0000)
&CLK_TEST_APC1_SYSLEAF_CLK=(&CLK_APCS_TEST|0x0100)
&CLK_TEST_APC2_SYSLEAF_CLK=(&CLK_APCS_TEST|0x0200)
&CLK_TEST_APC3_SYSLEAF_CLK=(&CLK_APCS_TEST|0x0300)
&CLK_TEST_APC_L2_SYSLEAF_CLK=(&CLK_APCS_TEST|0x1000)
&CLK_TEST_IM_SLEEP_CLK=(&CLK_APCS_TEST|0x7000)
&CLK_TEST_IM_REF_CLK=(&CLK_APCS_TEST|0x6000)
&CLK_TEST_SYS_APCSQSB_CLK=(&CLK_APCS_TEST|0x3000)
&CLK_TEST_APCS_HDCD_AHB_GATED_CLK=(&CLK_APCS_TEST|0x4000)

; GCC test clocks
&CLK_TEST_GCC_SEC_CTRL_ACC_CLK=(&CLK_GCC_TEST|0x120)
&CLK_TEST_GCC_APSS_AHB_CLK=(&CLK_GCC_TEST|0x168)
&CLK_TEST_GCC_SNOC_BUS_TIMEOUT0_AHB_CLK=(&CLK_GCC_TEST|0x170)
&CLK_TEST_GCC_SYS_NOC_APSS_AHB_CLK=(&CLK_GCC_TEST|0x003)
&CLK_TEST_GCC_APSS_AXI_CLK=(&CLK_GCC_TEST|0x169)
&CLK_TEST_GCC_BIMC_APSS_AXI_CLK=(&CLK_GCC_TEST|0x155)
&CLK_TEST_GCC_APSS_TCU_ASYNC_CLK=(&CLK_GCC_TEST|0x050)
&CLK_TEST_GCC_BIMC_APSS_TCU_CLK=(&CLK_GCC_TEST|0x159)
&CLK_TEST_GCC_BIMC_CLK=(&CLK_GCC_TEST|0x15A)
&CLK_TEST_GCC_SPDM_BIMC_CY_CLK=(&CLK_GCC_TEST|0x133)
&CLK_TEST_GCC_BIMC_XO_CLK=(&CLK_GCC_TEST|0x150)
&CLK_TEST_GCC_BIMC_GFX_CLK=(&CLK_GCC_TEST|0x02D)
&CLK_TEST_GCC_BIMC_GPU_CLK=(&CLK_GCC_TEST|0x157)
&CLK_TEST_GCC_GFX_TBU_CLK=(&CLK_GCC_TEST|0x052)
&CLK_TEST_GCC_GFX_TCU_CLK=(&CLK_GCC_TEST|0x053)
&CLK_TEST_GCC_BLSP1_QUP0_I2C_APPS_CLK=(&CLK_GCC_TEST|0x099)
&CLK_TEST_GCC_BLSP1_QUP0_SPI_APPS_CLK=(&CLK_GCC_TEST|0x098)
&CLK_TEST_GCC_BLSP1_QUP1_I2C_APPS_CLK=(&CLK_GCC_TEST|0x08B)
&CLK_TEST_GCC_BLSP1_QUP1_SPI_APPS_CLK=(&CLK_GCC_TEST|0x08A)
&CLK_TEST_GCC_BLSP1_QUP2_I2C_APPS_CLK=(&CLK_GCC_TEST|0x08F)
&CLK_TEST_GCC_BLSP1_QUP2_SPI_APPS_CLK=(&CLK_GCC_TEST|0x08E)
&CLK_TEST_GCC_BLSP1_QUP3_I2C_APPS_CLK=(&CLK_GCC_TEST|0x093)
&CLK_TEST_GCC_BLSP1_QUP3_SPI_APPS_CLK=(&CLK_GCC_TEST|0x092)
&CLK_TEST_GCC_BLSP1_QUP4_I2C_APPS_CLK=(&CLK_GCC_TEST|0x095)
&CLK_TEST_GCC_BLSP1_QUP4_SPI_APPS_CLK=(&CLK_GCC_TEST|0x094)
&CLK_TEST_GCC_BLSP1_UART0_APPS_CLK=(&CLK_GCC_TEST|0x09A)
&CLK_TEST_GCC_BLSP1_UART1_APPS_CLK=(&CLK_GCC_TEST|0x08C)
&CLK_TEST_GCC_BLSP1_UART2_APPS_CLK=(&CLK_GCC_TEST|0x090)
&CLK_TEST_GCC_BLSP1_UART3_APPS_CLK=(&CLK_GCC_TEST|0x096)
&CLK_TEST_GCC_BLSP2_QUP0_I2C_APPS_CLK=(&CLK_GCC_TEST|0x0A3)
&CLK_TEST_GCC_BLSP2_QUP0_SPI_APPS_CLK=(&CLK_GCC_TEST|0x0A2)
&CLK_TEST_GCC_BLSP2_UART0_APPS_CLK=(&CLK_GCC_TEST|0x0A4)
&CLK_TEST_GCC_BLSP1_UART0_SIM_CLK=(&CLK_GCC_TEST|0x09B)
&CLK_TEST_GCC_BLSP1_UART1_SIM_CLK=(&CLK_GCC_TEST|0x08D)
&CLK_TEST_GCC_BLSP1_UART2_SIM_CLK=(&CLK_GCC_TEST|0x091)
&CLK_TEST_GCC_BLSP1_UART3_SIM_CLK=(&CLK_GCC_TEST|0x097)
&CLK_TEST_GCC_BLSP2_UART0_SIM_CLK=(&CLK_GCC_TEST|0x0A5)
&CLK_TEST_GCC_MDSS_BYTE0_CLK=(&CLK_GCC_TEST|0x1FC)
&CLK_TEST_GCC_BIMC_CDSP_CLK=(&CLK_GCC_TEST|0x15C)
&CLK_TEST_GCC_CDSP_BIMC_CLK=(&CLK_GCC_TEST|0x030)
&CLK_TEST_GCC_CDSP_TBU_CLK=(&CLK_GCC_TEST|0x05A)
&CLK_TEST_GCC_CRYPTO_CLK=(&CLK_GCC_TEST|0x138)
&CLK_TEST_GCC_ETH_RGMII_CLK=(&CLK_GCC_TEST|0x081)
&CLK_TEST_GCC_ETH_PTP_CLK=(&CLK_GCC_TEST|0x083)
&CLK_TEST_GCC_MDSS_ESC0_CLK=(&CLK_GCC_TEST|0x1FD)
&CLK_TEST_GCC_BIMC_SLEEP_CLK=(&CLK_GCC_TEST|0x152)
&CLK_TEST_GCC_BLSP1_SLEEP_CLK=(&CLK_GCC_TEST|0x089)
&CLK_TEST_GCC_BLSP2_SLEEP_CLK=(&CLK_GCC_TEST|0x0A1)
&CLK_TEST_GCC_DDR_DIM_SLEEP_CLK=(&CLK_GCC_TEST|0x15B)
&CLK_TEST_GCC_IM_SLEEP_CLK=(&CLK_GCC_TEST|0x14B)
&CLK_TEST_GCC_QPIC_SYSTEM_CLK=(&CLK_GCC_TEST|0x0C2)
&CLK_TEST_GCC_RPM_SLEEP_CLK=(&CLK_GCC_TEST|0x11B)
&CLK_TEST_GCC_USB2A_PHY_SLEEP_CLK=(&CLK_GCC_TEST|0x063)
&CLK_TEST_GCC_USB30_SLEEP_CLK=(&CLK_GCC_TEST|0x079)
&CLK_TEST_GCC_USB_HS_INACTIVITY_TIMERS_CLK=(&CLK_GCC_TEST|0x062)
&CLK_TEST_LPASS_SLEEP_CLK=(&CLK_GCC_TEST|0x14C)
&CLK_TEST_GCC_DCC_XO_CLK=(&CLK_GCC_TEST|0x1B8)
&CLK_TEST_GCC_DCD_XO_CLK=(&CLK_GCC_TEST|0x1E0)
&CLK_TEST_GCC_GENI_IR_S_CLK=(&CLK_GCC_TEST|0x0EE)
&CLK_TEST_GCC_XO_CLK=(&CLK_GCC_TEST|0x149)
&CLK_TEST_GCC_XO_DIV4_CLK=(&CLK_GCC_TEST|0x14A)
&CLK_TEST_GCC_OXILI_GFX3D_CLK=(&CLK_GCC_TEST|0x1EA)
&CLK_TEST_GCC_GP1_CLK=(&CLK_GCC_TEST|0x010)
&CLK_TEST_GCC_GP2_CLK=(&CLK_GCC_TEST|0x011)
&CLK_TEST_GCC_GP3_CLK=(&CLK_GCC_TEST|0x012)
&CLK_TEST_GCC_MDSS_HDMI_APP_CLK=(&CLK_GCC_TEST|0x1F2)
&CLK_TEST_GCC_MDSS_HDMI_PCLK_CLK=(&CLK_GCC_TEST|0x1F1)
&CLK_TEST_GCC_BIMC_LPASS_CLK=(&CLK_GCC_TEST|0x15D)
&CLK_TEST_GCC_LPASS_AGNOC_CLK=(&CLK_GCC_TEST|0x164)
&CLK_TEST_GCC_LPASS_CORE_MPORT_CLK=(&CLK_GCC_TEST|0x1E1)
&CLK_TEST_GCC_LPASS_HW_AF_CLK=(&CLK_GCC_TEST|0x1E3)
&CLK_TEST_GCC_LPASS_Q6_AXIM_CLK=(&CLK_GCC_TEST|0x1E2)
&CLK_TEST_GCC_LPASS_TBU_CLK=(&CLK_GCC_TEST|0x05C)
&CLK_TEST_GCC_MDSS_MDP_CLK=(&CLK_GCC_TEST|0x1F9)
&CLK_TEST_GCC_BIMC_MDSS_CLK=(&CLK_GCC_TEST|0x15F)
&CLK_TEST_GCC_MDP_TBU_CLK=(&CLK_GCC_TEST|0x051)
&CLK_TEST_GCC_MDSS_AXI_CLK=(&CLK_GCC_TEST|0x1F7)
&CLK_TEST_GCC_PCIE_0_AUX_CLK=(&CLK_GCC_TEST|0x0AB)
&CLK_TEST_GCC_PCIE_0_PIPE_CLK=(&CLK_GCC_TEST|0x0AC)
&CLK_TEST_GCC_MDSS_PCLK0_CLK=(&CLK_GCC_TEST|0x1F8)
&CLK_TEST_GCC_AHB_CLK=(&CLK_GCC_TEST|0x148)
&CLK_TEST_GCC_BIMC_CFG_AHB_CLK=(&CLK_GCC_TEST|0x151)
&CLK_TEST_GCC_BLSP1_AHB_CLK=(&CLK_GCC_TEST|0x088)
&CLK_TEST_GCC_BLSP2_AHB_CLK=(&CLK_GCC_TEST|0x0A0)
&CLK_TEST_GCC_BOOT_ROM_AHB_CLK=(&CLK_GCC_TEST|0x0F8)
&CLK_TEST_GCC_CDSP_CFG_AHB_CLK=(&CLK_GCC_TEST|0x031)
&CLK_TEST_GCC_CRYPTO_AHB_CLK=(&CLK_GCC_TEST|0x13A)
&CLK_TEST_GCC_CRYPTO_AXI_CLK=(&CLK_GCC_TEST|0x139)
&CLK_TEST_GCC_DCC_CLK=(&CLK_GCC_TEST|0x1B9)
&CLK_TEST_GCC_ETH_SLAVE_AHB_CLK=(&CLK_GCC_TEST|0x082)
&CLK_TEST_GCC_GENI_IR_H_CLK=(&CLK_GCC_TEST|0x0EC)
&CLK_TEST_GCC_GENI_IR_XPU_CLK=(&CLK_GCC_TEST|0x0ED)
&CLK_TEST_GCC_GTCU_AHB_CLK=(&CLK_GCC_TEST|0x058)
&CLK_TEST_GCC_IMEM_CFG_AHB_CLK=(&CLK_GCC_TEST|0x021)
&CLK_TEST_GCC_LPASS_AGNOC_CFG_CLK=(&CLK_GCC_TEST|0x165)
&CLK_TEST_GCC_LPASS_AGNOC_MPU_CFG_CLK=(&CLK_GCC_TEST|0x166)
&CLK_TEST_GCC_LPASS_MPU_CFG_CLK=(&CLK_GCC_TEST|0x162)
&CLK_TEST_GCC_MDSS_AHB_CLK=(&CLK_GCC_TEST|0x1F6)
&CLK_TEST_GCC_MPM_AHB_CLK=(&CLK_GCC_TEST|0x110)
&CLK_TEST_GCC_MSG_RAM_AHB_CLK=(&CLK_GCC_TEST|0x100)
&CLK_TEST_GCC_NOC_CONF_XPU_AHB_CLK=(&CLK_GCC_TEST|0x018)
&CLK_TEST_GCC_OXILI_AHB_CLK=(&CLK_GCC_TEST|0x1EB)
&CLK_TEST_GCC_PCIE_0_CFG_AHB_CLK=(&CLK_GCC_TEST|0x0AA)
&CLK_TEST_GCC_PCNOC_AHB_CLK=(&CLK_GCC_TEST|0x008)
&CLK_TEST_GCC_PCNOC_BUS_TIMEOUT0_AHB_CLK=(&CLK_GCC_TEST|0x178)
&CLK_TEST_GCC_PCNOC_BUS_TIMEOUT1_AHB_CLK=(&CLK_GCC_TEST|0x179)
&CLK_TEST_GCC_PCNOC_BUS_TIMEOUT2_AHB_CLK=(&CLK_GCC_TEST|0x17A)
&CLK_TEST_GCC_PCNOC_BUS_TIMEOUT3_AHB_CLK=(&CLK_GCC_TEST|0x17B)
&CLK_TEST_GCC_PCNOC_BUS_TIMEOUT4_AHB_CLK=(&CLK_GCC_TEST|0x17C)
&CLK_TEST_GCC_PCNOC_BUS_TIMEOUT6_AHB_CLK=(&CLK_GCC_TEST|0x181)
&CLK_TEST_GCC_PCNOC_BUS_TIMEOUT7_AHB_CLK=(&CLK_GCC_TEST|0x182)
&CLK_TEST_GCC_PCNOC_BUS_TIMEOUT8_AHB_CLK=(&CLK_GCC_TEST|0x183)
&CLK_TEST_GCC_PCNOC_BUS_TIMEOUT9_AHB_CLK=(&CLK_GCC_TEST|0x184)
&CLK_TEST_GCC_PCNOC_DDR_CFG_CLK=(&CLK_GCC_TEST|0x154)
&CLK_TEST_GCC_PCNOC_EAST_AHB_CLK=(&CLK_GCC_TEST|0x00B)
&CLK_TEST_GCC_PCNOC_MPU_CFG_AHB_CLK=(&CLK_GCC_TEST|0x0C9)
&CLK_TEST_GCC_PCNOC_MST_RPM_BRIDGE_CLK=(&CLK_GCC_TEST|0x11D)
&CLK_TEST_GCC_PCNOC_NORTH_AHB_CLK=(&CLK_GCC_TEST|0x00E)
&CLK_TEST_GCC_PCNOC_SLV_RPM_BRIDGE_CLK=(&CLK_GCC_TEST|0x11E)
&CLK_TEST_GCC_PCNOC_SOUTH_AHB_CLK=(&CLK_GCC_TEST|0x00D)
&CLK_TEST_GCC_PCNOC_TBU_CLK=(&CLK_GCC_TEST|0x05D)
&CLK_TEST_GCC_PCNOC_WEST_AHB_CLK=(&CLK_GCC_TEST|0x00F)
&CLK_TEST_GCC_PDM_AHB_CLK=(&CLK_GCC_TEST|0x0D0)
&CLK_TEST_GCC_PRNG_AHB_CLK=(&CLK_GCC_TEST|0x0D8)
&CLK_TEST_GCC_QDSS_CFG_AHB_CLK=(&CLK_GCC_TEST|0x041)
&CLK_TEST_GCC_QDSS_DAP_AHB_CLK=(&CLK_GCC_TEST|0x040)
&CLK_TEST_GCC_QPIC_AHB_CLK=(&CLK_GCC_TEST|0x0C1)
&CLK_TEST_GCC_RBCPR_AHB_CLK=(&CLK_GCC_TEST|0x191)
&CLK_TEST_GCC_RPM_CFG_XPU_CLK=(&CLK_GCC_TEST|0x038)
&CLK_TEST_GCC_SDCC1_AHB_CLK=(&CLK_GCC_TEST|0x069)
&CLK_TEST_GCC_SDCC2_AHB_CLK=(&CLK_GCC_TEST|0x071)
&CLK_TEST_GCC_SEC_CTRL_AHB_CLK=(&CLK_GCC_TEST|0x121)
&CLK_TEST_GCC_SEC_CTRL_BOOT_ROM_PATCH_CLK=(&CLK_GCC_TEST|0x124)
&CLK_TEST_GCC_SMMU_CFG_CLK=(&CLK_GCC_TEST|0x05B)
&CLK_TEST_GCC_SMMU_XPU_CLK=(&CLK_GCC_TEST|0x059)
&CLK_TEST_GCC_SNOC_PCNOC_AHB_CLK=(&CLK_GCC_TEST|0x004)
&CLK_TEST_GCC_SPDM_CFG_AHB_CLK=(&CLK_GCC_TEST|0x130)
&CLK_TEST_GCC_SPDM_MSTR_AHB_CLK=(&CLK_GCC_TEST|0x131)
&CLK_TEST_GCC_SPDM_PCNOC_CY_CLK=(&CLK_GCC_TEST|0x135)
&CLK_TEST_GCC_SPMI_PCNOC_AHB_CLK=(&CLK_GCC_TEST|0x129)
&CLK_TEST_GCC_TCSR_AHB_CLK=(&CLK_GCC_TEST|0x0E8)
&CLK_TEST_GCC_TIC_CFG_AHB_CLK=(&CLK_GCC_TEST|0x1E9)
&CLK_TEST_GCC_TLMM_CLK=(&CLK_GCC_TEST|0x10B)
&CLK_TEST_GCC_TLMM_EAST_AHB_CLK=(&CLK_GCC_TEST|0x108)
&CLK_TEST_GCC_TLMM_EAST_CLK=(&CLK_GCC_TEST|0x10C)
&CLK_TEST_GCC_TLMM_NORTH_AHB_CLK=(&CLK_GCC_TEST|0x10A)
&CLK_TEST_GCC_TLMM_NORTH_CLK=(&CLK_GCC_TEST|0x10D)
&CLK_TEST_GCC_TLMM_SOUTH_AHB_CLK=(&CLK_GCC_TEST|0x109)
&CLK_TEST_GCC_TLMM_SOUTH_CLK=(&CLK_GCC_TEST|0x10E)
&CLK_TEST_GCC_USB_HS_PHY_CFG_AHB_CLK=(&CLK_GCC_TEST|0x064)
&CLK_TEST_GCC_WDSP_Q6SS_AHBS_CLK=(&CLK_GCC_TEST|0x0B8)
&CLK_TEST_GCC_PDM_XO4_CLK=(&CLK_GCC_TEST|0x0D1)
&CLK_TEST_GCC_PDM2_CLK=(&CLK_GCC_TEST|0x0D2)
&CLK_TEST_GCC_PWM0_XO512_CLK=(&CLK_GCC_TEST|0x0D3)
&CLK_TEST_GCC_PWM1_XO512_CLK=(&CLK_GCC_TEST|0x0D4)
&CLK_TEST_GCC_PWM2_XO512_CLK=(&CLK_GCC_TEST|0x0D5)
&CLK_TEST_GCC_QDSS_APB2JTAG_CLK=(&CLK_GCC_TEST|0x047)
&CLK_TEST_GCC_QDSS_DAP_CLK=(&CLK_GCC_TEST|0x049)
&CLK_TEST_GCC_QDSS_TSCTR_CLK=(&CLK_GCC_TEST|0x046)
&CLK_TEST_GCC_WCSS_APB_CLK=(&CLK_GCC_TEST|0x0B6)
&CLK_TEST_GCC_WCSS_TSCTR_CLK=(&CLK_GCC_TEST|0x0B5)
&CLK_TEST_GCC_LPASS_AT_CLK=(&CLK_GCC_TEST|0x167)
&CLK_TEST_GCC_PCNOC_AT_CLK=(&CLK_GCC_TEST|0x00C)
&CLK_TEST_GCC_QDSS_AT_CLK=(&CLK_GCC_TEST|0x042)
&CLK_TEST_GCC_SYS_NOC_AT_CLK=(&CLK_GCC_TEST|0x006)
&CLK_TEST_GCC_WCSS_AT_CLK=(&CLK_GCC_TEST|0x0B4)
&CLK_TEST_GCC_QDSS_STM_CLK=(&CLK_GCC_TEST|0x044)
&CLK_TEST_GCC_SYS_NOC_QDSS_STM_AXI_CLK=(&CLK_GCC_TEST|0x002)
&CLK_TEST_GCC_QDSS_TRACECLKIN_CLK=(&CLK_GCC_TEST|0x045)
&CLK_TEST_GCC_QDSS_TRIG_CLK=(&CLK_GCC_TEST|0x048)
&CLK_TEST_GCC_QPIC_CLK=(&CLK_GCC_TEST|0x0C0)
&CLK_TEST_GCC_RBCPR_CLK=(&CLK_GCC_TEST|0x190)
&CLK_TEST_GCC_RPM_BUS_AHB_CLK=(&CLK_GCC_TEST|0x11A)
&CLK_TEST_GCC_RPM_PROC_FCLK=(&CLK_GCC_TEST|0x118)
&CLK_TEST_GCC_RPM_PROC_HCLK=(&CLK_GCC_TEST|0x119)
&CLK_TEST_GCC_RPM_TIMER_CLK=(&CLK_GCC_TEST|0x11C)
&CLK_TEST_GCC_SDCC1_APPS_CLK=(&CLK_GCC_TEST|0x068)
&CLK_TEST_GCC_SDCC1_ICE_CORE_CLK=(&CLK_GCC_TEST|0x06A)
&CLK_TEST_GCC_SDCC2_APPS_CLK=(&CLK_GCC_TEST|0x070)
&CLK_TEST_GCC_SEC_CTRL_CLK=(&CLK_GCC_TEST|0x122)
&CLK_TEST_GCC_SEC_CTRL_SENSE_CLK=(&CLK_GCC_TEST|0x123)
&CLK_TEST_GCC_SMMU_CATS_CLK=(&CLK_GCC_TEST|0x05F)
&CLK_TEST_GCC_SPDM_FF_CLK=(&CLK_GCC_TEST|0x132)
&CLK_TEST_GCC_SPDM_GFX3D_CLK=(&CLK_GCC_TEST|0x143)
&CLK_TEST_GCC_SPDM_MDP_CLK=(&CLK_GCC_TEST|0x146)
&CLK_TEST_GCC_SPDM_PCLK0_CLK=(&CLK_GCC_TEST|0x141)
&CLK_TEST_GCC_SPDM_RPM_CY_CLK=(&CLK_GCC_TEST|0x136)
&CLK_TEST_GCC_SPMI_AHB_CLK=(&CLK_GCC_TEST|0x12A)
&CLK_TEST_GCC_SPMI_SER_CLK=(&CLK_GCC_TEST|0x128)
&CLK_TEST_GCC_BIMC_SYSNOC_AXI_CLK=(&CLK_GCC_TEST|0x153)
&CLK_TEST_GCC_EMAC_TBU_AXI_CLK=(&CLK_GCC_TEST|0x055)
&CLK_TEST_GCC_ETH_AXI_CLK=(&CLK_GCC_TEST|0x080)
&CLK_TEST_GCC_IMEM_AXI_CLK=(&CLK_GCC_TEST|0x020)
&CLK_TEST_GCC_LPASS_Q6_AXIS_CLK=(&CLK_GCC_TEST|0x160)
&CLK_TEST_GCC_LPASS_SWAY_CLK=(&CLK_GCC_TEST|0x163)
&CLK_TEST_GCC_PCIE_0_MSTR_AXI_CLK=(&CLK_GCC_TEST|0x0A9)
&CLK_TEST_GCC_PCIE_0_SLV_AXI_CLK=(&CLK_GCC_TEST|0x0A8)
&CLK_TEST_GCC_PCIE_TBU_CLK=(&CLK_GCC_TEST|0x054)
&CLK_TEST_GCC_QDSS_ETR_USB_CLK=(&CLK_GCC_TEST|0x043)
&CLK_TEST_GCC_SNOC_BUS_TIMEOUT1_AHB_CLK=(&CLK_GCC_TEST|0x171)
&CLK_TEST_GCC_SNOC_BUS_TIMEOUT2_AHB_CLK=(&CLK_GCC_TEST|0x172)
&CLK_TEST_GCC_SPDM_SNOC_CY_CLK=(&CLK_GCC_TEST|0x134)
&CLK_TEST_GCC_SYS_NOC_AXI_CLK=(&CLK_GCC_TEST|0x000)
&CLK_TEST_GCC_SYS_NOC_LPASS_CLK=(&CLK_GCC_TEST|0x007)
&CLK_TEST_GCC_SYS_NOC_TPRB_CLK=(&CLK_GCC_TEST|0x1E6)
&CLK_TEST_GCC_SYS_NOC_WCSS_CLK=(&CLK_GCC_TEST|0x005)
&CLK_TEST_GCC_WCSS_AHB_S0_CLK=(&CLK_GCC_TEST|0x0B0)
&CLK_TEST_GCC_WCSS_AXI_M_CLK=(&CLK_GCC_TEST|0x0B1)
&CLK_TEST_GCC_WCSS_ECAHB_CLK=(&CLK_GCC_TEST|0x0B2)
&CLK_TEST_GCC_WCSS_SHDREG_AHB_CLK=(&CLK_GCC_TEST|0x0B3)
&CLK_TEST_GCC_WCSS_TBU_CLK=(&CLK_GCC_TEST|0x05E)
&CLK_TEST_GCC_WDSP_Q6SS_AXIM_CLK=(&CLK_GCC_TEST|0x0B9)
&CLK_TEST_GCC_WDSP_XPU_CLK=(&CLK_GCC_TEST|0x057)
&CLK_TEST_GCC_USB20_MOCK_UTMI_CLK=(&CLK_GCC_TEST|0x065)
&CLK_TEST_GCC_PCNOC_BUS_TIMEOUT11_AHB_CLK=(&CLK_GCC_TEST|0x186)
&CLK_TEST_GCC_PCNOC_USB3_CLK=(&CLK_GCC_TEST|0x00A)
&CLK_TEST_GCC_SYS_NOC_USB3_CLK=(&CLK_GCC_TEST|0x001)
&CLK_TEST_GCC_USB30_MASTER_CLK=(&CLK_GCC_TEST|0x078)
&CLK_TEST_GCC_USB3_TBU_AXI_CLK=(&CLK_GCC_TEST|0x056)
&CLK_TEST_GCC_USB30_MOCK_UTMI_CLK=(&CLK_GCC_TEST|0x07A)
&CLK_TEST_GCC_USB30_PHY_PIPE_CLK=(&CLK_GCC_TEST|0x07B)
&CLK_TEST_GCC_USB3_PHY_AUX_CLK=(&CLK_GCC_TEST|0x07C)
&CLK_TEST_GCC_PCNOC_BUS_TIMEOUT10_AHB_CLK=(&CLK_GCC_TEST|0x185)
&CLK_TEST_GCC_PCNOC_USB2_CLK=(&CLK_GCC_TEST|0x009)
&CLK_TEST_GCC_USB_HS_SYSTEM_CLK=(&CLK_GCC_TEST|0x060)
&CLK_TEST_GCC_MDSS_VSYNC_CLK=(&CLK_GCC_TEST|0x1FB)
&CLK_TEST_GCC_WDSP_Q6SS_AON_CLK=(&CLK_GCC_TEST|0x0BD)
&CLK_TEST_GCC_WDSP_Q6SS_QOS_CLK=(&CLK_GCC_TEST|0x0BC)
&CLK_TEST_APSS_GCC_DBG_CLK=(&CLK_GCC_TEST|0x16A)
&CLK_TEST_APSS_GCC_RINGOSC_CLK=(&CLK_GCC_TEST|0x1D0)
&CLK_TEST_BIMC_PLL_DTEST=(&CLK_GCC_TEST|0x1C4)
&CLK_TEST_BIMC_PLL_LOCK_DET=(&CLK_GCC_TEST|0x1C5)
&CLK_TEST_GPLL0_DTEST=(&CLK_GCC_TEST|0x1C0)
&CLK_TEST_GPLL0_LOCK_DET=(&CLK_GCC_TEST|0x1C1)
&CLK_TEST_GPLL3_DTEST=(&CLK_GCC_TEST|0x1D8)
&CLK_TEST_GPLL3_LOCK_DET=(&CLK_GCC_TEST|0x1D9)
&CLK_TEST_GPLL4_DTEST=(&CLK_GCC_TEST|0x1DA)
&CLK_TEST_GPLL4_LOCK_DET=(&CLK_GCC_TEST|0x1DB)
&CLK_TEST_GPLL5_DTEST=(&CLK_GCC_TEST|0x1DC)
&CLK_TEST_GPLL5_LOCK_DET=(&CLK_GCC_TEST|0x1DD)
&CLK_TEST_GPLL6_DTEST=(&CLK_GCC_TEST|0x1DE)
&CLK_TEST_GPLL6_LOCK_DET=(&CLK_GCC_TEST|0x1DF)
&CLK_TEST_LPASS_GCC_DBG_CLK=(&CLK_GCC_TEST|0x161)
&CLK_TEST_MPM_GCC_TEMP_SENSOR_RINGOSC_CLK=(&CLK_GCC_TEST|0x1C8)
&CLK_TEST_PCIE_0_PIPE_CLK=(&CLK_GCC_TEST|0x0AD)
&CLK_TEST_USB2_PHY_GCC_ATEST_ULPI_0_CLK=(&CLK_GCC_TEST|0x0EA)
&CLK_TEST_USB2_PHY_GCC_ATEST_ULPI_1_CLK=(&CLK_GCC_TEST|0x0EB)
&CLK_TEST_WCSS_GCC_DBG_CLK=(&CLK_GCC_TEST|0x0B7)

;-----------------------------------------------------------------------------
; Init testclock
;-----------------------------------------------------------------------------

; Grab the entire launch command line.
local &launch_cmd_line
entry %LINE &launch_cmd_line

local &ARGS
&ARGS=os.ppd()
gosub __acquire_args_cmm &ARGS\..
entry &ARGS

local &AID
local &opts
local &create_area_param
local &success
local &testclock_main_window
local &testclock_main_area
local &log_output
local &log_filename
local &prev_clk_grp
local &input_filename
local &got_input_filename
local &arg
local &num_unread
local &prev_cmd_line
local &clk_err
local &help_use_same_window
local &tc_mode
local &area_exists
local &show_area

local &reset_window
&reset_window=0

&input_filename="c:\temp\testclock.txt"
&log_output=0
&prev_clk_grp=""
&prev_cmd_line=""

; Check if testclock was invoked in '__help_same_window__' mode.
&help_use_same_window=string.scan("&launch_cmd_line", "__help_same_window__", 0)
if (&help_use_same_window!=-1)
(
  &launch_cmd_line=string.replace("&launch_cmd_line", "__help_same_window__", "", 1.)
)

; Detect '__tc__' mode.
&tc_mode=string.scan("&launch_cmd_line", "__tc__", 0)
if (&tc_mode!=-1)
(
  &tc_mode=1
  &launch_cmd_line=string.replace("&launch_cmd_line", "__tc__", "", 1.)
)
else
(
  &tc_mode=0
)

; Clear any leftover help/history windows.
WINCLEAR testclock_help_window
WINCLEAR testclock_hist_window

; Check if a T32 area was given.
&testclock_main_area=string.ScanAndExtract("&launch_cmd_line", "super_script_area=", "_NF_")

; Create new areas.
&create_area_param="2 TESTCLOCK_HELP 130. 1000. TESTCLOCK_HIST , ,"
if ("&testclock_main_area"=="_NF_")
(
  &testclock_main_area="TESTCLOCK"

  &area_exists=1

  ;
  ; Allow 'tc' mode to avoid clearing the area ('area.create' clears areas if
  ; it is given row/col dimensions for the area buffer)
  ;
  if (&tc_mode!=0)
  (
    gosub wa_does_area_exist TESTCLOCK
    entry &area_exists
  )

  if ((&tc_mode==0)||(&area_exists==0))
  (
    &create_area_param="3 TESTCLOCK 180. 1000. TESTCLOCK_HELP 130. 1000. TESTCLOCK_HIST , ,"
  )
)
else
(
  ; Cut the 'super_script_area' argument out of the launch command line.
  &launch_cmd_line=string.replace("&launch_cmd_line", "super_script_area=&testclock_main_area", "", 1.)

  ; Create the given area if it doesn't already exist.
  gosub wa_does_area_exist &testclock_main_area
  entry &area_exists
  if (&area_exists==0)
  (
    &create_area_param="3 &testclock_main_area 180. 1000. TESTCLOCK_HELP 130. 1000. TESTCLOCK_HIST , ,"
  )
)

gosub wa_area_create_list &create_area_param
entry &success
if (&success==0)
(
  area.select
  print %ERROR "ERROR: Failed to create areas for testclock.cmm."
  enddo
)

; Check if a T32 window was given.
&testclock_main_window=string.ScanAndExtract("&launch_cmd_line", "super_script_window=", "_NF_")
if ("&testclock_main_window"=="_NF_")
(
  &testclock_main_window="testclock_main_window"
)
else
(
  ; Cut the 'super_script_window' argument out of the launch command line.
  &launch_cmd_line=string.replace("&launch_cmd_line", "super_script_window=&testclock_main_window", "", 1.)
)

; Create a new window if needed.
if (WIN.EXIST("&testclock_main_window")==FALSE())
(
  local &x_start
  local &y_start
  local &x_len
  local &y_len

  ; Check if there are previously saved window settings.
  gosub wa_find_saved_window_settings &testclock_main_window
  entry &x_start &y_start &x_len &y_len

  if (&x_start!=-1)
  (
    ; Use the previous window settings.
    winpos &x_start &y_start &x_len &y_len 0. 0. &testclock_main_window
  )
  else
  (
    gosub Default_WINPOS_Main
  )
)

; Check if a show-area option was given.
&show_area=string.ScanAndExtract("&launch_cmd_line", "show_area=", "_NF_")
if ("&show_area"=="_NF_")
(
  &show_area=1.
)
else
(
  ; Cut the 'show_area' argument out of the launch command line.
  &launch_cmd_line=string.replace("&launch_cmd_line", "show_area=&show_area", "", 1.)
)

area.select &testclock_main_area
if (&show_area==0.)
(
  ; Force an exit if the area is not shown, because no input prompt will appear.
  &launch_cmd_line="&launch_cmd_line x"
)
else
(
  area.view &testclock_main_area
)

; Initialize the argument bufferer with the launch command line.
do &ARGS create_client clk_drv &testclock_main_area &launch_cmd_line
entry &AID
if ("&AID"=="ARGS_ERR")
(
  do &ARGS get_error
  entry &clk_err

  print %ERROR "ERROR: Failed to create an ARGS client:"
  print %ERROR "       '&clk_err'."
  enddo
)

; Set bufferer options.
&opts="print_errors=1 help_cmd=? help_sub=Display_Help"
&opts="&opts hist_cmd=hist hist_sub=Display_Hist"
do &ARGS set_opts &AID &opts
entry &clk_err
if ("&clk_err"=="ARGS_ERR")
(
  do &ARGS get_error
  entry &clk_err

  print %ERROR "ERROR: Failed to set ARGS options:"
  print %ERROR "       '&clk_err'."

  enddo
)

; Set generic testclock error handler.
ON ERROR gosub
(
  print %ERROR "ERROR: Testclock error occurred:"
  print %ERROR "       Last command='&arg'. Last clock group='&clk'."
  return
)

; Print banner before entering main loop.
print " "
print "[-------------------- [&chipset_name] TEST CLOCK TOOL --------------------]"
print " "


;-----------------------------------------------------------------------------
; Argument handler main loop
;-----------------------------------------------------------------------------

Main_Loop:
(
  &clk_err=""

  ;
  ; Reset testclock argument handler state.
  ;
  &repeat_prev_cmd=0
  &header_printed=0
  &state_change=""
  &got_input_filename=0

  ;
  ; Get next command header arg.
  ;
  do &ARGS get_num_unread &AID
  entry &num_unread
  if (&num_unread==0)
  (
    local &line

    do &ARGS get_cmd_line &AID
    entry %LINE &line

    if (("&line"!=".")&&("&line"!=""))
    (
      &prev_cmd_line="&line"
    )

    ; If the history window is open, go ahead and update it.
    if (WIN.EXIST("testclock_hist_window")==TRUE())
    (
      gosub Display_Hist SKIP_VIEW
    )

    print " "
    print "[testclock.cmm] Version: <04/30/2015>"
  )

  do &ARGS get_arg &AID Enter command ('?' for help) >
  entry &arg

  gosub wa_save_window_settings testclock_hist_window
  gosub wa_save_window_settings &testclock_main_window

  ;
  ; Pre-process the command header arg.
  ;
  if (("&arg"==".")||("&arg"==""))
  (
    if ("&prev_cmd_line"=="")
    (
      print %ERROR "No previous command to repeat."
      goto Main_Loop
    )

    ; Prepare to repeat the previous command line.
    do &ARGS reset_cmd_line &AID &prev_cmd_line
    do &ARGS get_arg &AID
    entry &arg

    &repeat_prev_cmd=1
  )

  if (("&arg"=="on")||("&arg"=="off")||("&arg"=="set"))
  (
    ; Set state change command.
    &state_change="&arg"

    ; Check if a new clock selection is specified.
    do &ARGS get_num_unread &AID
    entry &num_unread
    if (&num_unread==0)
    (
      ; Use previous clock selection for state change operation.
      if ("&prev_clk_grp"=="")
      (
        print %ERROR "Command '&arg' failed. No clock(s) were previously selected."
        goto Handle_Args
      )
      &arg="&prev_clk_grp"
    )
    else
    (
      ; Extract new clock selection from buffered command line.
      do &ARGS get_arg &AID
      entry &arg
    )

    if ("&arg"=="file")
    (
      ; Check if a new clock file input is specified.
      do &ARGS get_num_unread &AID
      entry &num_unread
      if (&num_unread!=0)
      (
        ; Extract new clock file input from buffered command line.
        do &ARGS get_arg &AID
        entry &input_filename
      )

      ; Record that the file name is already known.
      &got_input_filename=1
    )
  )

  ;
  ; Execute the command operation.
  ;
  if ("&arg"=="x")
  (
    goto Exit_Testclock
  )
  else if ("&arg"=="wr")
  (
    &reset_window=1

    ; Reset the window size/position to default settings.
    winclear testclock_help_window
    winclear testclock_hist_window
    winclear &testclock_main_window

    gosub Default_WINPOS_Main

    if (&show_area!=0.)
    (
      area.view &testclock_main_area
    )
  )
  else if ("&arg"=="gpio")
  (
    gosub Configure_GPIO
  )
  else if ("&arg"=="log")
  (
    ; Check if output is already being logged.
    if (&log_output==0)
    (
      ; Output not currently logged--prompt user for new log file name
      local &filename
      do &ARGS get_arg &AID Enter log output file (default 'c:\temp\testclock_out.log') >
      entry &filename

      if ("&filename"=="close")
      (
        print %ERROR "No open output log to close."
      )
      else
      (
        if ("&filename"=="")
        (
          &log_filename="c:\temp\testclock_out.log"
        )
        else
        (
          &log_filename="&filename"
        )
        print "Logging testclock output to '&log_filename'."

        ; Open the output log file.
        (
          ON ERROR gosub
          (
            print %ERROR "ERROR: Failed to open clock output log '&log_filename'."
            &clk_err="failed_to_open_log_out"
            return
          )
          AREA.open &testclock_main_area &log_filename
        )

        if ("&clk_err"!="failed_to_open_log_out")
        (
          &log_output=1
        )
      )
    )
    else
    (
      local &log_arg

      do &ARGS get_arg &AID Stop logging output and close '&log_filename'? [close|n] >
      entry &log_arg

      if ("&log_arg"=="close")
      (
        AREA.close &testclock_main_area
        &log_output=0
        print "Closed '&log_filename' and stopped logging output."
      )
      else
      (
        print "Did not close the open output log '&log_filename'."
      )
    )
  )
  else if ("&arg"=="file")
  (
    local &input_line

    ; Get the input filename if necessary.
    if (&got_input_filename==0)
    (
      local &prompt_filename

      do &ARGS get_arg &AID Enter input file (default 'c:\temp\testclock.txt') >
      entry &prompt_filename

      if ("&prompt_filename"!="")
      (
        &input_filename="&prompt_filename"
      )
    )

    ; Open the clock input file
    (
      ON ERROR gosub
      (
        print %ERROR "ERROR: Failed to open clock list file '&input_filename'."
        &clk_err="failed_to_open_file_in"
        return
      )
      OPEN #1 &input_filename /Read
    )

    if ("&clk_err"!="failed_to_open_file_in")
    (
      print "Operating on list of clocks from '&input_filename'."

      READ #1 %line &input_line
      WHILE !EOF()
      (
        &input_line=string.trim("&input_line")
        if ("&input_line"!="")
        (
          gosub Find_Print_Clock &input_line
        )

        READ #1 %line &input_line
      )
      CLOSE #1
    )

    &prev_clk_grp="&arg"
  )
  else if (("&arg"=="all")||("&arg"=="all_on")||("&arg"=="all_off"))
  (
    &clk_state_filter="&arg"
    gosub Print_All
    &prev_clk_grp="&arg"
  )
  else
  (
    ; Assume argument is a clock group
    local &printed_ss_clock_info
    gosub Print_All_SS &arg
    entry &printed_ss_clock_info

    if (&printed_ss_clock_info==0)
    (
      ; Didn't match a SS clock group--attempt to operate on non-SS clock group
      gosub Find_Print_Clock &arg
    )

    &prev_clk_grp="&arg"
  )

  goto Main_Loop
)

;
; Sets up the default window position/size for the main window.
;
Default_WINPOS_Main:
(
  winpos 0. 0. 150. 100% 0. 0. &testclock_main_window
  return
)

;
; Sets up the default window position/size for the history window.
;
Default_WINPOS_Hist:
(
  winpos 155. 0. 50. 50% 0. 0. testclock_hist_window
  return
)

;-----------------------------------------------------------------------------
; Exit testclock
;-----------------------------------------------------------------------------

Exit_Testclock:
(
  local &num_unread &exit_arg

  winclear testclock_help_window

  if ((&tc_mode==0)||(&reset_window!=0))  ; skip saving a second time for 'tc' mode.
  (
    gosub wa_save_window_settings testclock_hist_window
    gosub wa_save_window_settings &testclock_main_window
  )

  ; Close the output log if needed.
  if (&log_output!=0)
  (
    area.close &testclock_main_area
  )

  winclear testclock_hist_window

  do &ARGS get_num_unread &AID
  entry &num_unread
  if (&num_unread>0.)
  (
    ; Don't hide the main window if the '.' exit option is given.
    do &ARGS get_arg &AID
    entry &exit_arg
    if ("&exit_arg"!=".")
    (
      winclear &testclock_main_window
    )
  )
  else
  (
    winclear &testclock_main_window
  )

  if (&show_area!=0.)
  (
    area.select
    print "Exited [&chipset_name] 'testclock.cmm'."
  )

  ; Return the clock frequency of the last measured clock (will be empty if
  ; no clock frequency was measured).
  enddo &clk_freq
)

;-----------------------------------------------------------------------------
; Display history
;-----------------------------------------------------------------------------

Display_Hist:
(
  local &skip_view
  entry &skip_view

  ; Display the help area if required.
  if ("&skip_view"=="")
  (
    if (WIN.EXIST("testclock_hist_window")==FALSE())
    (
      local &x_start
      local &y_start
      local &x_len
      local &y_len

      ; Check if there are previously saved window settings.
      gosub wa_find_saved_window_settings testclock_hist_window
      entry &x_start &y_start &x_len &y_len

      if (&x_start!=-1)
      (
        ; Use the previous window settings.
        winpos &x_start &y_start &x_len &y_len 0. 0. testclock_hist_window
      )
      else
      (
        gosub Default_WINPOS_Hist
      )
    )

    area.view TESTCLOCK_HIST
    wintop testclock_hist_window
  )

  area.clear TESTCLOCK_HIST
  area.select TESTCLOCK_HIST

  ; Print the history entries.
  print " "
  print "[--- [&chipset_name] testclock.cmm history: ---]"
  print " "
  do &ARGS print_hist &AID

  ; Switch back to the main demo window.
  area.select &testclock_main_area

  return
)

;-----------------------------------------------------------------------------
; Display help
;-----------------------------------------------------------------------------

Display_Help:
(
  ;-----------------------------------------------------------------------------
  ; Display available clock sources that can be output to the clock test output
  ; and prompt for selection.
  ;-----------------------------------------------------------------------------

  ; If the history window is open, go ahead and update it.
  if (WIN.EXIST("testclock_hist_window")==TRUE())
  (
    gosub Display_Hist SKIP_VIEW
  )

  if (&help_use_same_window==-1)
  (
    if (WIN.EXIST("testclock_help_window")==FALSE())
    (
      WINPOS , , , , , , testclock_help_window
    )

    area.view TESTCLOCK_HELP
    area.clear TESTCLOCK_HELP
    area.select TESTCLOCK_HELP

    winresize 130. 38.
  )

  print " "
  print " "
  gosub Print_Clock_Help
  print " "
  print " "

  print "Returns the frequency in MHz of the last measured clock if any clock freqeuncy was"
  print "measured, else returns nothing."
  print " "

  print "*** Launch Options ***"
  print " "
  print "  super_script_window=<name> - Specifies a T32 window to be used."
  print "  super_script_area=<name>   - Specifies a T32 area to be used."
  print "  show_area=<0|1>            - If zero, testclock's area is not displayed (1 by default)."
  print " "

  print "*** Commands ***"
  print " "
  print "  <clk_group>      - Print the status of a single clock or clock group."
  print "  on/off [clks]    - Modifies on/off state of clock(s). If a new clock group"
  print "                     isn't given, the previously selected clock group is used."

  ; TODO: actually support this or remove?
  ;print "  set         - sets the clock to one of supported frequencies"

  print "  gpio             - Enable GPIO's for clock output."
  print "  log <name|close> - Begin/end logging output to a file (closes upon 'x' exit)."
  print "  x [.]            - Exit [and leave the main window displayed]."
  print "  ?                - Display help message."
  print "  .                - Repeat previous command. Entering an empty line will also"
  print "                     repeat the previous command."
  print "  hist             - Display a testclock history window."
  print "  wr               - Reset the script window size/position."
  print " "

  print "*** Clock Groups ***"
  print " "
  print "  all          - All clocks."
  print "  all_on       - All clocks that are on."
  print "  all_off      - All clocks that are off."
  print "  <ss>_all     - All subsystem clocks."
  print "  <wildcard>   - Search query."
  print "  buses        - All bus clocks."
  print "  cpus         - All cpu clocks."
  print "  file <name>  - File specifying enumerated clocks (separated by newlines)."
  print "                 If a file name is not given, the previous input file is"
  print "                 used (default 'c:\temp\testclock.txt')."
  print " "

  area.select &testclock_main_area

  return
)



;;;;;;;;;;;;;;;;;;;;;;;;;;;;;;;;;;;;;;;;;;;;;;;;;;;;;;;;;;;;;;;;;;;;;;;;;;;;;;
;
; Lauterbach T32 "Window/Area" Utility Subs:
;
;   bool    wa_does_area_exist ( string area )
;
;   bool    wa_try_area_create ( string area, [int cols, int rows] )
;
;   bool    wa_area_create_list (
;             int num, [string area, int cols, int rows], ... )
;
;   string  wa_get_substr_ws ( string src_str, int read_idx )
;
;   int[4]  wa_extract_stored_win_dim ( string file_name, string window_name )
;
;   bool    wa_save_window_settings ( string window_name, [flag print_error] )
;
;   int[4]  wa_find_saved_window_settings ( string window_name )
;
;   bool    wa_delete_saved_window_settings (
;             string window_name, [flag print_error] )
;
;   bool    wa_delete_saved_window_settings_ext (
;             string window, string script, [flag print_error] )
;
;;;;;;;;;;;;;;;;;;;;;;;;;;;;;;;;;;;;;;;;;;;;;;;;;;;;;;;;;;;;;;;;;;;;;;;;;;;;;;

;
; bool wa_does_area_exist ( string area )
;
; Returns non-zero if the given area currently exists.
;
; SIDE EFFECTS:  Selects the tested area if it exists, or the default area.
;
wa_does_area_exist:
(
  local &area_name
  entry &area_name

  ON ERROR gosub
  (
    ; Clear the error message.
    area.select
    print " "

    &clk_err="!"
    return
  )

  &clk_err=""
  area.select &area_name

  if ("&clk_err"=="")
  (
    return 1
  )
  else
  (
    return 0
  )
)

;
; bool wa_try_area_create ( string area, [int cols, int rows] )
;
; Attempts to create an area (see 'area.create'). Returns non-zero if the 
; area is successfully created. If the 'area.create' operation fails, the
; caller may run 'area.reset' then re-try creating the area. The 'rows' and
; 'cols' arguments can be bypassed by omitting both.
;
; T32 has a maximum number of concurrent areas (only 10 at the time of
; writing this sub). Unfortunately these areas can only be deleted in bulk
; with the highly destructive 'area.reset' (although some T32 documentation
; incorrectly states that 'area.close <area_name>' destroys the area, it
; doesn't--it only closes the area's output logging).
;
; Furthermore, areas aren't destroyed automatically upon script exit, so
; if a user were to run multiple scripts with multiple areas they could
; quickly exhaust the 10-area limit and then find that subsequent script
; launches always fail, potentially with confusing error messages. This
; utility sub is intended to mitigate this risk without having to immidiately
; resort to running a global 'area.reset' during script initialization.
;
wa_try_area_create:
(
  local &area_name
  local &cols
  local &rows

  entry &area_name &cols &rows

  ON ERROR gosub
  (
    &clk_err="!"
    return
  )

  &clk_err=""
  area.create &area_name &cols &rows

  if ("&clk_err"=="")
  (
    return 1
  )
  else
  (
    return 0
  )
)

;
; bool wa_area_create_list ( int num, [string area, int cols, int rows], ... )
;
; Attempts to create a list of areas. Will run the global 'area.reset' command
; upon the first failure, and return 0 upon the second failure. Otherwise
; returns non-zero upon success.
;
wa_area_create_list:
(
  local &success
  local &already_failed
  local &area_name
  local &cols
  local &rows
  local &area_idx
  local &num
  local &input_line
  local &line_idx
  local &area_list_line_idx

  entry %LINE &input_line

  ; Get the number of areas to create.
  gosub wa_get_substr_ws "&input_line" 0.
  entry &num &area_list_line_idx
  if ("&num"=="")
  (
    print %ERROR "ERROR: wa_area_create_list() detected invalid input: '&input_line'."
    return 0
  )

  &already_failed=0

wa_area_create_list_process_areas:

  ; Create each area.
  &area_idx=0
  &line_idx=&area_list_line_idx
  while (&area_idx<&num)
  (
    ; Read in the area information.
    gosub wa_get_substr_ws "&input_line" &line_idx
    entry &area_name &line_idx
    if ("&area_name"=="")
    (
      goto wa_area_create_list_too_few_args
    )
    gosub wa_get_substr_ws "&input_line" &line_idx
    entry &cols &line_idx
    if ("&cols"=="")
    (
      goto wa_area_create_list_too_few_args
    )
    gosub wa_get_substr_ws "&input_line" &line_idx
    entry &rows &line_idx
    if ("&rows"=="")
    (
      goto wa_area_create_list_too_few_args
    )

    ; Check if the row/col argument was bypassed.
    if (("&cols"==",")||("&rows"==","))
    (
      ; Apply a sanity check for row/col bypass.
      if (("&cols"!=",")||("&rows"!=","))
      (
        print %ERROR "ERROR: wa_area_create_list() detected invalid row/col settings for '&area_name'."
        print %ERROR "       Row/col must both be an integer or both be ',' (got row='&row', col='&col'). "
        return 0
      )

      &cols=""
      &rows=""
    )

    ; Attempt to create the area.
    gosub wa_try_area_create &area_name &cols &rows
    entry &success

    if (&success==0)
    (
      ; Already failed => infinite impending failures.
      if (&already_failed!=0)
      (
        print %ERROR %Decimal "ERROR: wa_area_create_list() failed to create &num areas."
        return 0
      )

      ; Delete all areas and try creating the area list once more.
      &already_failed=1
      area.reset
      winclear
      goto wa_area_create_list_process_areas
    )

    &area_idx=&area_idx+1
  )

  return 1

wa_area_create_list_too_few_args:

  print %ERROR "ERROR: wa_area_create_list() detected too few arguments (num_areas='&num')."
  return 0
)

;
; string wa_get_substr_ws ( string src_str, int read_idx )
;
; Returns the next sub-string word from a source string, or nothing if there
; is no such word. The words are split by spaces.
;
; Example: <gosub args_get_next_substr_ws "a  bc  de" 1.>
;          Returns "bc 5" (sans quotes).
;
wa_get_substr_ws:
(
  local &src_str
  local &src_len
  local &read_idx
  local &sub_str
  local &start_idx

  entry &src_str &read_idx

  if (&read_idx<0)
  (
    ; Negative read index--return empty string (and no index).
    return
  )

  &src_len=string.length(&src_str)

  ; Find the start of non-whitespace segment.
  while (&read_idx<&src_len)
  (
    if (string.char(&src_str, &read_idx)!=' ')
    (
      &start_idx=&read_idx
      goto wa_get_substr_ws_find_end_idx
    )

    &read_idx=&read_idx+1
  )

  ; No non-whitespace found--return empty string (and no index).
  return

wa_get_substr_ws_find_end_idx:

  ; Find the end of non-whitespace segment.
  &read_idx=&read_idx+1
  while (&read_idx<&src_len)
  (
    if (string.char(&src_str, &read_idx)==' ')
    (
      ; Cut out leading and trailing whitespace
      &sub_str=string.mid(&src_str, &start_idx, &read_idx-&start_idx)

      goto wa_get_substr_ws_return_substr
    )

    &read_idx=&read_idx+1
  )

  ; No trailing white-space found--cut out any leading whitespace.
  &sub_str=string.cut(&src_str, &start_idx)

wa_get_substr_ws_return_substr:

  return &sub_str &read_idx
)

;
; int[2] wa_extract_stored_win_dim ( string file_name,  string window_name )
;
; Returns the settings for the given window extracted from a previously
; stored file. Returns -1 if the window settings aren't found.
;
; Returns: {x_start, y_start, x_length, y_length}
;          (all values are in row or column units).
;
wa_extract_stored_win_dim:
(
  local &window_name
  local &file_name
  local &x_start
  local &y_start
  local &x_len
  local &y_len
  local &line_in
  local &idx

  entry &file_name &window_name

  &x_start=-1
  &y_start=-1
  &y_len=-1
  &x_start=-1

  ; Open the input file.
  (
    &clk_err=""
    ON ERROR gosub
    (
      print %ERROR "ERROR: wa_extract_stored_win_dim() failed to open '&file_name'."
      &clk_err="!"
      return
    )
    OPEN #1 &file_name /Read
  )

  if ("&clk_err"!="")
  (
    goto wa_extract_stored_win_dim_error
  )

  ; Scan the input file for "winpos ... window_name".
  WHILE TRUE()
  (
    READ #1 %line &line_in
    if (EOF()==TRUE())
    (
      goto wa_extract_stored_win_dim_error
    )
    &line_in=string.lower("&line_in")

    ; Search for 'winpos' line header and cut it out if found.
    &idx=string.scan("&line_in", "winpos", 0)
    if (&idx!=-1)
    (
      &line_in=string.cut("&line_in", &idx+6.)

      ; Search for the specified window name.
      if (string.scan("&line_in", "&window_name", 0)!=-1)
      (
        ; Extract the specified window's settings.
        gosub wa_get_substr_ws "&line_in" 0.
        entry &x_start &idx
        if ("&x_start"=="")
        (
          goto wa_extract_stored_win_dim_error
        )
        gosub wa_get_substr_ws "&line_in" &idx
        entry &y_start &idx
        if ("&y_start"=="")
        (
          goto wa_extract_stored_win_dim_error
        )
        gosub wa_get_substr_ws "&line_in" &idx
        entry &x_len &idx
        if ("&x_len"=="")
        (
          goto wa_extract_stored_win_dim_error
        )
        gosub wa_get_substr_ws "&line_in" &idx
        entry &y_len &idx
        if ("&y_len"=="")
        (
          goto wa_extract_stored_win_dim_error
        )

        CLOSE #1
        return &x_start &y_start &x_len &y_len
      )
    )
  )

wa_extract_stored_win_dim_error:

  CLOSE #1
  return -1 -1 -1 -1
)

;
; bool wa_save_window_settings ( string window_name, [flag print_error] )
;
; Saves a script's window configuration (position + size).
; See restore_window_settings() for the restore operation.
; Returns non-zero if the store operation succeeded.
;
; This is provided as a method to allow scripts to save/restore their window
; settings accross multiple script sessions. T32's "store <file> win" tool
; is insufficient to do this since it will only save/restore *all* T32 windows,
; not targeted windows.
;
wa_save_window_settings:
(
  local &file
  local &window_name
  local &script_name
  local &extn_less_dim_fname
  local &print_error

  &clk_err=""
  ON ERROR gosub
  (
    &clk_err="!"
    return
  )

  entry &window_name &print_error

  ; Store the full window configuration in a file under the temporary directory.
  &script_name=os.ppf()
  &script_name=os.file.name("&script_name")
  &extn_less_dim_fname="__&(script_name)_&(window_name)_dim"
  &extn_less_dim_fname=string.replace("&extn_less_dim_fname", ".", "_", 0.)

  &file=os.ptd()
  &file="&(file)\&(extn_less_dim_fname).cmm"
  store &file win

  if ("&clk_err"=="")
  (
    return 1
  )
  else
  (
    if ("&print_error"!="")
    (
      print %ERROR "ERROR: wa_save_window_settings() failed to store settings for '&window_name'."
    )
    return 0
  )
)

;
; int[4] wa_find_saved_window_settings ( string window_name )
;
; Returns the settings for the given window extracted from a previously
; save. Returns -1 if the window settings aren't found.
;
; Returns: {x_start, y_start, x_length, y_length}
;          (all values are in row or column units).
;
; This is provided as a method to allow scripts to save/restore their window
; settings accross multiple script sessions. T32's "store <file> win" tool
; is insufficient to do this since it will only save/restore *all* T32 windows,
; not targeted windows.
;
wa_find_saved_window_settings:
(
  local &x_start
  local &y_start
  local &x_len
  local &y_len
  local &window_name
  local &file
  local &script_name
  local &extn_less_dim_fname
  local &first

  entry &window_name

  &script_name=os.ppf()
  &script_name=os.file.name("&script_name")
  &extn_less_dim_fname="__&(script_name)_&(window_name)_dim"
  &extn_less_dim_fname=string.replace("&extn_less_dim_fname", ".", "_", 0.)

  &first=0.
  (
    ON ERROR gosub
    (
      var.newglobal char \&extn_less_dim_fname
      &first=1.
      return
    )

    var.assign \&extn_less_dim_fname = 0
  )

  &file=os.ptd()
  &file="&(file)\&(extn_less_dim_fname).cmm"

  if (&first!=0.)
  (
    ;
    ; Don't attempt to restore on the first time--instead delete the save.
    ; This prevents issues where a new T32 session is opened in a smaller
    ; window but the launched script maintains its old oversize dimensions.
    ;
    (
      ON ERROR continue
      del &file
    )
    return -1 -1 -1 -1
  )

  if (os.file.access("&file", "R")==FALSE())
  (
    return -1 -1 -1 -1
  )

  ; Search for previously saved settings for this window.
  gosub wa_extract_stored_win_dim &file &window_name
  entry &x_start &y_start &x_len &y_len

  return &x_start &y_start &x_len &y_len
)

;
; bool wa_delete_saved_window_settings ( string window_name, [flag print_error] )
;
; Deletes a window settings file.
;
wa_delete_saved_window_settings:
(
  local &success
  local &file
  local &script_name
  local &window_name
  local &extn_less_dim_fname
  local &print_error

  entry &window_name &print_error

  ; Check if the window's saved settings file exists.
  &script_name=os.ppf()
  &script_name=os.file.name("&script_name")
  &extn_less_dim_fname="__&(script_name)_&(window_name)_dim"
  &extn_less_dim_fname=string.replace("&extn_less_dim_fname", ".", "_", 0.)

  &file=os.ptd()
  &file="&(file)\&(extn_less_dim_fname).cmm"
  if (os.file.access("&file", "W")==TRUE())
  (
    ; Delete the file.
    del &file
    &success=1
  )
  else
  (
    if ("&print_error"!="")
    (
      print %ERROR "ERROR: wa_delete_saved_window_settings() failed to delete window settings for '&window_name'."
    )
    &success=0
  )

  return &success
)

;
; bool wa_delete_saved_window_settings_ext ( string window, string script, [flag print_error] )
;
; Deletes a window settings file.
;
wa_delete_saved_window_settings_ext:
(
  local &success
  local &file
  local &script_name
  local &extn_less_dim_fname
  local &window_name
  local &print_error

  entry &window_name &script_name &print_error

  &extn_less_dim_fname="__&(script_name)_&(window_name)_dim"
  &extn_less_dim_fname=string.replace("&extn_less_dim_fname", ".", "_", 0.)

  &file=os.ptd()
  &file="&(file)\&(extn_less_dim_fname).cmm"
  if (os.file.access("&file", "W")==TRUE())
  (
    ; Delete the file.
    del &file
    &success=1
  )
  else
  (
    if ("&print_error"!="")
    (
      print %ERROR "ERROR: delete_saved_window_settings() failed to delete window settings for '&window_name'."
    )
    &success=0
  )

  return &success
)

;;;;;;;;;;;;; End of "Lauterbach T32 "Window/Area" Utility Subs" ;;;;;;;;;;;;;



;;;;;;;;;;;;;;;;;;;;;;;;;;;;;;;;;;;;;;;;;;;;;;;;;;;;;;;;;;;;;;;;;;;;;;;;;;;;;;
;
; Lauterbach T32 "ARGS Aquisition" Utility Subs:
;
;   string      __acquire_args_cmm ( string expected_args_dir )
;
;   int         __cmp_file_ts ( string path_a, string path_b )
;
;   int         __get_file_date_int ( string path, [flag ERR_FATAL] )
;
;   (int, int)  __str_get_next_dec_int ( int idx, string str_in)
;
;;;;;;;;;;;;;;;;;;;;;;;;;;;;;;;;;;;;;;;;;;;;;;;;;;;;;;;;;;;;;;;;;;;;;;;;;;;;;;

;
; string __acquire_args_cmm ( string expected_args_dir )
;
; Returns a path to an 'args.cmm' script.
;
; Aborts the scripts upon any failure.
;
__acquire_args_cmm:
(
  local &args_path
  local &server_args_path
  local &expected_args_dir

  entry &expected_args_dir

  ON ERROR gosub
  (
    area.select
    area.view
    print " "
    print %ERROR "Caught error in '__acquire_args_cmm'. Failed to fulfill 'args.cmm' dependency."
    enddo
  )

  &args_path="&expected_args_dir\args.cmm"

  ; Check if the expected 'args.cmm' file exists.
  if (os.file(&args_path)==FALSE())
  (
    ; The expected 'args.cmm' is missing. Attempt to copy it from the server.
    &server_args_path="\\ben\corebsp_labdata_0001\sysdrv\args\args.cmm"

    &args_path=os.ptd()
    &args_path="&args_path\__temp_args.cmm"

    ; Check if a local temp server copy already exists.
    if (os.file(&args_path)==FALSE())
    (
      ; The local temp copy does not exist--attempt to create it.
      if (os.file(&server_args_path)==FALSE())
      (
        area.select
        area.view
        print " "
        print %ERROR "ERROR: '&expected_args_dir\args.cmm', '&args_path\__temp_args.cmm' and"
        print %ERROR "       '&server_args_path' do not exist. Missing required 'args.cmm' file."
        enddo
      )
      if (os.file.access("&server_args_path", "R")==FALSE())
      (
        area.select
        area.view
        print " "
        print %ERROR "ERROR: '&expected_args_dir\args.cmm' and '&args_path\__temp_args.cmm' do not exist and"
        print %ERROR "       '&server_args_path' is not readable. Missing required 'args.cmm' file."
        enddo
      )

      copy &server_args_path &args_path
      if (os.file(&args_path)==FALSE())
      (
        ; Just try to use the server version if for some reason the copy to the
        ; T32 temp directory failed.
        &args_path="&server_args_path"
      )
    )
    else
    (
      ; The local temp 'args.cmm' exists. Check if it matches the server version.
      ; If the server version isn't found, the temp copy is used.
      if ((os.file(&server_args_path)==TRUE())&&(os.file.access("&server_args_path", "R")==TRUE()))
      (
        local &args_cmp_ret

        gosub __cmp_file_ts &server_args_path &args_path
        entry &args_cmp_ret

        if (&args_cmp_ret>0.)
        (
          ; The server copy is newer than the local temp copy--attempt to refresh.
          del &args_path
          copy &server_args_path &args_path

          if (os.file(&args_path)==FALSE())
          (
            ; Just try to use the server version if for some reason the copy to the
            ; T32 temp directory failed.
            &args_path="&server_args_path"
          )
        )
      )
    )
  )

  return &args_path
)

;
; int __cmp_file_ts ( string path_a, string path_b )
;
; Returns positive number if the first file is newer than the second file,
; else returns zero if the two files have identical timestamps, else returns
; a negative number. Assumes that both files exist.
;
; Aborts the scripts upon any failure.
;
__cmp_file_ts:
(
  local &path_a
  local &path_b

  entry &path_a &path_b

  gosub __get_file_date_int &path_a ERR_FATAL
  entry &path_a

  gosub __get_file_date_int &path_b ERR_FATAL
  entry &path_b

  &path_a=(&path_a-&path_b)
  return &path_a
)

;
; int __get_file_date_int ( string path, [flag ERR_FATAL] )
;
; Returns an integer representation of the given file's timestamp data string
; (see 'os.file.date()').
;
; Upon failure, if the 'ERR_FATAL' flag is given an error message is printed
; and the script is aborted, else -1 is returned.
;
; NOTES:  This subroutine is greatly complicated by the fact that (at the time
;         of its authoring) Lauterbach does not provide a way to obtain a
;         1971-based file time-stamp integer, instead only providing methods
;         get various file date strings of various formats which are not even
;         consistant with the given Lauterbach documentation!
;
__get_file_date_int:
(
  local &year
  local &month
  local &day
  local &date_int
  local &date_str
  local &hour_min_sec_am_pm_str
  local &get_file_date_int_err

  local &path
  local &err_fatal

  entry &path &err_fatal

  &get_file_date_int_err=""
  ON ERROR gosub
  (
    if ("&err_fatal"=="")
    (
      &get_file_date_int_err="!"
      return
    )
    else
    (
      ; Abort if fatal error flag was given.
      area.select
      area.view
      print " "
      print %ERROR "Caught fatal error in __get_file_date_int(), file = '&path'."
      enddo
    )
  )

  ;
  ; Don't use raw 'os.file.date()' as it's format doesn't match Lauterbach's
  ; documentation which indicates that it might be regionalized. Instead use a
  ; combination of the two date string formats, in order to get the AM/PM
  ; included in the time string, but with a more reliable "year/month/day"
  ; format for the date string.
  ;
  &hour_min_sec_am_pm_str=os.file.date(&path)
  gosub __str_get_next_dec_int 0. "&hour_min_sec_am_pm_str"
  entry &year &date_idx
  gosub __str_get_next_dec_int &date_idx "&hour_min_sec_am_pm_str"
  entry &year &date_idx
  gosub __str_get_next_dec_int &date_idx "&hour_min_sec_am_pm_str"
  entry &year &date_idx
  &hour_min_sec_am_pm_str=string.cut("&hour_min_sec_am_pm_str", &date_idx)
  &hour_min_sec_am_pm_str=string.trim("&hour_min_sec_am_pm_str")

  &date_str=os.file.date2(&path)
  &date_str="&date_str &hour_min_sec_am_pm_str"
  &date_str=string.trim("&date_str")

  if ("&get_file_date_int_err"=="")
  (
    ; Determine the 1971 year second-offset (assumes each month is <= 31 days).
    gosub __str_get_next_dec_int 0. "&date_str"
    entry &year &date_idx
    &date_int=((&year-1971.)*32140800.)

    if ("&get_file_date_int_err"=="")
    (
      ; Read the month (assumes each month is <= 31 days).
      gosub __str_get_next_dec_int &date_idx "&date_str"
      entry &month &date_idx
      &date_int=(&date_int+(&month*2678400.))

      if ("&get_file_date_int_err"=="")
      (
        ; Read the day.
        gosub __str_get_next_dec_int &date_idx "&date_str"
        entry &day &date_idx
        &date_int=(&date_int+(&day*86400.))

        if ("&get_file_date_int_err"=="")
        (
          ; Read the hour/minute/second/AM-PM.
          local &hour
          local &min
          local &sec
          local &am_pm_str
          gosub __str_get_next_dec_int &date_idx "&date_str"
          entry &hour &date_idx

          if ("&get_file_date_int_err"=="")
          (
            gosub __str_get_next_dec_int &date_idx "&date_str"
            entry &min &date_idx

            if ("&get_file_date_int_err"=="")
            (
              gosub __str_get_next_dec_int &date_idx "&date_str"
              entry &sec &date_idx

              if ("&get_file_date_int_err"=="")
              (
                &am_pm_str=string.cut("&date_str", &date_idx)
                &am_pm_str=string.trim("&am_pm_str")
                &am_pm_str=string.lower("&am_pm_str")
                if ("&am_pm_str"=="pm")
                (
                  &hour=(&hour+12.)
                )

                ; Calculate the final date integer and return it.
                &date_int=(&date_int+(&hour*3600.)+(&min*60.)+&sec)
                if ("&get_file_date_int_err"=="")
                (
                  return &date_int
                )
              )
            )
          )
        )
      )
    )
  )

  ; Otherwise return an error code.
  return -1.
)

;
; (int, int) __str_get_next_dec_int ( int idx, string str_in )
;
; Returns the next integer value extracted from the given string and start
; index along with the next string read index. The integer value is derived
; from the string's first digit sequence which is treated as a decimal
; formatted number. Returns an empty string if no such digit section is found.
;
; NOTES: The 'str_in' input should be wrapped in double quotes.
;
__str_get_next_dec_int:
(
  local &int_val
  local &int_start_idx
  local &char
  local &len

  local &idx
  local &str_in

  entry &idx &str_in

  &int_start_idx=""
  &char=1.
  while (&char>0.)
  (
    &char=string.char(&str_in, &idx)

    if ("&int_start_idx"=="")
    (
      if ((&char>='0')&&(&char<='9'))
      (
        &int_start_idx=&idx
      )
    )
    else
    (
      if ((&char<'0')||(&char>'9'))
      (
        &len=(&idx-&int_start_idx)
        &int_val=string.mid(&str_in, &int_start_idx, &len)
        &int_val="&(int_val)."
        &idx=(&idx+1.)

        return &int_val &idx
      )
    )

    &idx=&idx+1.
  )

  return ""
)

;;;;;;;;;;; End of "Lauterbach T32 "ARGS Aquisition" Utility Subs" ;;;;;;;;;;;


;-----------------------------------------------------------------------------
; Determine clock frequency.
;-----------------------------------------------------------------------------

Calc_Clock_Freq:

  local &l2cpucpselr_val
  local &l2cpucpcpdr_val

  ; Save current values
  &xo_div4_cbcr=data.long(&access_mode:&xo_div4_cbcr_addr)
  
  ; Measure a short run
  &tcxo_count=0x800
  
  ; Config XO DIV4 comparator clock
  data.set &access_mode:&xo_div4_cbcr_addr %LONG data.long(&access_mode:&xo_div4_cbcr_addr)|0x1
  
  ; Start with the counter disabled 
  &measure_ctl=data.long(&access_mode:&frq_measure_ctl_addr)
  &measure_ctl=&measure_ctl&~0x1FFFFF
  data.set &access_mode:&frq_measure_ctl_addr %LONG &measure_ctl
  
  ; Program the starting counter value, high enough to get good accuracy
  &measure_ctl=&measure_ctl|&tcxo_count
  
  ; Start the counting
  &measure_ctl=&measure_ctl|0x100000
  data.set &access_mode:&frq_measure_ctl_addr %LONG &measure_ctl
  
  ; Wait for the counters to finish
  wait 1.ms
  while (data.long(&access_mode:&frq_measure_status_addr)&0x2000000)==0
  (
  )
  
  ; Turn off the test clock and read the clock count
  &measure_ctl=data.long(&access_mode:&frq_measure_ctl_addr)
  data.set &access_mode:&frq_measure_ctl_addr %LONG (&measure_ctl&~0x100000)
  
  &short_clock_count=data.long(&access_mode:&frq_measure_status_addr)&0x1FFFFFF
  
  ; Restore the registers
  data.set &access_mode:&xo_div4_cbcr_addr %LONG &xo_div4_cbcr
 
  ; Now do a longer count and compare
  ; Save current values
  &xo_div4_cbcr=data.long(&access_mode:&xo_div4_cbcr_addr)
  
  &tcxo_count=0x8000
  
  ; Config XO DIV4 comparator clock
  data.set &access_mode:&xo_div4_cbcr_addr %LONG data.long(&access_mode:&xo_div4_cbcr_addr)|0x1
  
  ; Start with the counter disabled 
  &measure_ctl=data.long(&access_mode:&frq_measure_ctl_addr)
  &measure_ctl=&measure_ctl&~0x1FFFFF
  data.set &access_mode:&frq_measure_ctl_addr %LONG &measure_ctl
  
  ; Program the starting counter value, high enough to get good accuracy
  &measure_ctl=&measure_ctl|&tcxo_count
  
  ; Start the counting
  &measure_ctl=&measure_ctl|0x100000
  data.set &access_mode:&frq_measure_ctl_addr %LONG &measure_ctl
  
  ; Wait for the counters to finish
  wait 1.ms
  while (data.long(&access_mode:&frq_measure_status_addr)&0x2000000)==0
  (
  )
  
  ; Turn off the test clock and read the clock count
  &measure_ctl=data.long(&access_mode:&frq_measure_ctl_addr)
  data.set &access_mode:&frq_measure_ctl_addr %LONG (&measure_ctl&~0x100000)
  
  &clock_count=data.long(&access_mode:&frq_measure_status_addr)&0x1FFFFFF
  
  ; Calculate the frequency.  Function is provided by
  ; Power Control 42.8.1.2 Measurement technique
  ; f ring = f tcxo/4 * (Nring + 1.5) / (TCtcxo + 3.5)
  ;
  ; The formula below is the equivalent one converted
  ; to integer arithmetic.
  ; 
  ; We add half of the denominator value to the dividend
  ; to guard against rounding errors inherent to
  ; integer arithmetic.
  ;
  
  if &clock_count==&short_clock_count
  (
    &clk_freq=0
  )
  else
  (
    &clk_freq=4.8*(&clock_count+1.5)/(&tcxo_count+3.5)
  )
  
  ; Restore the registers
  data.set &access_mode:&xo_div4_cbcr_addr %LONG &xo_div4_cbcr

  return




PRINT_SET_CLOCK_FREQ_WARNING:

  print " "
  print "Warning: This feature is in beta and does not account for voltage requirements. Clock driver state will be out of sync."
  print " "

  return



;-----------------------------------------------------------------------------
; Set clock frequency.
;-----------------------------------------------------------------------------

Set_Clock_Freq:

  ; Use testpll.cmm to turn on required source
  do testpll.cmm on &clk_src_name

  ; Convert src divider to appropriate register value
  if (&clk_src_div!=0)
  (
    &clk_src_div=&clk_src_div-1
  )

  ; Read current cmd_rcgr and cfg_rcgr values
  &clk_cmd_rcgr_val=data.long(&access_mode:&clk_cmd_rcgr_addr)
  &clk_cfg_rcgr_val=data.long(&access_mode:&clk_cfg_rcgr_addr)

  ; Clear src_sel, src_div, and mode fields
  &clk_cfg_rcgr_val=&clk_cfg_rcgr_val&~(&HAL_CLK_CFG_CGR_SRC_SEL_FMSK|&HAL_CLK_CFG_CGR_SRC_DIV_FMSK|&HAL_CLK_CFG_CGR_MODE_FMSK)

  ; Program src_sel and src_div
  &clk_cfg_rcgr_val=&clk_cfg_rcgr_val|((&clk_src_sel<<&HAL_CLK_CFG_CGR_SRC_SEL_SHFT)&(&HAL_CLK_CFG_CGR_SRC_SEL_FMSK))
  &clk_cfg_rcgr_val=&clk_cfg_rcgr_val|((&clk_src_div<<&HAL_CLK_CFG_CGR_SRC_DIV_SHFT)&(&HAL_CLK_CFG_CGR_SRC_DIV_FMSK))

  ; Program M, N, D registers if necessary
  if (&clk_m_val!=0.)&&(&clk_m_val<&clk_n_val)
  (
    &clk_m_addr=&clk_cmd_rcgr_addr+&HAL_CLK_M_REG_OFFSET
    &clk_n_addr=&clk_cmd_rcgr_addr+&HAL_CLK_N_REG_OFFSET
    &clk_2d_addr=&clk_cmd_rcgr_addr+&HAL_CLK_D_REG_OFFSET

    ; Write to M register
    data.set &access_mode:&clk_m_addr %long &clk_m_val
    
    ; Write to N register
    data.set &access_mode:&clk_n_addr %long ~(&clk_n_val-&clk_m_val)
    
    ; Write to D register
    data.set &access_mode:&clk_2d_addr %long ~&clk_2d_val
    
    ; Dual edge mode
    &clk_cfg_rcgr_val=&clk_cfg_rcgr_val|((&HAL_CLK_CFG_CFG_DUAL_EDGE_MODE_VAL<<&HAL_CLK_CFG_CGR_MODE_SHFT)&(&HAL_CLK_CFG_CGR_MODE_FMSK))
  )
  
  ; Write to cfg_rcgr
  data.set &access_mode:&clk_cfg_rcgr_addr %long &clk_cfg_rcgr_val

  ; Write to cmd_rcgr to trigger update
  data.set &access_mode:&clk_cmd_rcgr_addr %long (&clk_cmd_rcgr_val|&HAL_CLK_CMD_CFG_UPDATE_FMSK)

  ; Wait for update to finish
  wait 1.ms
  while (data.long(&access_mode:&clk_cmd_rcgr_addr)&(&HAL_CLK_CMD_CFG_UPDATE_FMSK))!=0
  (
  )

  return




;-----------------------------------------------------------------------------
; Display clock info header
;-----------------------------------------------------------------------------

Print_Header:

  if &header_printed==0
  (
    print " "
    print "Clock                                      State      Frequency (MHz)         CBCR Addr : Value        CBCR Type "
    print "---------------------------------------------------------------------------------------------------------------- "

    &header_printed=1
  )

  return




;-----------------------------------------------------------------------------
; Display clock info line
;-----------------------------------------------------------------------------

Print_Clk_Info_Line:
(
  local &is_on &clk_reg_val &clk_reg_val_str &on_reg &on_mask &clk_freq_str

  ;-----------------------------------------------------------------------------
  ; Toggle clock state if requested
  ;-----------------------------------------------------------------------------
  if (&clk_reg!=0)
  (
    if &clk_vote_bit!=-1.
    (
      &vote_idx=&clk_vote_bit/32.
      &on_reg=v.value(\vote_regs[&vote_idx])
      &on_mask=(1<<(&clk_vote_bit-(32.*&vote_idx)))
    )
    else
    (
      &on_reg="&clk_reg"
      &on_mask=0x1
    )

    if "&state_change"=="on"
    (
      data.set &clk_access_mode:&on_reg %LONG (data.long(&clk_access_mode:&on_reg)|&on_mask)
    )
    else if "&state_change"=="off"
    (
      data.set &clk_access_mode:&on_reg %LONG (data.long(&clk_access_mode:&on_reg)&~(&on_mask))
    )
  )

  if "&state_change"=="set"
  (
    gosub Set_Clock_Freq_Enter
  )

  ;-----------------------------------------------------------------------------
  ; Print the clock header
  ;-----------------------------------------------------------------------------
  gosub Print_Header

  ;-----------------------------------------------------------------------------
  ; Test if clock is on
  ;-----------------------------------------------------------------------------
  
  if (&clk_reg!=0)
  (
    if (data.long(&clk_access_mode:&clk_reg)&(0x80000000))==0x0
    (
      &clk_state="ON "
      &is_on=1
    )
    else
    (
      &clk_state="OFF"
      &clk_freq=0
      &is_on=0
    )
  )
  else
  (
    &clk_state=" ? " 
    &is_on=-1
  )
  
  ;-----------------------------------------------------------------------------
  ; Calculate the clock frequency based on the TCXO counter
  ;-----------------------------------------------------------------------------

  if (&clk_test!=0)&&((&is_on==1)||(&is_on==-1))
  (
    gosub Program_Clk_Test

    ; Set dividers before calculation to ensure clock is within range of
    ; the frequency counter. Clear dividers after calculation so they
    ; don't affect frequency when probing with a scope.
    gosub Set_Dividers
    gosub Calc_Clock_Freq
    gosub Clear_Dividers

    if (&clk_freq==0)
    (
      &clk_freq_str=FORMAT.DECIMAL(14., 0x0)
    )
    else
    (
      &clk_freq=&clk_freq*&clk_multiplier
      &clk_freq_str=FORMAT.FLOAT(12., 0x6, &clk_freq) 
    )

    if (&is_on==-1)
    (
      if (&clk_freq==0)
      (
        &is_on=0
      )
      else
      (
        &is_on=1
      )
    )
  )
  else if (&is_on==0)
  (
    &clk_freq_str=FORMAT.DECIMAL(14., 0x0)
  )
  else
  (
    &clk_freq_str="  Not Testable"
  )
  
  if ((("&clk_state_filter"=="all_on")&&(&is_on==0))||(("&clk_state_filter"=="all_off")&&(&is_on==1)))
  (
    return
  )

  if (&clk_reg!=0)
  (
    &clk_reg_val=FORMAT.HEX(0x8, data.long(&clk_access_mode:&clk_reg))
    &clk_reg_val_str="0x&clk_reg_val"
    
    &clk_reg=FORMAT.HEX(0x8, &clk_reg)
    &clk_reg_str="0x&clk_reg"
  )
  else
  (
    &clk_reg_str="----------" 
    &clk_reg_val_str="----------"
  )

  ; Format clock name width

  &left_width="                                           "
  &padding=STRING.CUT("&left_width", STRING.LEN("&clk_name"))

  print "&clk_name&padding &clk_state       &clk_freq_str         &clk_reg_str : &clk_reg_val_str   &clk_reg_cbcr_type"

  return
)



;-----------------------------------------------------------------------------
; Program the clk_test register
;-----------------------------------------------------------------------------

Program_Clk_Test:

  &testval=&clk_test&(&CLK_TEST_TYPE_MASK)
  &selval=&clk_test&(&CLK_TEST_SEL_MASK)

  ; APCS
  if &selval==&CLK_APCS_TEST
  (

    
    &apcs_alias1_glb_clk_diag_reg=&HWIO_APCS_ALIAS1_GLB_CLK_DIAG_ADDR
    &apcs_alias1_glb_clk_diag_val=(data.long(&APCS_access_mode:&apcs_alias1_glb_clk_diag_reg)&~0xffffffff)|(0x0&0xffffffff)
    &apcs_alias1_glb_clk_diag_val=&apcs_alias1_glb_clk_diag_val&~(0x7fff<<0.)
    data.set &APCS_access_mode:&apcs_alias1_glb_clk_diag_reg %LONG &apcs_alias1_glb_clk_diag_val&~0x7fff|((&testval<<0.)&0x7fff)

    
    &gcc_gcc_debug_clk_ctl_reg=&HWIO_GCC_GCC_DEBUG_CLK_CTL_ADDR
    &gcc_gcc_debug_clk_ctl_val=(data.long(&GCC_access_mode:&gcc_gcc_debug_clk_ctl_reg)&~0xffffffff)|(0x10000&0xffffffff)
    &gcc_gcc_debug_clk_ctl_val=&gcc_gcc_debug_clk_ctl_val&~(0x1ff<<0.)
    data.set &GCC_access_mode:&gcc_gcc_debug_clk_ctl_reg %LONG &gcc_gcc_debug_clk_ctl_val&~0x1ff|((0x16a<<0.)&0x1ff)



    ; Frequency counter utility registers.
    &frq_measure_ctl_addr=&HWIO_GCC_CLOCK_FRQ_MEASURE_CTL_ADDR
    &frq_measure_status_addr=&HWIO_GCC_CLOCK_FRQ_MEASURE_STATUS_ADDR
    &xo_div4_cbcr_addr=&HWIO_GCC_GCC_XO_DIV4_CBCR_ADDR

  )

  ; GCC
  else if &selval==&CLK_GCC_TEST
  (

    
    &gcc_gcc_debug_clk_ctl_reg=&HWIO_GCC_GCC_DEBUG_CLK_CTL_ADDR
    &gcc_gcc_debug_clk_ctl_val=(data.long(&GCC_access_mode:&gcc_gcc_debug_clk_ctl_reg)&~0xffffffff)|(0x10000&0xffffffff)
    &gcc_gcc_debug_clk_ctl_val=&gcc_gcc_debug_clk_ctl_val&~(0x1ff<<0.)
    data.set &GCC_access_mode:&gcc_gcc_debug_clk_ctl_reg %LONG &gcc_gcc_debug_clk_ctl_val&~0x1ff|((&testval<<0.)&0x1ff)



    ; Frequency counter utility registers.
    &frq_measure_ctl_addr=&HWIO_GCC_CLOCK_FRQ_MEASURE_CTL_ADDR
    &frq_measure_status_addr=&HWIO_GCC_CLOCK_FRQ_MEASURE_STATUS_ADDR
    &xo_div4_cbcr_addr=&HWIO_GCC_GCC_XO_DIV4_CBCR_ADDR

  )
 
  return
  

Configure_GPIO:
    
    ; Configure HS GPIO
     data.set &access_mode:&HWIO_TLMM_GPIO_CFG53_ADDR %LONG 0x1D0
     print "GPIO 53 configured and output enabled"    
    
    ;&val=data.long(&GCC_access_mode:&HWIO_GCC_PLLTEST_PAD_CFG_ADDR)|0xa1000
    ;data.set &GCC_access_mode:&HWIO_GCC_PLLTEST_PAD_CFG_ADDR %LONG &val
    ;print "PLLTEST_PAD enabled in GCC_PLLTEST_PAD_CFG."

    return

Set_Dividers:
    
    &val=(data.long(&GCC_access_mode:&HWIO_GCC_GCC_DEBUG_CLK_CTL_ADDR)&~0xf000)|(0x3<<12.)
    data.set &GCC_access_mode:&HWIO_GCC_GCC_DEBUG_CLK_CTL_ADDR %LONG &val

    return

Clear_Dividers:
    
    &val=(data.long(&GCC_access_mode:&HWIO_GCC_GCC_DEBUG_CLK_CTL_ADDR)&~0xf000)
    data.set &GCC_access_mode:&HWIO_GCC_GCC_DEBUG_CLK_CTL_ADDR %LONG &val

    return


Print_Clock_Help:


  print " "
  print "*****************************************************  APCS  ******************************************************"

  print " "
  print "[ APCS ]" 
  print " apc0_sysleaf_clk                   apc1_sysleaf_clk                   apc2_sysleaf_clk                    " 
  print " apc3_sysleaf_clk                   apc_l2_sysleaf_clk                 im_sleep_clk                        " 
  print " im_ref_clk                         sys_apcsqsb_clk                    apcs_hdcd_ahb_gated_clk             " 
  print " "
  print "[ EXT ]" 

  print " "
  print "*****************************************************  GCC   ******************************************************"

  print " "
  print "[ STANDALONEBCR ]" 
  print "  " 
  print " "
  print "[ APSS ]" 
  print " gcc_apss_ahb_clk                   gcc_snoc_bus_timeout0_ahb_clk      gcc_sys_noc_apss_ahb_clk            " 
  print " gcc_apss_axi_clk                   gcc_bimc_apss_axi_clk               " 
  print " "
  print "[ BIMC ]" 
  print " gcc_bimc_clk                       gcc_debug_mux                      gcc_spdm_bimc_cy_clk                " 
  print " gcc_spdm_debug_cy_clk              gcc_bimc_xo_clk                    gcc_bimc_gfx_clk                    " 
  print " gcc_bimc_gpu_clk                   gcc_gfx_tbu_clk                    gcc_gfx_tcu_clk                     " 
  print " "
  print "[ BLSP1 ]" 
  print " gcc_blsp1_uart0_sim_clk            gcc_blsp1_uart1_sim_clk            gcc_blsp1_uart2_sim_clk             " 
  print " gcc_blsp1_uart3_sim_clk            gcc_blsp2_uart0_sim_clk             " 
  print " "
  print "[ BLSP1_QUP0 ]" 
  print " gcc_blsp1_qup0_i2c_apps_clk        gcc_blsp1_qup0_spi_apps_clk         " 
  print " "
  print "[ BLSP1_QUP1 ]" 
  print " gcc_blsp1_qup1_i2c_apps_clk        gcc_blsp1_qup1_spi_apps_clk         " 
  print " "
  print "[ BLSP1_QUP2 ]" 
  print " gcc_blsp1_qup2_i2c_apps_clk        gcc_blsp1_qup2_spi_apps_clk         " 
  print " "
  print "[ BLSP1_QUP3 ]" 
  print " gcc_blsp1_qup3_i2c_apps_clk        gcc_blsp1_qup3_spi_apps_clk         " 
  print " "
  print "[ BLSP1_QUP4 ]" 
  print " gcc_blsp1_qup4_i2c_apps_clk        gcc_blsp1_qup4_spi_apps_clk         " 
  print " "
  print "[ BLSP1_UART0 ]" 
  print " gcc_blsp1_uart0_apps_clk            " 
  print " "
  print "[ BLSP1_UART1 ]" 
  print " gcc_blsp1_uart1_apps_clk            " 
  print " "
  print "[ BLSP1_UART2 ]" 
  print " gcc_blsp1_uart2_apps_clk            " 
  print " "
  print "[ BLSP1_UART3 ]" 
  print " gcc_blsp1_uart3_apps_clk            " 
  print " "
  print "[ BLSP2_QUP0 ]" 
  print " gcc_blsp2_qup0_i2c_apps_clk        gcc_blsp2_qup0_spi_apps_clk         " 
  print " "
  print "[ BLSP2_UART0 ]" 
  print " gcc_blsp2_uart0_apps_clk            " 
  print " "
  print "[ CDSP ]" 
  print " gcc_bimc_cdsp_clk                  gcc_cdsp_bimc_clk                  gcc_cdsp_tbu_clk                    " 
  print " "
  print "[ CRYPTO ]" 
  print " gcc_crypto_clk                      " 
  print " "
  print "[ DEBUG ]" 
  print "  " 
  print " "
  print "[ EMAC ]" 
  print " gcc_eth_rgmii_clk                  gcc_eth_ptp_clk                     " 
  print " "
  print "[ EXTERNAL RAW CLOCKS ]" 
  print " gcc_tic_clk                         " 
  print " "
  print "[ GCC ]" 
  print " gcc_bimc_sleep_clk                 gcc_blsp1_sleep_clk                gcc_blsp2_sleep_clk                 " 
  print " gcc_ddr_dim_sleep_clk              gcc_im_sleep_clk                   gcc_qpic_system_clk                 " 
  print " gcc_rpm_sleep_clk                  gcc_usb2a_phy_sleep_clk            gcc_usb30_sleep_clk                 " 
  print " gcc_usb_hs_inactivity_timers_clk   lpass_sleep_clk                    gcc_dcc_xo_clk                      " 
  print " gcc_dcd_xo_clk                     gcc_geni_ir_s_clk                  gcc_xo_clk                          " 
  print " gcc_xo_div4_clk                     " 
  print " "
  print "[ GCC_MM_SPDM ]" 
  print " gcc_spdm_gfx3d_clk                 gcc_spdm_mdp_clk                   gcc_spdm_pclk0_clk                  " 
  print " "
  print "[ GP1 ]" 
  print " gcc_gp1_clk                         " 
  print " "
  print "[ GP2 ]" 
  print " gcc_gp2_clk                         " 
  print " "
  print "[ GP3 ]" 
  print " gcc_gp3_clk                         " 
  print " "
  print "[ LPASS ]" 
  print " gcc_bimc_lpass_clk                 gcc_lpass_agnoc_clk                gcc_lpass_core_mport_clk            " 
  print " gcc_lpass_hw_af_clk                gcc_lpass_q6_axim_clk              gcc_lpass_tbu_clk                   " 
  print " "
  print "[ MDSS ]" 
  print " gcc_mdss_byte0_clk                 gcc_mdss_esc0_clk                  gcc_mdss_hdmi_app_clk               " 
  print " gcc_mdss_hdmi_pclk_clk             gcc_mdss_mdp_clk                   gcc_bimc_mdss_clk                   " 
  print " gcc_mdp_tbu_clk                    gcc_mdss_axi_clk                   gcc_mdss_pclk0_clk                  " 
  print " gcc_mdss_vsync_clk                  " 
  print " "
  print "[ OXILI ]" 
  print " gcc_oxili_gfx3d_clk                 " 
  print " "
  print "[ PCIE_0 ]" 
  print " gcc_pcie_0_aux_clk                 gcc_pcie_0_pipe_clk                 " 
  print " "
  print "[ PCNOC ]" 
  print " gcc_ahb_clk                        gcc_bimc_cfg_ahb_clk               gcc_blsp1_ahb_clk                   " 
  print " gcc_blsp2_ahb_clk                  gcc_boot_rom_ahb_clk               gcc_cdsp_cfg_ahb_clk                " 
  print " gcc_crypto_ahb_clk                 gcc_crypto_axi_clk                 gcc_dcc_clk                         " 
  print " gcc_eth_slave_ahb_clk              gcc_geni_ir_h_clk                  gcc_geni_ir_xpu_clk                 " 
  print " gcc_gtcu_ahb_clk                   gcc_imem_cfg_ahb_clk               gcc_lpass_agnoc_cfg_clk             " 
  print " gcc_lpass_agnoc_mpu_cfg_clk        gcc_lpass_mpu_cfg_clk              gcc_mdss_ahb_clk                    " 
  print " gcc_mpm_ahb_clk                    gcc_msg_ram_ahb_clk                gcc_noc_conf_xpu_ahb_clk            " 
  print " gcc_oxili_ahb_clk                  gcc_pcie_0_cfg_ahb_clk             gcc_pcnoc_ahb_clk                   " 
  print " gcc_pcnoc_bus_timeout0_ahb_clk     gcc_pcnoc_bus_timeout1_ahb_clk     gcc_pcnoc_bus_timeout2_ahb_clk      " 
  print " gcc_pcnoc_bus_timeout3_ahb_clk     gcc_pcnoc_bus_timeout4_ahb_clk     gcc_pcnoc_bus_timeout6_ahb_clk      " 
  print " gcc_pcnoc_bus_timeout7_ahb_clk     gcc_pcnoc_bus_timeout8_ahb_clk     gcc_pcnoc_bus_timeout9_ahb_clk      " 
  print " gcc_pcnoc_ddr_cfg_clk              gcc_pcnoc_east_ahb_clk             gcc_pcnoc_mpu_cfg_ahb_clk           " 
  print " gcc_pcnoc_mst_rpm_bridge_clk       gcc_pcnoc_north_ahb_clk            gcc_pcnoc_slv_rpm_bridge_clk        " 
  print " gcc_pcnoc_south_ahb_clk            gcc_pcnoc_tbu_clk                  gcc_pcnoc_west_ahb_clk              " 
  print " gcc_pdm_ahb_clk                    gcc_prng_ahb_clk                   gcc_qdss_cfg_ahb_clk                " 
  print " gcc_qdss_dap_ahb_clk               gcc_qpic_ahb_clk                   gcc_rbcpr_ahb_clk                   " 
  print " gcc_rpm_cfg_xpu_clk                gcc_sdcc1_ahb_clk                  gcc_sdcc2_ahb_clk                   " 
  print " gcc_sec_ctrl_ahb_clk               gcc_sec_ctrl_boot_rom_patch_clk    gcc_smmu_cfg_clk                    " 
  print " gcc_smmu_xpu_clk                   gcc_snoc_pcnoc_ahb_clk             gcc_spdm_cfg_ahb_clk                " 
  print " gcc_spdm_mstr_ahb_clk              gcc_spdm_pcnoc_cy_clk              gcc_spmi_pcnoc_ahb_clk              " 
  print " gcc_tcsr_ahb_clk                   gcc_tic_cfg_ahb_clk                gcc_tlmm_clk                        " 
  print " gcc_tlmm_east_ahb_clk              gcc_tlmm_east_clk                  gcc_tlmm_north_ahb_clk              " 
  print " gcc_tlmm_north_clk                 gcc_tlmm_south_ahb_clk             gcc_tlmm_south_clk                  " 
  print " gcc_usb_hs_phy_cfg_ahb_clk         gcc_wdsp_q6ss_ahbs_clk              " 
  print " "
  print "[ PDM ]" 
  print " gcc_pdm_xo4_clk                    gcc_pdm2_clk                       gcc_pwm0_xo512_clk                  " 
  print " "
  print "[ PWM1 ]" 
  print " gcc_pwm1_xo512_clk                  " 
  print " "
  print "[ PWM2 ]" 
  print " gcc_pwm2_xo512_clk                  " 
  print " "
  print "[ QDSS ]" 
  print " gcc_qdss_apb2jtag_clk              gcc_qdss_dap_clk                   gcc_qdss_tsctr_clk                  " 
  print " gcc_wcss_apb_clk                   gcc_wcss_tsctr_clk                 gcc_lpass_at_clk                    " 
  print " gcc_pcnoc_at_clk                   gcc_qdss_at_clk                    gcc_sys_noc_at_clk                  " 
  print " gcc_wcss_at_clk                    gcc_qdss_stm_clk                   gcc_sys_noc_qdss_stm_axi_clk        " 
  print " gcc_qdss_traceclkin_clk            gcc_qdss_trig_clk                   " 
  print " "
  print "[ QPIC ]" 
  print " gcc_qpic_clk                        " 
  print " "
  print "[ RBCPR ]" 
  print " gcc_rbcpr_clk                       " 
  print " "
  print "[ RPM ]" 
  print " gcc_rpm_bus_ahb_clk                gcc_rpm_proc_fclk                  gcc_rpm_proc_hclk                   " 
  print " gcc_rpm_timer_clk                   " 
  print " "
  print "[ SDCC1 ]" 
  print " gcc_sdcc1_apps_clk                 gcc_sdcc1_ice_core_clk              " 
  print " "
  print "[ SDCC2 ]" 
  print " gcc_sdcc2_apps_clk                  " 
  print " "
  print "[ SEC_CTRL ]" 
  print " gcc_sec_ctrl_acc_clk               gcc_sec_ctrl_clk                   gcc_sec_ctrl_sense_clk              " 
  print " "
  print "[ SMMU ]" 
  print " gcc_apss_tcu_async_clk             gcc_bimc_apss_tcu_clk              gcc_smmu_cats_clk                   " 
  print " "
  print "[ SPDM ]" 
  print " gcc_spdm_ff_clk                    gcc_spdm_rpm_cy_clk                 " 
  print " "
  print "[ SPMI ]" 
  print " gcc_spmi_ahb_clk                   gcc_spmi_ser_clk                    " 
  print " "
  print "[ SYSTEM_NOC ]" 
  print " gcc_bimc_sysnoc_axi_clk            gcc_emac_tbu_axi_clk               gcc_eth_axi_clk                     " 
  print " gcc_imem_axi_clk                   gcc_lpass_q6_axis_clk              gcc_lpass_sway_clk                  " 
  print " gcc_pcie_0_mstr_axi_clk            gcc_pcie_0_slv_axi_clk             gcc_pcie_tbu_clk                    " 
  print " gcc_qdss_etr_usb_clk               gcc_snoc_bus_timeout1_ahb_clk      gcc_snoc_bus_timeout2_ahb_clk       " 
  print " gcc_spdm_snoc_cy_clk               gcc_sys_noc_axi_clk                gcc_sys_noc_lpass_clk               " 
  print " gcc_sys_noc_tprb_clk               gcc_sys_noc_wcss_clk               gcc_wcss_ahb_s0_clk                 " 
  print " gcc_wcss_axi_m_clk                 gcc_wcss_ecahb_clk                 gcc_wcss_shdreg_ahb_clk             " 
  print " gcc_wcss_tbu_clk                   gcc_wdsp_q6ss_axim_clk             gcc_wdsp_xpu_clk                    " 
  print " "
  print "[ USB_30 ]" 
  print " gcc_pcnoc_bus_timeout11_ahb_clk    gcc_pcnoc_usb3_clk                 gcc_sys_noc_usb3_clk                " 
  print " gcc_usb30_master_clk               gcc_usb3_tbu_axi_clk               gcc_usb30_mock_utmi_clk             " 
  print " gcc_usb30_phy_pipe_clk             gcc_usb3_phy_aux_clk                " 
  print " "
  print "[ USB_HS ]" 
  print " gcc_usb20_mock_utmi_clk            gcc_pcnoc_bus_timeout10_ahb_clk    gcc_pcnoc_usb2_clk                  " 
  print " gcc_usb_hs_system_clk               " 
  print " "
  print "[ WDSP ]" 
  print " gcc_wdsp_q6ss_aon_clk              gcc_wdsp_q6ss_qos_clk               " 
  print " "
  print "[ EXT ]" 
  print " apss_gcc_dbg_clk                   apss_gcc_ringosc_clk               bimc_pll_dtest                      " 
  print " bimc_pll_lock_det                  gpll0_dtest                        gpll0_lock_det                      " 
  print " gpll3_dtest                        gpll3_lock_det                     gpll4_dtest                         " 
  print " gpll4_lock_det                     gpll5_dtest                        gpll5_lock_det                      " 
  print " gpll6_dtest                        gpll6_lock_det                     lpass_gcc_dbg_clk                   " 
  print " mpm_gcc_temp_sensor_ringosc_clk    pcie_0_pipe_clk                    usb2_phy_gcc_atest_ulpi_0_clk       " 
  print " usb2_phy_gcc_atest_ulpi_1_clk      wcss_gcc_dbg_clk                    " 

  return



Print_All:

  gosub Find_Print_Clock apc0_sysleaf_clk
  gosub Find_Print_Clock apc1_sysleaf_clk
  gosub Find_Print_Clock apc2_sysleaf_clk
  gosub Find_Print_Clock apc3_sysleaf_clk
  gosub Find_Print_Clock apc_l2_sysleaf_clk
  gosub Find_Print_Clock im_sleep_clk
  gosub Find_Print_Clock im_ref_clk
  gosub Find_Print_Clock sys_apcsqsb_clk
  gosub Find_Print_Clock apcs_hdcd_ahb_gated_clk
  gosub Find_Print_Clock gcc_sec_ctrl_acc_clk
  gosub Find_Print_Clock gcc_apss_ahb_clk
  gosub Find_Print_Clock gcc_snoc_bus_timeout0_ahb_clk
  gosub Find_Print_Clock gcc_sys_noc_apss_ahb_clk
  gosub Find_Print_Clock gcc_apss_axi_clk
  gosub Find_Print_Clock gcc_bimc_apss_axi_clk
  gosub Find_Print_Clock gcc_apss_tcu_async_clk
  gosub Find_Print_Clock gcc_bimc_apss_tcu_clk
  gosub Find_Print_Clock gcc_bimc_clk
  gosub Find_Print_Clock gcc_debug_mux
  gosub Find_Print_Clock gcc_spdm_bimc_cy_clk
  gosub Find_Print_Clock gcc_spdm_debug_cy_clk
  gosub Find_Print_Clock gcc_bimc_xo_clk
  gosub Find_Print_Clock gcc_bimc_gfx_clk
  gosub Find_Print_Clock gcc_bimc_gpu_clk
  gosub Find_Print_Clock gcc_gfx_tbu_clk
  gosub Find_Print_Clock gcc_gfx_tcu_clk
  gosub Find_Print_Clock gcc_blsp1_qup0_i2c_apps_clk
  gosub Find_Print_Clock gcc_blsp1_qup0_spi_apps_clk
  gosub Find_Print_Clock gcc_blsp1_qup1_i2c_apps_clk
  gosub Find_Print_Clock gcc_blsp1_qup1_spi_apps_clk
  gosub Find_Print_Clock gcc_blsp1_qup2_i2c_apps_clk
  gosub Find_Print_Clock gcc_blsp1_qup2_spi_apps_clk
  gosub Find_Print_Clock gcc_blsp1_qup3_i2c_apps_clk
  gosub Find_Print_Clock gcc_blsp1_qup3_spi_apps_clk
  gosub Find_Print_Clock gcc_blsp1_qup4_i2c_apps_clk
  gosub Find_Print_Clock gcc_blsp1_qup4_spi_apps_clk
  gosub Find_Print_Clock gcc_blsp1_uart0_apps_clk
  gosub Find_Print_Clock gcc_blsp1_uart1_apps_clk
  gosub Find_Print_Clock gcc_blsp1_uart2_apps_clk
  gosub Find_Print_Clock gcc_blsp1_uart3_apps_clk
  gosub Find_Print_Clock gcc_blsp2_qup0_i2c_apps_clk
  gosub Find_Print_Clock gcc_blsp2_qup0_spi_apps_clk
  gosub Find_Print_Clock gcc_blsp2_uart0_apps_clk
  gosub Find_Print_Clock gcc_blsp1_uart0_sim_clk
  gosub Find_Print_Clock gcc_blsp1_uart1_sim_clk
  gosub Find_Print_Clock gcc_blsp1_uart2_sim_clk
  gosub Find_Print_Clock gcc_blsp1_uart3_sim_clk
  gosub Find_Print_Clock gcc_blsp2_uart0_sim_clk
  gosub Find_Print_Clock gcc_mdss_byte0_clk
  gosub Find_Print_Clock gcc_bimc_cdsp_clk
  gosub Find_Print_Clock gcc_cdsp_bimc_clk
  gosub Find_Print_Clock gcc_cdsp_tbu_clk
  gosub Find_Print_Clock gcc_crypto_clk
  gosub Find_Print_Clock gcc_eth_rgmii_clk
  gosub Find_Print_Clock gcc_eth_ptp_clk
  gosub Find_Print_Clock gcc_mdss_esc0_clk
  gosub Find_Print_Clock gcc_bimc_sleep_clk
  gosub Find_Print_Clock gcc_blsp1_sleep_clk
  gosub Find_Print_Clock gcc_blsp2_sleep_clk
  gosub Find_Print_Clock gcc_ddr_dim_sleep_clk
  gosub Find_Print_Clock gcc_im_sleep_clk
  gosub Find_Print_Clock gcc_qpic_system_clk
  gosub Find_Print_Clock gcc_rpm_sleep_clk
  gosub Find_Print_Clock gcc_usb2a_phy_sleep_clk
  gosub Find_Print_Clock gcc_usb30_sleep_clk
  gosub Find_Print_Clock gcc_usb_hs_inactivity_timers_clk
  gosub Find_Print_Clock lpass_sleep_clk
  gosub Find_Print_Clock gcc_dcc_xo_clk
  gosub Find_Print_Clock gcc_dcd_xo_clk
  gosub Find_Print_Clock gcc_geni_ir_s_clk
  gosub Find_Print_Clock gcc_xo_clk
  gosub Find_Print_Clock gcc_xo_div4_clk
  gosub Find_Print_Clock gcc_oxili_gfx3d_clk
  gosub Find_Print_Clock gcc_gp1_clk
  gosub Find_Print_Clock gcc_gp2_clk
  gosub Find_Print_Clock gcc_gp3_clk
  gosub Find_Print_Clock gcc_mdss_hdmi_app_clk
  gosub Find_Print_Clock gcc_mdss_hdmi_pclk_clk
  gosub Find_Print_Clock gcc_bimc_lpass_clk
  gosub Find_Print_Clock gcc_lpass_agnoc_clk
  gosub Find_Print_Clock gcc_lpass_core_mport_clk
  gosub Find_Print_Clock gcc_lpass_hw_af_clk
  gosub Find_Print_Clock gcc_lpass_q6_axim_clk
  gosub Find_Print_Clock gcc_lpass_tbu_clk
  gosub Find_Print_Clock gcc_mdss_mdp_clk
  gosub Find_Print_Clock gcc_bimc_mdss_clk
  gosub Find_Print_Clock gcc_mdp_tbu_clk
  gosub Find_Print_Clock gcc_mdss_axi_clk
  gosub Find_Print_Clock gcc_pcie_0_aux_clk
  gosub Find_Print_Clock gcc_pcie_0_pipe_clk
  gosub Find_Print_Clock gcc_mdss_pclk0_clk
  gosub Find_Print_Clock gcc_ahb_clk
  gosub Find_Print_Clock gcc_bimc_cfg_ahb_clk
  gosub Find_Print_Clock gcc_blsp1_ahb_clk
  gosub Find_Print_Clock gcc_blsp2_ahb_clk
  gosub Find_Print_Clock gcc_boot_rom_ahb_clk
  gosub Find_Print_Clock gcc_cdsp_cfg_ahb_clk
  gosub Find_Print_Clock gcc_crypto_ahb_clk
  gosub Find_Print_Clock gcc_crypto_axi_clk
  gosub Find_Print_Clock gcc_dcc_clk
  gosub Find_Print_Clock gcc_eth_slave_ahb_clk
  gosub Find_Print_Clock gcc_geni_ir_h_clk
  gosub Find_Print_Clock gcc_geni_ir_xpu_clk
  gosub Find_Print_Clock gcc_gtcu_ahb_clk
  gosub Find_Print_Clock gcc_imem_cfg_ahb_clk
  gosub Find_Print_Clock gcc_lpass_agnoc_cfg_clk
  gosub Find_Print_Clock gcc_lpass_agnoc_mpu_cfg_clk
  gosub Find_Print_Clock gcc_lpass_mpu_cfg_clk
  gosub Find_Print_Clock gcc_mdss_ahb_clk
  gosub Find_Print_Clock gcc_mpm_ahb_clk
  gosub Find_Print_Clock gcc_msg_ram_ahb_clk
  gosub Find_Print_Clock gcc_noc_conf_xpu_ahb_clk
  gosub Find_Print_Clock gcc_oxili_ahb_clk
  gosub Find_Print_Clock gcc_pcie_0_cfg_ahb_clk
  gosub Find_Print_Clock gcc_pcnoc_ahb_clk
  gosub Find_Print_Clock gcc_pcnoc_bus_timeout0_ahb_clk
  gosub Find_Print_Clock gcc_pcnoc_bus_timeout1_ahb_clk
  gosub Find_Print_Clock gcc_pcnoc_bus_timeout2_ahb_clk
  gosub Find_Print_Clock gcc_pcnoc_bus_timeout3_ahb_clk
  gosub Find_Print_Clock gcc_pcnoc_bus_timeout4_ahb_clk
  gosub Find_Print_Clock gcc_pcnoc_bus_timeout6_ahb_clk
  gosub Find_Print_Clock gcc_pcnoc_bus_timeout7_ahb_clk
  gosub Find_Print_Clock gcc_pcnoc_bus_timeout8_ahb_clk
  gosub Find_Print_Clock gcc_pcnoc_bus_timeout9_ahb_clk
  gosub Find_Print_Clock gcc_pcnoc_ddr_cfg_clk
  gosub Find_Print_Clock gcc_pcnoc_east_ahb_clk
  gosub Find_Print_Clock gcc_pcnoc_mpu_cfg_ahb_clk
  gosub Find_Print_Clock gcc_pcnoc_mst_rpm_bridge_clk
  gosub Find_Print_Clock gcc_pcnoc_north_ahb_clk
  gosub Find_Print_Clock gcc_pcnoc_slv_rpm_bridge_clk
  gosub Find_Print_Clock gcc_pcnoc_south_ahb_clk
  gosub Find_Print_Clock gcc_pcnoc_tbu_clk
  gosub Find_Print_Clock gcc_pcnoc_west_ahb_clk
  gosub Find_Print_Clock gcc_pdm_ahb_clk
  gosub Find_Print_Clock gcc_prng_ahb_clk
  gosub Find_Print_Clock gcc_qdss_cfg_ahb_clk
  gosub Find_Print_Clock gcc_qdss_dap_ahb_clk
  gosub Find_Print_Clock gcc_qpic_ahb_clk
  gosub Find_Print_Clock gcc_rbcpr_ahb_clk
  gosub Find_Print_Clock gcc_rpm_cfg_xpu_clk
  gosub Find_Print_Clock gcc_sdcc1_ahb_clk
  gosub Find_Print_Clock gcc_sdcc2_ahb_clk
  gosub Find_Print_Clock gcc_sec_ctrl_ahb_clk
  gosub Find_Print_Clock gcc_sec_ctrl_boot_rom_patch_clk
  gosub Find_Print_Clock gcc_smmu_cfg_clk
  gosub Find_Print_Clock gcc_smmu_xpu_clk
  gosub Find_Print_Clock gcc_snoc_pcnoc_ahb_clk
  gosub Find_Print_Clock gcc_spdm_cfg_ahb_clk
  gosub Find_Print_Clock gcc_spdm_mstr_ahb_clk
  gosub Find_Print_Clock gcc_spdm_pcnoc_cy_clk
  gosub Find_Print_Clock gcc_spmi_pcnoc_ahb_clk
  gosub Find_Print_Clock gcc_tcsr_ahb_clk
  gosub Find_Print_Clock gcc_tic_cfg_ahb_clk
  gosub Find_Print_Clock gcc_tlmm_clk
  gosub Find_Print_Clock gcc_tlmm_east_ahb_clk
  gosub Find_Print_Clock gcc_tlmm_east_clk
  gosub Find_Print_Clock gcc_tlmm_north_ahb_clk
  gosub Find_Print_Clock gcc_tlmm_north_clk
  gosub Find_Print_Clock gcc_tlmm_south_ahb_clk
  gosub Find_Print_Clock gcc_tlmm_south_clk
  gosub Find_Print_Clock gcc_usb_hs_phy_cfg_ahb_clk
  gosub Find_Print_Clock gcc_wdsp_q6ss_ahbs_clk
  gosub Find_Print_Clock gcc_pdm_xo4_clk
  gosub Find_Print_Clock gcc_pdm2_clk
  gosub Find_Print_Clock gcc_pwm0_xo512_clk
  gosub Find_Print_Clock gcc_pwm1_xo512_clk
  gosub Find_Print_Clock gcc_pwm2_xo512_clk
  gosub Find_Print_Clock gcc_qdss_apb2jtag_clk
  gosub Find_Print_Clock gcc_qdss_dap_clk
  gosub Find_Print_Clock gcc_qdss_tsctr_clk
  gosub Find_Print_Clock gcc_wcss_apb_clk
  gosub Find_Print_Clock gcc_wcss_tsctr_clk
  gosub Find_Print_Clock gcc_lpass_at_clk
  gosub Find_Print_Clock gcc_pcnoc_at_clk
  gosub Find_Print_Clock gcc_qdss_at_clk
  gosub Find_Print_Clock gcc_sys_noc_at_clk
  gosub Find_Print_Clock gcc_wcss_at_clk
  gosub Find_Print_Clock gcc_qdss_stm_clk
  gosub Find_Print_Clock gcc_sys_noc_qdss_stm_axi_clk
  gosub Find_Print_Clock gcc_qdss_traceclkin_clk
  gosub Find_Print_Clock gcc_qdss_trig_clk
  gosub Find_Print_Clock gcc_qpic_clk
  gosub Find_Print_Clock gcc_rbcpr_clk
  gosub Find_Print_Clock gcc_rpm_bus_ahb_clk
  gosub Find_Print_Clock gcc_rpm_proc_fclk
  gosub Find_Print_Clock gcc_rpm_proc_hclk
  gosub Find_Print_Clock gcc_rpm_timer_clk
  gosub Find_Print_Clock gcc_sdcc1_apps_clk
  gosub Find_Print_Clock gcc_sdcc1_ice_core_clk
  gosub Find_Print_Clock gcc_sdcc2_apps_clk
  gosub Find_Print_Clock gcc_sec_ctrl_clk
  gosub Find_Print_Clock gcc_sec_ctrl_sense_clk
  gosub Find_Print_Clock gcc_smmu_cats_clk
  gosub Find_Print_Clock gcc_spdm_ff_clk
  gosub Find_Print_Clock gcc_spdm_gfx3d_clk
  gosub Find_Print_Clock gcc_spdm_mdp_clk
  gosub Find_Print_Clock gcc_spdm_pclk0_clk
  gosub Find_Print_Clock gcc_spdm_rpm_cy_clk
  gosub Find_Print_Clock gcc_spmi_ahb_clk
  gosub Find_Print_Clock gcc_spmi_ser_clk
  gosub Find_Print_Clock gcc_bimc_sysnoc_axi_clk
  gosub Find_Print_Clock gcc_emac_tbu_axi_clk
  gosub Find_Print_Clock gcc_eth_axi_clk
  gosub Find_Print_Clock gcc_imem_axi_clk
  gosub Find_Print_Clock gcc_lpass_q6_axis_clk
  gosub Find_Print_Clock gcc_lpass_sway_clk
  gosub Find_Print_Clock gcc_pcie_0_mstr_axi_clk
  gosub Find_Print_Clock gcc_pcie_0_slv_axi_clk
  gosub Find_Print_Clock gcc_pcie_tbu_clk
  gosub Find_Print_Clock gcc_qdss_etr_usb_clk
  gosub Find_Print_Clock gcc_snoc_bus_timeout1_ahb_clk
  gosub Find_Print_Clock gcc_snoc_bus_timeout2_ahb_clk
  gosub Find_Print_Clock gcc_spdm_snoc_cy_clk
  gosub Find_Print_Clock gcc_sys_noc_axi_clk
  gosub Find_Print_Clock gcc_sys_noc_lpass_clk
  gosub Find_Print_Clock gcc_sys_noc_tprb_clk
  gosub Find_Print_Clock gcc_sys_noc_wcss_clk
  gosub Find_Print_Clock gcc_wcss_ahb_s0_clk
  gosub Find_Print_Clock gcc_wcss_axi_m_clk
  gosub Find_Print_Clock gcc_wcss_ecahb_clk
  gosub Find_Print_Clock gcc_wcss_shdreg_ahb_clk
  gosub Find_Print_Clock gcc_wcss_tbu_clk
  gosub Find_Print_Clock gcc_wdsp_q6ss_axim_clk
  gosub Find_Print_Clock gcc_wdsp_xpu_clk
  gosub Find_Print_Clock gcc_tic_clk
  gosub Find_Print_Clock gcc_usb20_mock_utmi_clk
  gosub Find_Print_Clock gcc_pcnoc_bus_timeout11_ahb_clk
  gosub Find_Print_Clock gcc_pcnoc_usb3_clk
  gosub Find_Print_Clock gcc_sys_noc_usb3_clk
  gosub Find_Print_Clock gcc_usb30_master_clk
  gosub Find_Print_Clock gcc_usb3_tbu_axi_clk
  gosub Find_Print_Clock gcc_usb30_mock_utmi_clk
  gosub Find_Print_Clock gcc_usb30_phy_pipe_clk
  gosub Find_Print_Clock gcc_usb3_phy_aux_clk
  gosub Find_Print_Clock gcc_pcnoc_bus_timeout10_ahb_clk
  gosub Find_Print_Clock gcc_pcnoc_usb2_clk
  gosub Find_Print_Clock gcc_usb_hs_system_clk
  gosub Find_Print_Clock gcc_mdss_vsync_clk
  gosub Find_Print_Clock gcc_wdsp_q6ss_aon_clk
  gosub Find_Print_Clock gcc_wdsp_q6ss_qos_clk
  gosub Find_Print_Clock apss_gcc_dbg_clk
  gosub Find_Print_Clock apss_gcc_ringosc_clk
  gosub Find_Print_Clock bimc_pll_dtest
  gosub Find_Print_Clock bimc_pll_lock_det
  gosub Find_Print_Clock gpll0_dtest
  gosub Find_Print_Clock gpll0_lock_det
  gosub Find_Print_Clock gpll3_dtest
  gosub Find_Print_Clock gpll3_lock_det
  gosub Find_Print_Clock gpll4_dtest
  gosub Find_Print_Clock gpll4_lock_det
  gosub Find_Print_Clock gpll5_dtest
  gosub Find_Print_Clock gpll5_lock_det
  gosub Find_Print_Clock gpll6_dtest
  gosub Find_Print_Clock gpll6_lock_det
  gosub Find_Print_Clock lpass_gcc_dbg_clk
  gosub Find_Print_Clock mpm_gcc_temp_sensor_ringosc_clk
  gosub Find_Print_Clock pcie_0_pipe_clk
  gosub Find_Print_Clock usb2_phy_gcc_atest_ulpi_0_clk
  gosub Find_Print_Clock usb2_phy_gcc_atest_ulpi_1_clk
  gosub Find_Print_Clock wcss_gcc_dbg_clk

  return


Print_All_SS:
(
  local &choice
  entry &choice

  if ("&choice"=="apcs_all")
  (
    gosub Find_Print_Clock apc0_sysleaf_clk
    gosub Find_Print_Clock apc1_sysleaf_clk
    gosub Find_Print_Clock apc2_sysleaf_clk
    gosub Find_Print_Clock apc3_sysleaf_clk
    gosub Find_Print_Clock apc_l2_sysleaf_clk
    gosub Find_Print_Clock im_sleep_clk
    gosub Find_Print_Clock im_ref_clk
    gosub Find_Print_Clock sys_apcsqsb_clk
    gosub Find_Print_Clock apcs_hdcd_ahb_gated_clk
    return 1.
  )
  if ("&choice"=="gcc_all")
  (
    gosub Find_Print_Clock gcc_sec_ctrl_acc_clk
    gosub Find_Print_Clock gcc_apss_ahb_clk
    gosub Find_Print_Clock gcc_snoc_bus_timeout0_ahb_clk
    gosub Find_Print_Clock gcc_sys_noc_apss_ahb_clk
    gosub Find_Print_Clock gcc_apss_axi_clk
    gosub Find_Print_Clock gcc_bimc_apss_axi_clk
    gosub Find_Print_Clock gcc_apss_tcu_async_clk
    gosub Find_Print_Clock gcc_bimc_apss_tcu_clk
    gosub Find_Print_Clock gcc_bimc_clk
    gosub Find_Print_Clock gcc_debug_mux
    gosub Find_Print_Clock gcc_spdm_bimc_cy_clk
    gosub Find_Print_Clock gcc_spdm_debug_cy_clk
    gosub Find_Print_Clock gcc_bimc_xo_clk
    gosub Find_Print_Clock gcc_bimc_gfx_clk
    gosub Find_Print_Clock gcc_bimc_gpu_clk
    gosub Find_Print_Clock gcc_gfx_tbu_clk
    gosub Find_Print_Clock gcc_gfx_tcu_clk
    gosub Find_Print_Clock gcc_blsp1_qup0_i2c_apps_clk
    gosub Find_Print_Clock gcc_blsp1_qup0_spi_apps_clk
    gosub Find_Print_Clock gcc_blsp1_qup1_i2c_apps_clk
    gosub Find_Print_Clock gcc_blsp1_qup1_spi_apps_clk
    gosub Find_Print_Clock gcc_blsp1_qup2_i2c_apps_clk
    gosub Find_Print_Clock gcc_blsp1_qup2_spi_apps_clk
    gosub Find_Print_Clock gcc_blsp1_qup3_i2c_apps_clk
    gosub Find_Print_Clock gcc_blsp1_qup3_spi_apps_clk
    gosub Find_Print_Clock gcc_blsp1_qup4_i2c_apps_clk
    gosub Find_Print_Clock gcc_blsp1_qup4_spi_apps_clk
    gosub Find_Print_Clock gcc_blsp1_uart0_apps_clk
    gosub Find_Print_Clock gcc_blsp1_uart1_apps_clk
    gosub Find_Print_Clock gcc_blsp1_uart2_apps_clk
    gosub Find_Print_Clock gcc_blsp1_uart3_apps_clk
    gosub Find_Print_Clock gcc_blsp2_qup0_i2c_apps_clk
    gosub Find_Print_Clock gcc_blsp2_qup0_spi_apps_clk
    gosub Find_Print_Clock gcc_blsp2_uart0_apps_clk
    gosub Find_Print_Clock gcc_blsp1_uart0_sim_clk
    gosub Find_Print_Clock gcc_blsp1_uart1_sim_clk
    gosub Find_Print_Clock gcc_blsp1_uart2_sim_clk
    gosub Find_Print_Clock gcc_blsp1_uart3_sim_clk
    gosub Find_Print_Clock gcc_blsp2_uart0_sim_clk
    gosub Find_Print_Clock gcc_mdss_byte0_clk
    gosub Find_Print_Clock gcc_bimc_cdsp_clk
    gosub Find_Print_Clock gcc_cdsp_bimc_clk
    gosub Find_Print_Clock gcc_cdsp_tbu_clk
    gosub Find_Print_Clock gcc_crypto_clk
    gosub Find_Print_Clock gcc_eth_rgmii_clk
    gosub Find_Print_Clock gcc_eth_ptp_clk
    gosub Find_Print_Clock gcc_mdss_esc0_clk
    gosub Find_Print_Clock gcc_lpass_q6ss_boot_gpll0_clk_src
    gosub Find_Print_Clock gcc_plltest_de
    gosub Find_Print_Clock gcc_bimc_sleep_clk
    gosub Find_Print_Clock gcc_blsp1_sleep_clk
    gosub Find_Print_Clock gcc_blsp2_sleep_clk
    gosub Find_Print_Clock gcc_ddr_dim_sleep_clk
    gosub Find_Print_Clock gcc_im_sleep_clk
    gosub Find_Print_Clock gcc_qpic_system_clk
    gosub Find_Print_Clock gcc_rpm_sleep_clk
    gosub Find_Print_Clock gcc_usb2a_phy_sleep_clk
    gosub Find_Print_Clock gcc_usb30_sleep_clk
    gosub Find_Print_Clock gcc_usb_hs_inactivity_timers_clk
    gosub Find_Print_Clock lpass_sleep_clk
    gosub Find_Print_Clock gcc_dcc_xo_clk
    gosub Find_Print_Clock gcc_dcd_xo_clk
    gosub Find_Print_Clock gcc_geni_ir_s_clk
    gosub Find_Print_Clock gcc_xo_clk
    gosub Find_Print_Clock gcc_xo_div4_clk
    gosub Find_Print_Clock gcc_oxili_gfx3d_clk
    gosub Find_Print_Clock gcc_gp1_clk
    gosub Find_Print_Clock gcc_gp2_clk
    gosub Find_Print_Clock gcc_gp3_clk
    gosub Find_Print_Clock gcc_mdss_hdmi_app_clk
    gosub Find_Print_Clock gcc_mdss_hdmi_pclk_clk
    gosub Find_Print_Clock gcc_bimc_lpass_clk
    gosub Find_Print_Clock gcc_lpass_agnoc_clk
    gosub Find_Print_Clock gcc_lpass_core_mport_clk
    gosub Find_Print_Clock gcc_lpass_hw_af_clk
    gosub Find_Print_Clock gcc_lpass_q6_axim_clk
    gosub Find_Print_Clock gcc_lpass_tbu_clk
    gosub Find_Print_Clock gcc_mdss_mdp_clk
    gosub Find_Print_Clock gcc_bimc_mdss_clk
    gosub Find_Print_Clock gcc_mdp_tbu_clk
    gosub Find_Print_Clock gcc_mdss_axi_clk
    gosub Find_Print_Clock gcc_pcie_0_aux_clk
    gosub Find_Print_Clock gcc_pcie_0_pipe_clk
    gosub Find_Print_Clock gcc_mdss_pclk0_clk
    gosub Find_Print_Clock gcc_ahb_clk
    gosub Find_Print_Clock gcc_bimc_cfg_ahb_clk
    gosub Find_Print_Clock gcc_blsp1_ahb_clk
    gosub Find_Print_Clock gcc_blsp2_ahb_clk
    gosub Find_Print_Clock gcc_boot_rom_ahb_clk
    gosub Find_Print_Clock gcc_cdsp_cfg_ahb_clk
    gosub Find_Print_Clock gcc_crypto_ahb_clk
    gosub Find_Print_Clock gcc_crypto_axi_clk
    gosub Find_Print_Clock gcc_dcc_clk
    gosub Find_Print_Clock gcc_eth_slave_ahb_clk
    gosub Find_Print_Clock gcc_geni_ir_h_clk
    gosub Find_Print_Clock gcc_geni_ir_xpu_clk
    gosub Find_Print_Clock gcc_gtcu_ahb_clk
    gosub Find_Print_Clock gcc_imem_cfg_ahb_clk
    gosub Find_Print_Clock gcc_lpass_agnoc_cfg_clk
    gosub Find_Print_Clock gcc_lpass_agnoc_mpu_cfg_clk
    gosub Find_Print_Clock gcc_lpass_mpu_cfg_clk
    gosub Find_Print_Clock gcc_mdss_ahb_clk
    gosub Find_Print_Clock gcc_mpm_ahb_clk
    gosub Find_Print_Clock gcc_msg_ram_ahb_clk
    gosub Find_Print_Clock gcc_noc_conf_xpu_ahb_clk
    gosub Find_Print_Clock gcc_oxili_ahb_clk
    gosub Find_Print_Clock gcc_pcie_0_cfg_ahb_clk
    gosub Find_Print_Clock gcc_pcnoc_ahb_clk
    gosub Find_Print_Clock gcc_pcnoc_bus_timeout0_ahb_clk
    gosub Find_Print_Clock gcc_pcnoc_bus_timeout1_ahb_clk
    gosub Find_Print_Clock gcc_pcnoc_bus_timeout2_ahb_clk
    gosub Find_Print_Clock gcc_pcnoc_bus_timeout3_ahb_clk
    gosub Find_Print_Clock gcc_pcnoc_bus_timeout4_ahb_clk
    gosub Find_Print_Clock gcc_pcnoc_bus_timeout6_ahb_clk
    gosub Find_Print_Clock gcc_pcnoc_bus_timeout7_ahb_clk
    gosub Find_Print_Clock gcc_pcnoc_bus_timeout8_ahb_clk
    gosub Find_Print_Clock gcc_pcnoc_bus_timeout9_ahb_clk
    gosub Find_Print_Clock gcc_pcnoc_ddr_cfg_clk
    gosub Find_Print_Clock gcc_pcnoc_east_ahb_clk
    gosub Find_Print_Clock gcc_pcnoc_mpu_cfg_ahb_clk
    gosub Find_Print_Clock gcc_pcnoc_mst_rpm_bridge_clk
    gosub Find_Print_Clock gcc_pcnoc_north_ahb_clk
    gosub Find_Print_Clock gcc_pcnoc_slv_rpm_bridge_clk
    gosub Find_Print_Clock gcc_pcnoc_south_ahb_clk
    gosub Find_Print_Clock gcc_pcnoc_tbu_clk
    gosub Find_Print_Clock gcc_pcnoc_west_ahb_clk
    gosub Find_Print_Clock gcc_pdm_ahb_clk
    gosub Find_Print_Clock gcc_prng_ahb_clk
    gosub Find_Print_Clock gcc_qdss_cfg_ahb_clk
    gosub Find_Print_Clock gcc_qdss_dap_ahb_clk
    gosub Find_Print_Clock gcc_qpic_ahb_clk
    gosub Find_Print_Clock gcc_rbcpr_ahb_clk
    gosub Find_Print_Clock gcc_rpm_cfg_xpu_clk
    gosub Find_Print_Clock gcc_sdcc1_ahb_clk
    gosub Find_Print_Clock gcc_sdcc2_ahb_clk
    gosub Find_Print_Clock gcc_sec_ctrl_ahb_clk
    gosub Find_Print_Clock gcc_sec_ctrl_boot_rom_patch_clk
    gosub Find_Print_Clock gcc_smmu_cfg_clk
    gosub Find_Print_Clock gcc_smmu_xpu_clk
    gosub Find_Print_Clock gcc_snoc_pcnoc_ahb_clk
    gosub Find_Print_Clock gcc_spdm_cfg_ahb_clk
    gosub Find_Print_Clock gcc_spdm_mstr_ahb_clk
    gosub Find_Print_Clock gcc_spdm_pcnoc_cy_clk
    gosub Find_Print_Clock gcc_spmi_pcnoc_ahb_clk
    gosub Find_Print_Clock gcc_tcsr_ahb_clk
    gosub Find_Print_Clock gcc_tic_cfg_ahb_clk
    gosub Find_Print_Clock gcc_tlmm_clk
    gosub Find_Print_Clock gcc_tlmm_east_ahb_clk
    gosub Find_Print_Clock gcc_tlmm_east_clk
    gosub Find_Print_Clock gcc_tlmm_north_ahb_clk
    gosub Find_Print_Clock gcc_tlmm_north_clk
    gosub Find_Print_Clock gcc_tlmm_south_ahb_clk
    gosub Find_Print_Clock gcc_tlmm_south_clk
    gosub Find_Print_Clock gcc_usb_hs_phy_cfg_ahb_clk
    gosub Find_Print_Clock gcc_wdsp_q6ss_ahbs_clk
    gosub Find_Print_Clock gcc_pdm_xo4_clk
    gosub Find_Print_Clock gcc_pdm2_clk
    gosub Find_Print_Clock gcc_pwm0_xo512_clk
    gosub Find_Print_Clock gcc_pwm1_xo512_clk
    gosub Find_Print_Clock gcc_pwm2_xo512_clk
    gosub Find_Print_Clock gcc_qdss_apb2jtag_clk
    gosub Find_Print_Clock gcc_qdss_dap_clk
    gosub Find_Print_Clock gcc_qdss_tsctr_clk
    gosub Find_Print_Clock gcc_wcss_apb_clk
    gosub Find_Print_Clock gcc_wcss_tsctr_clk
    gosub Find_Print_Clock gcc_lpass_at_clk
    gosub Find_Print_Clock gcc_pcnoc_at_clk
    gosub Find_Print_Clock gcc_qdss_at_clk
    gosub Find_Print_Clock gcc_sys_noc_at_clk
    gosub Find_Print_Clock gcc_wcss_at_clk
    gosub Find_Print_Clock gcc_qdss_stm_clk
    gosub Find_Print_Clock gcc_sys_noc_qdss_stm_axi_clk
    gosub Find_Print_Clock gcc_qdss_traceclkin_clk
    gosub Find_Print_Clock gcc_qdss_trig_clk
    gosub Find_Print_Clock gcc_qpic_clk
    gosub Find_Print_Clock gcc_rbcpr_clk
    gosub Find_Print_Clock gcc_rpm_bus_ahb_clk
    gosub Find_Print_Clock gcc_rpm_proc_fclk
    gosub Find_Print_Clock gcc_rpm_proc_hclk
    gosub Find_Print_Clock gcc_rpm_timer_clk
    gosub Find_Print_Clock gcc_sdcc1_apps_clk
    gosub Find_Print_Clock gcc_sdcc1_ice_core_clk
    gosub Find_Print_Clock gcc_sdcc2_apps_clk
    gosub Find_Print_Clock gcc_sec_ctrl_clk
    gosub Find_Print_Clock gcc_sec_ctrl_sense_clk
    gosub Find_Print_Clock sec_ctrl_acc_clk_src
    gosub Find_Print_Clock gcc_smmu_cats_clk
    gosub Find_Print_Clock gcc_spdm_ff_clk
    gosub Find_Print_Clock gcc_spdm_gfx3d_clk
    gosub Find_Print_Clock gcc_spdm_mdp_clk
    gosub Find_Print_Clock gcc_spdm_pclk0_clk
    gosub Find_Print_Clock gcc_spdm_rpm_cy_clk
    gosub Find_Print_Clock gcc_spmi_ahb_clk
    gosub Find_Print_Clock gcc_spmi_ser_clk
    gosub Find_Print_Clock gcc_bimc_sysnoc_axi_clk
    gosub Find_Print_Clock gcc_emac_tbu_axi_clk
    gosub Find_Print_Clock gcc_eth_axi_clk
    gosub Find_Print_Clock gcc_imem_axi_clk
    gosub Find_Print_Clock gcc_lpass_q6_axis_clk
    gosub Find_Print_Clock gcc_lpass_sway_clk
    gosub Find_Print_Clock gcc_pcie_0_mstr_axi_clk
    gosub Find_Print_Clock gcc_pcie_0_slv_axi_clk
    gosub Find_Print_Clock gcc_pcie_tbu_clk
    gosub Find_Print_Clock gcc_qdss_etr_usb_clk
    gosub Find_Print_Clock gcc_snoc_bus_timeout1_ahb_clk
    gosub Find_Print_Clock gcc_snoc_bus_timeout2_ahb_clk
    gosub Find_Print_Clock gcc_spdm_snoc_cy_clk
    gosub Find_Print_Clock gcc_sys_noc_axi_clk
    gosub Find_Print_Clock gcc_sys_noc_lpass_clk
    gosub Find_Print_Clock gcc_sys_noc_tprb_clk
    gosub Find_Print_Clock gcc_sys_noc_wcss_clk
    gosub Find_Print_Clock gcc_wcss_ahb_s0_clk
    gosub Find_Print_Clock gcc_wcss_axi_m_clk
    gosub Find_Print_Clock gcc_wcss_ecahb_clk
    gosub Find_Print_Clock gcc_wcss_shdreg_ahb_clk
    gosub Find_Print_Clock gcc_wcss_tbu_clk
    gosub Find_Print_Clock gcc_wdsp_q6ss_axim_clk
    gosub Find_Print_Clock gcc_wdsp_xpu_clk
    gosub Find_Print_Clock gcc_tic_clk
    gosub Find_Print_Clock gcc_usb20_mock_utmi_clk
    gosub Find_Print_Clock gcc_pcnoc_bus_timeout11_ahb_clk
    gosub Find_Print_Clock gcc_pcnoc_usb3_clk
    gosub Find_Print_Clock gcc_sys_noc_usb3_clk
    gosub Find_Print_Clock gcc_usb30_master_clk
    gosub Find_Print_Clock gcc_usb3_tbu_axi_clk
    gosub Find_Print_Clock gcc_usb30_mock_utmi_clk
    gosub Find_Print_Clock gcc_usb30_phy_pipe_clk
    gosub Find_Print_Clock usb30_phy_pipe_clk_src
    gosub Find_Print_Clock gcc_usb3_phy_aux_clk
    gosub Find_Print_Clock gcc_pcnoc_bus_timeout10_ahb_clk
    gosub Find_Print_Clock gcc_pcnoc_usb2_clk
    gosub Find_Print_Clock gcc_usb_hs_system_clk
    gosub Find_Print_Clock gcc_mdss_vsync_clk
    gosub Find_Print_Clock gcc_wdsp_q6ss_aon_clk
    gosub Find_Print_Clock gcc_wdsp_q6ss_qos_clk
    gosub Find_Print_Clock apss_gcc_dbg_clk
    gosub Find_Print_Clock apss_gcc_ringosc_clk
    gosub Find_Print_Clock bimc_pll_dtest
    gosub Find_Print_Clock bimc_pll_lock_det
    gosub Find_Print_Clock gpll0_dtest
    gosub Find_Print_Clock gpll0_lock_det
    gosub Find_Print_Clock gpll3_dtest
    gosub Find_Print_Clock gpll3_lock_det
    gosub Find_Print_Clock gpll4_dtest
    gosub Find_Print_Clock gpll4_lock_det
    gosub Find_Print_Clock gpll5_dtest
    gosub Find_Print_Clock gpll5_lock_det
    gosub Find_Print_Clock gpll6_dtest
    gosub Find_Print_Clock gpll6_lock_det
    gosub Find_Print_Clock lpass_gcc_dbg_clk
    gosub Find_Print_Clock mpm_gcc_temp_sensor_ringosc_clk
    gosub Find_Print_Clock pcie_0_pipe_clk
    gosub Find_Print_Clock usb2_phy_gcc_atest_ulpi_0_clk
    gosub Find_Print_Clock usb2_phy_gcc_atest_ulpi_1_clk
    gosub Find_Print_Clock wcss_gcc_dbg_clk
    return 1.
  )

  return 0.
)


;-----------------------------------------------------------------------------
; Find clocks that match what the user entered and print their information 
;-----------------------------------------------------------------------------

Find_Print_Clock:

ENTRY &clk

&clk_test=0
&clk_reg=0
&clk_reg_name=""

  &match=0
  &wild_head=0
  &wild_tail=0
  &clk_input_length=STRING.LENGTH("&clk")
  &clk_itr_length=STRING.LENGTH("apc0_sysleaf_clk")

  if (STRING.SCAN("&clk", "*", 0)==0)
  (
    &wild_head=1
  )
  if (STRING.SCAN("&clk", "*", 1)==(STRING.LENGTH("&clk")-1))
  (
    &wild_tail=1
  )

  if ((&wild_head==1)&&(&wild_tail==1))
  (
    if (STRING.SCAN("apc0_sysleaf_clk", STRING.MID("&clk", 1, &clk_input_length-2), 0)!=-1)
    ( 
      &match=1
    )
  )
  else if (&wild_head==1)
  (
    if (STRING.MID("apc0_sysleaf_clk", &clk_itr_length-&clk_input_length+1, &clk_input_length-1)==STRING.CUT("&clk", 1))
    ( 
      &match=1
    )
  )
  else if (&wild_tail==1)
  (
    if (STRING.MID("apc0_sysleaf_clk", 0, &clk_input_length-1)==STRING.CUT("&clk", -1))
    ( 
      &match=1
    )
  )
  else if ("apc0_sysleaf_clk"=="&clk")||("cpus"=="&clk")
  (
    &match=1
  )
  
  if (&match==1)
  (
    &clk_test=&CLK_TEST_APC0_SYSLEAF_CLK
    &clk_reg=0
    &clk_reg_name="No CBCR"
    &clk_name="apc0_sysleaf_clk"
    &clk_reg_cbcr_type=""
    &clk_vote_bit=-1.
    &clk_multiplier=4.
    &clk_access_mode="&APCS_access_mode"

    gosub Print_Clk_Info_Line
  )

  &match=0
  &wild_head=0
  &wild_tail=0
  &clk_input_length=STRING.LENGTH("&clk")
  &clk_itr_length=STRING.LENGTH("apc1_sysleaf_clk")

  if (STRING.SCAN("&clk", "*", 0)==0)
  (
    &wild_head=1
  )
  if (STRING.SCAN("&clk", "*", 1)==(STRING.LENGTH("&clk")-1))
  (
    &wild_tail=1
  )

  if ((&wild_head==1)&&(&wild_tail==1))
  (
    if (STRING.SCAN("apc1_sysleaf_clk", STRING.MID("&clk", 1, &clk_input_length-2), 0)!=-1)
    ( 
      &match=1
    )
  )
  else if (&wild_head==1)
  (
    if (STRING.MID("apc1_sysleaf_clk", &clk_itr_length-&clk_input_length+1, &clk_input_length-1)==STRING.CUT("&clk", 1))
    ( 
      &match=1
    )
  )
  else if (&wild_tail==1)
  (
    if (STRING.MID("apc1_sysleaf_clk", 0, &clk_input_length-1)==STRING.CUT("&clk", -1))
    ( 
      &match=1
    )
  )
  else if ("apc1_sysleaf_clk"=="&clk")||("cpus"=="&clk")
  (
    &match=1
  )
  
  if (&match==1)
  (
    &clk_test=&CLK_TEST_APC1_SYSLEAF_CLK
    &clk_reg=0
    &clk_reg_name="No CBCR"
    &clk_name="apc1_sysleaf_clk"
    &clk_reg_cbcr_type=""
    &clk_vote_bit=-1.
    &clk_multiplier=4.
    &clk_access_mode="&APCS_access_mode"

    gosub Print_Clk_Info_Line
  )

  &match=0
  &wild_head=0
  &wild_tail=0
  &clk_input_length=STRING.LENGTH("&clk")
  &clk_itr_length=STRING.LENGTH("apc2_sysleaf_clk")

  if (STRING.SCAN("&clk", "*", 0)==0)
  (
    &wild_head=1
  )
  if (STRING.SCAN("&clk", "*", 1)==(STRING.LENGTH("&clk")-1))
  (
    &wild_tail=1
  )

  if ((&wild_head==1)&&(&wild_tail==1))
  (
    if (STRING.SCAN("apc2_sysleaf_clk", STRING.MID("&clk", 1, &clk_input_length-2), 0)!=-1)
    ( 
      &match=1
    )
  )
  else if (&wild_head==1)
  (
    if (STRING.MID("apc2_sysleaf_clk", &clk_itr_length-&clk_input_length+1, &clk_input_length-1)==STRING.CUT("&clk", 1))
    ( 
      &match=1
    )
  )
  else if (&wild_tail==1)
  (
    if (STRING.MID("apc2_sysleaf_clk", 0, &clk_input_length-1)==STRING.CUT("&clk", -1))
    ( 
      &match=1
    )
  )
  else if ("apc2_sysleaf_clk"=="&clk")
  (
    &match=1
  )
  
  if (&match==1)
  (
    &clk_test=&CLK_TEST_APC2_SYSLEAF_CLK
    &clk_reg=0
    &clk_reg_name="No CBCR"
    &clk_name="apc2_sysleaf_clk"
    &clk_reg_cbcr_type=""
    &clk_vote_bit=-1.
    &clk_multiplier=4.
    &clk_access_mode="&APCS_access_mode"

    gosub Print_Clk_Info_Line
  )

  &match=0
  &wild_head=0
  &wild_tail=0
  &clk_input_length=STRING.LENGTH("&clk")
  &clk_itr_length=STRING.LENGTH("apc3_sysleaf_clk")

  if (STRING.SCAN("&clk", "*", 0)==0)
  (
    &wild_head=1
  )
  if (STRING.SCAN("&clk", "*", 1)==(STRING.LENGTH("&clk")-1))
  (
    &wild_tail=1
  )

  if ((&wild_head==1)&&(&wild_tail==1))
  (
    if (STRING.SCAN("apc3_sysleaf_clk", STRING.MID("&clk", 1, &clk_input_length-2), 0)!=-1)
    ( 
      &match=1
    )
  )
  else if (&wild_head==1)
  (
    if (STRING.MID("apc3_sysleaf_clk", &clk_itr_length-&clk_input_length+1, &clk_input_length-1)==STRING.CUT("&clk", 1))
    ( 
      &match=1
    )
  )
  else if (&wild_tail==1)
  (
    if (STRING.MID("apc3_sysleaf_clk", 0, &clk_input_length-1)==STRING.CUT("&clk", -1))
    ( 
      &match=1
    )
  )
  else if ("apc3_sysleaf_clk"=="&clk")
  (
    &match=1
  )
  
  if (&match==1)
  (
    &clk_test=&CLK_TEST_APC3_SYSLEAF_CLK
    &clk_reg=0
    &clk_reg_name="No CBCR"
    &clk_name="apc3_sysleaf_clk"
    &clk_reg_cbcr_type=""
    &clk_vote_bit=-1.
    &clk_multiplier=4.
    &clk_access_mode="&APCS_access_mode"

    gosub Print_Clk_Info_Line
  )

  &match=0
  &wild_head=0
  &wild_tail=0
  &clk_input_length=STRING.LENGTH("&clk")
  &clk_itr_length=STRING.LENGTH("apc_l2_sysleaf_clk")

  if (STRING.SCAN("&clk", "*", 0)==0)
  (
    &wild_head=1
  )
  if (STRING.SCAN("&clk", "*", 1)==(STRING.LENGTH("&clk")-1))
  (
    &wild_tail=1
  )

  if ((&wild_head==1)&&(&wild_tail==1))
  (
    if (STRING.SCAN("apc_l2_sysleaf_clk", STRING.MID("&clk", 1, &clk_input_length-2), 0)!=-1)
    ( 
      &match=1
    )
  )
  else if (&wild_head==1)
  (
    if (STRING.MID("apc_l2_sysleaf_clk", &clk_itr_length-&clk_input_length+1, &clk_input_length-1)==STRING.CUT("&clk", 1))
    ( 
      &match=1
    )
  )
  else if (&wild_tail==1)
  (
    if (STRING.MID("apc_l2_sysleaf_clk", 0, &clk_input_length-1)==STRING.CUT("&clk", -1))
    ( 
      &match=1
    )
  )
  else if ("apc_l2_sysleaf_clk"=="&clk")
  (
    &match=1
  )
  
  if (&match==1)
  (
    &clk_test=&CLK_TEST_APC_L2_SYSLEAF_CLK
    &clk_reg=0
    &clk_reg_name="No CBCR"
    &clk_name="apc_l2_sysleaf_clk"
    &clk_reg_cbcr_type=""
    &clk_vote_bit=-1.
    &clk_multiplier=4.
    &clk_access_mode="&APCS_access_mode"

    gosub Print_Clk_Info_Line
  )

  &match=0
  &wild_head=0
  &wild_tail=0
  &clk_input_length=STRING.LENGTH("&clk")
  &clk_itr_length=STRING.LENGTH("im_sleep_clk")

  if (STRING.SCAN("&clk", "*", 0)==0)
  (
    &wild_head=1
  )
  if (STRING.SCAN("&clk", "*", 1)==(STRING.LENGTH("&clk")-1))
  (
    &wild_tail=1
  )

  if ((&wild_head==1)&&(&wild_tail==1))
  (
    if (STRING.SCAN("im_sleep_clk", STRING.MID("&clk", 1, &clk_input_length-2), 0)!=-1)
    ( 
      &match=1
    )
  )
  else if (&wild_head==1)
  (
    if (STRING.MID("im_sleep_clk", &clk_itr_length-&clk_input_length+1, &clk_input_length-1)==STRING.CUT("&clk", 1))
    ( 
      &match=1
    )
  )
  else if (&wild_tail==1)
  (
    if (STRING.MID("im_sleep_clk", 0, &clk_input_length-1)==STRING.CUT("&clk", -1))
    ( 
      &match=1
    )
  )
  else if ("im_sleep_clk"=="&clk")
  (
    &match=1
  )
  
  if (&match==1)
  (
    &clk_test=&CLK_TEST_IM_SLEEP_CLK
    &clk_reg=0
    &clk_reg_name="No CBCR"
    &clk_name="im_sleep_clk"
    &clk_reg_cbcr_type=""
    &clk_vote_bit=-1.
    &clk_multiplier=4.
    &clk_access_mode="&APCS_access_mode"

    gosub Print_Clk_Info_Line
  )

  &match=0
  &wild_head=0
  &wild_tail=0
  &clk_input_length=STRING.LENGTH("&clk")
  &clk_itr_length=STRING.LENGTH("im_ref_clk")

  if (STRING.SCAN("&clk", "*", 0)==0)
  (
    &wild_head=1
  )
  if (STRING.SCAN("&clk", "*", 1)==(STRING.LENGTH("&clk")-1))
  (
    &wild_tail=1
  )

  if ((&wild_head==1)&&(&wild_tail==1))
  (
    if (STRING.SCAN("im_ref_clk", STRING.MID("&clk", 1, &clk_input_length-2), 0)!=-1)
    ( 
      &match=1
    )
  )
  else if (&wild_head==1)
  (
    if (STRING.MID("im_ref_clk", &clk_itr_length-&clk_input_length+1, &clk_input_length-1)==STRING.CUT("&clk", 1))
    ( 
      &match=1
    )
  )
  else if (&wild_tail==1)
  (
    if (STRING.MID("im_ref_clk", 0, &clk_input_length-1)==STRING.CUT("&clk", -1))
    ( 
      &match=1
    )
  )
  else if ("im_ref_clk"=="&clk")
  (
    &match=1
  )
  
  if (&match==1)
  (
    &clk_test=&CLK_TEST_IM_REF_CLK
    &clk_reg=0
    &clk_reg_name="No CBCR"
    &clk_name="im_ref_clk"
    &clk_reg_cbcr_type=""
    &clk_vote_bit=-1.
    &clk_multiplier=4.
    &clk_access_mode="&APCS_access_mode"

    gosub Print_Clk_Info_Line
  )

  &match=0
  &wild_head=0
  &wild_tail=0
  &clk_input_length=STRING.LENGTH("&clk")
  &clk_itr_length=STRING.LENGTH("sys_apcsqsb_clk")

  if (STRING.SCAN("&clk", "*", 0)==0)
  (
    &wild_head=1
  )
  if (STRING.SCAN("&clk", "*", 1)==(STRING.LENGTH("&clk")-1))
  (
    &wild_tail=1
  )

  if ((&wild_head==1)&&(&wild_tail==1))
  (
    if (STRING.SCAN("sys_apcsqsb_clk", STRING.MID("&clk", 1, &clk_input_length-2), 0)!=-1)
    ( 
      &match=1
    )
  )
  else if (&wild_head==1)
  (
    if (STRING.MID("sys_apcsqsb_clk", &clk_itr_length-&clk_input_length+1, &clk_input_length-1)==STRING.CUT("&clk", 1))
    ( 
      &match=1
    )
  )
  else if (&wild_tail==1)
  (
    if (STRING.MID("sys_apcsqsb_clk", 0, &clk_input_length-1)==STRING.CUT("&clk", -1))
    ( 
      &match=1
    )
  )
  else if ("sys_apcsqsb_clk"=="&clk")
  (
    &match=1
  )
  
  if (&match==1)
  (
    &clk_test=&CLK_TEST_SYS_APCSQSB_CLK
    &clk_reg=0
    &clk_reg_name="No CBCR"
    &clk_name="sys_apcsqsb_clk"
    &clk_reg_cbcr_type=""
    &clk_vote_bit=-1.
    &clk_multiplier=4.
    &clk_access_mode="&APCS_access_mode"

    gosub Print_Clk_Info_Line
  )

  &match=0
  &wild_head=0
  &wild_tail=0
  &clk_input_length=STRING.LENGTH("&clk")
  &clk_itr_length=STRING.LENGTH("apcs_hdcd_ahb_gated_clk")

  if (STRING.SCAN("&clk", "*", 0)==0)
  (
    &wild_head=1
  )
  if (STRING.SCAN("&clk", "*", 1)==(STRING.LENGTH("&clk")-1))
  (
    &wild_tail=1
  )

  if ((&wild_head==1)&&(&wild_tail==1))
  (
    if (STRING.SCAN("apcs_hdcd_ahb_gated_clk", STRING.MID("&clk", 1, &clk_input_length-2), 0)!=-1)
    ( 
      &match=1
    )
  )
  else if (&wild_head==1)
  (
    if (STRING.MID("apcs_hdcd_ahb_gated_clk", &clk_itr_length-&clk_input_length+1, &clk_input_length-1)==STRING.CUT("&clk", 1))
    ( 
      &match=1
    )
  )
  else if (&wild_tail==1)
  (
    if (STRING.MID("apcs_hdcd_ahb_gated_clk", 0, &clk_input_length-1)==STRING.CUT("&clk", -1))
    ( 
      &match=1
    )
  )
  else if ("apcs_hdcd_ahb_gated_clk"=="&clk")
  (
    &match=1
  )
  
  if (&match==1)
  (
    &clk_test=&CLK_TEST_APCS_HDCD_AHB_GATED_CLK
    &clk_reg=0
    &clk_reg_name="No CBCR"
    &clk_name="apcs_hdcd_ahb_gated_clk"
    &clk_reg_cbcr_type=""
    &clk_vote_bit=-1.
    &clk_multiplier=4.
    &clk_access_mode="&APCS_access_mode"

    gosub Print_Clk_Info_Line
  )

  &match=0
  &wild_head=0
  &wild_tail=0
  &clk_input_length=STRING.LENGTH("&clk")
  &clk_itr_length=STRING.LENGTH("gcc_sec_ctrl_acc_clk")

  if (STRING.SCAN("&clk", "*", 0)==0)
  (
    &wild_head=1
  )
  if (STRING.SCAN("&clk", "*", 1)==(STRING.LENGTH("&clk")-1))
  (
    &wild_tail=1
  )

  if ((&wild_head==1)&&(&wild_tail==1))
  (
    if (STRING.SCAN("gcc_sec_ctrl_acc_clk", STRING.MID("&clk", 1, &clk_input_length-2), 0)!=-1)
    ( 
      &match=1
    )
  )
  else if (&wild_head==1)
  (
    if (STRING.MID("gcc_sec_ctrl_acc_clk", &clk_itr_length-&clk_input_length+1, &clk_input_length-1)==STRING.CUT("&clk", 1))
    ( 
      &match=1
    )
  )
  else if (&wild_tail==1)
  (
    if (STRING.MID("gcc_sec_ctrl_acc_clk", 0, &clk_input_length-1)==STRING.CUT("&clk", -1))
    ( 
      &match=1
    )
  )
  else if ("gcc_sec_ctrl_acc_clk"=="&clk")
  (
    &match=1
  )
  
  if (&match==1)
  (
    &clk_test=&CLK_TEST_GCC_SEC_CTRL_ACC_CLK
    &clk_reg=&HWIO_GCC_SEC_CTRL_ACC_CBCR_ADDR
    &clk_reg_name="GCC_SEC_CTRL_ACC_CBCR"
    &clk_name="gcc_sec_ctrl_acc_clk"
    &clk_reg_cbcr_type="sm_pscbc"
    &clk_vote_bit=-1.
    &clk_multiplier=4.
    &clk_access_mode="&GCC_access_mode"

    gosub Print_Clk_Info_Line
  )

  &match=0
  &wild_head=0
  &wild_tail=0
  &clk_input_length=STRING.LENGTH("&clk")
  &clk_itr_length=STRING.LENGTH("gcc_apss_ahb_clk")

  if (STRING.SCAN("&clk", "*", 0)==0)
  (
    &wild_head=1
  )
  if (STRING.SCAN("&clk", "*", 1)==(STRING.LENGTH("&clk")-1))
  (
    &wild_tail=1
  )

  if ((&wild_head==1)&&(&wild_tail==1))
  (
    if (STRING.SCAN("gcc_apss_ahb_clk", STRING.MID("&clk", 1, &clk_input_length-2), 0)!=-1)
    ( 
      &match=1
    )
  )
  else if (&wild_head==1)
  (
    if (STRING.MID("gcc_apss_ahb_clk", &clk_itr_length-&clk_input_length+1, &clk_input_length-1)==STRING.CUT("&clk", 1))
    ( 
      &match=1
    )
  )
  else if (&wild_tail==1)
  (
    if (STRING.MID("gcc_apss_ahb_clk", 0, &clk_input_length-1)==STRING.CUT("&clk", -1))
    ( 
      &match=1
    )
  )
  else if ("gcc_apss_ahb_clk"=="&clk")
  (
    &match=1
  )
  
  if (&match==1)
  (
    &clk_test=&CLK_TEST_GCC_APSS_AHB_CLK
    &clk_reg=&HWIO_GCC_APSS_AHB_CBCR_ADDR
    &clk_reg_name="GCC_APSS_AHB_CBCR"
    &clk_name="gcc_apss_ahb_clk"
    &clk_reg_cbcr_type="sm_cbc"
    &clk_vote_bit=14.
    &clk_multiplier=4.
    &clk_access_mode="&GCC_access_mode"

    gosub Print_Clk_Info_Line
  )

  &match=0
  &wild_head=0
  &wild_tail=0
  &clk_input_length=STRING.LENGTH("&clk")
  &clk_itr_length=STRING.LENGTH("gcc_snoc_bus_timeout0_ahb_clk")

  if (STRING.SCAN("&clk", "*", 0)==0)
  (
    &wild_head=1
  )
  if (STRING.SCAN("&clk", "*", 1)==(STRING.LENGTH("&clk")-1))
  (
    &wild_tail=1
  )

  if ((&wild_head==1)&&(&wild_tail==1))
  (
    if (STRING.SCAN("gcc_snoc_bus_timeout0_ahb_clk", STRING.MID("&clk", 1, &clk_input_length-2), 0)!=-1)
    ( 
      &match=1
    )
  )
  else if (&wild_head==1)
  (
    if (STRING.MID("gcc_snoc_bus_timeout0_ahb_clk", &clk_itr_length-&clk_input_length+1, &clk_input_length-1)==STRING.CUT("&clk", 1))
    ( 
      &match=1
    )
  )
  else if (&wild_tail==1)
  (
    if (STRING.MID("gcc_snoc_bus_timeout0_ahb_clk", 0, &clk_input_length-1)==STRING.CUT("&clk", -1))
    ( 
      &match=1
    )
  )
  else if ("gcc_snoc_bus_timeout0_ahb_clk"=="&clk")
  (
    &match=1
  )
  
  if (&match==1)
  (
    &clk_test=&CLK_TEST_GCC_SNOC_BUS_TIMEOUT0_AHB_CLK
    &clk_reg=&HWIO_GCC_SNOC_BUS_TIMEOUT0_AHB_CBCR_ADDR
    &clk_reg_name="GCC_SNOC_BUS_TIMEOUT0_AHB_CBCR"
    &clk_name="gcc_snoc_bus_timeout0_ahb_clk"
    &clk_reg_cbcr_type="sm_cbc"
    &clk_vote_bit=-1.
    &clk_multiplier=4.
    &clk_access_mode="&GCC_access_mode"

    gosub Print_Clk_Info_Line
  )

  &match=0
  &wild_head=0
  &wild_tail=0
  &clk_input_length=STRING.LENGTH("&clk")
  &clk_itr_length=STRING.LENGTH("gcc_sys_noc_apss_ahb_clk")

  if (STRING.SCAN("&clk", "*", 0)==0)
  (
    &wild_head=1
  )
  if (STRING.SCAN("&clk", "*", 1)==(STRING.LENGTH("&clk")-1))
  (
    &wild_tail=1
  )

  if ((&wild_head==1)&&(&wild_tail==1))
  (
    if (STRING.SCAN("gcc_sys_noc_apss_ahb_clk", STRING.MID("&clk", 1, &clk_input_length-2), 0)!=-1)
    ( 
      &match=1
    )
  )
  else if (&wild_head==1)
  (
    if (STRING.MID("gcc_sys_noc_apss_ahb_clk", &clk_itr_length-&clk_input_length+1, &clk_input_length-1)==STRING.CUT("&clk", 1))
    ( 
      &match=1
    )
  )
  else if (&wild_tail==1)
  (
    if (STRING.MID("gcc_sys_noc_apss_ahb_clk", 0, &clk_input_length-1)==STRING.CUT("&clk", -1))
    ( 
      &match=1
    )
  )
  else if ("gcc_sys_noc_apss_ahb_clk"=="&clk")
  (
    &match=1
  )
  
  if (&match==1)
  (
    &clk_test=&CLK_TEST_GCC_SYS_NOC_APSS_AHB_CLK
    &clk_reg=&HWIO_GCC_SYS_NOC_APSS_AHB_CBCR_ADDR
    &clk_reg_name="GCC_SYS_NOC_APSS_AHB_CBCR"
    &clk_name="gcc_sys_noc_apss_ahb_clk"
    &clk_reg_cbcr_type="sm_cbc"
    &clk_vote_bit=16.
    &clk_multiplier=4.
    &clk_access_mode="&GCC_access_mode"

    gosub Print_Clk_Info_Line
  )

  &match=0
  &wild_head=0
  &wild_tail=0
  &clk_input_length=STRING.LENGTH("&clk")
  &clk_itr_length=STRING.LENGTH("gcc_apss_axi_clk")

  if (STRING.SCAN("&clk", "*", 0)==0)
  (
    &wild_head=1
  )
  if (STRING.SCAN("&clk", "*", 1)==(STRING.LENGTH("&clk")-1))
  (
    &wild_tail=1
  )

  if ((&wild_head==1)&&(&wild_tail==1))
  (
    if (STRING.SCAN("gcc_apss_axi_clk", STRING.MID("&clk", 1, &clk_input_length-2), 0)!=-1)
    ( 
      &match=1
    )
  )
  else if (&wild_head==1)
  (
    if (STRING.MID("gcc_apss_axi_clk", &clk_itr_length-&clk_input_length+1, &clk_input_length-1)==STRING.CUT("&clk", 1))
    ( 
      &match=1
    )
  )
  else if (&wild_tail==1)
  (
    if (STRING.MID("gcc_apss_axi_clk", 0, &clk_input_length-1)==STRING.CUT("&clk", -1))
    ( 
      &match=1
    )
  )
  else if ("gcc_apss_axi_clk"=="&clk")
  (
    &match=1
  )
  
  if (&match==1)
  (
    &clk_test=&CLK_TEST_GCC_APSS_AXI_CLK
    &clk_reg=&HWIO_GCC_APSS_AXI_CBCR_ADDR
    &clk_reg_name="GCC_APSS_AXI_CBCR"
    &clk_name="gcc_apss_axi_clk"
    &clk_reg_cbcr_type="sm_cbc"
    &clk_vote_bit=13.
    &clk_multiplier=4.
    &clk_access_mode="&GCC_access_mode"

    gosub Print_Clk_Info_Line
  )

  &match=0
  &wild_head=0
  &wild_tail=0
  &clk_input_length=STRING.LENGTH("&clk")
  &clk_itr_length=STRING.LENGTH("gcc_bimc_apss_axi_clk")

  if (STRING.SCAN("&clk", "*", 0)==0)
  (
    &wild_head=1
  )
  if (STRING.SCAN("&clk", "*", 1)==(STRING.LENGTH("&clk")-1))
  (
    &wild_tail=1
  )

  if ((&wild_head==1)&&(&wild_tail==1))
  (
    if (STRING.SCAN("gcc_bimc_apss_axi_clk", STRING.MID("&clk", 1, &clk_input_length-2), 0)!=-1)
    ( 
      &match=1
    )
  )
  else if (&wild_head==1)
  (
    if (STRING.MID("gcc_bimc_apss_axi_clk", &clk_itr_length-&clk_input_length+1, &clk_input_length-1)==STRING.CUT("&clk", 1))
    ( 
      &match=1
    )
  )
  else if (&wild_tail==1)
  (
    if (STRING.MID("gcc_bimc_apss_axi_clk", 0, &clk_input_length-1)==STRING.CUT("&clk", -1))
    ( 
      &match=1
    )
  )
  else if ("gcc_bimc_apss_axi_clk"=="&clk")
  (
    &match=1
  )
  
  if (&match==1)
  (
    &clk_test=&CLK_TEST_GCC_BIMC_APSS_AXI_CLK
    &clk_reg=&HWIO_GCC_BIMC_APSS_AXI_CBCR_ADDR
    &clk_reg_name="GCC_BIMC_APSS_AXI_CBCR"
    &clk_name="gcc_bimc_apss_axi_clk"
    &clk_reg_cbcr_type="sm_cbc"
    &clk_vote_bit=15.
    &clk_multiplier=4.
    &clk_access_mode="&GCC_access_mode"

    gosub Print_Clk_Info_Line
  )

  &match=0
  &wild_head=0
  &wild_tail=0
  &clk_input_length=STRING.LENGTH("&clk")
  &clk_itr_length=STRING.LENGTH("gcc_apss_tcu_async_clk")

  if (STRING.SCAN("&clk", "*", 0)==0)
  (
    &wild_head=1
  )
  if (STRING.SCAN("&clk", "*", 1)==(STRING.LENGTH("&clk")-1))
  (
    &wild_tail=1
  )

  if ((&wild_head==1)&&(&wild_tail==1))
  (
    if (STRING.SCAN("gcc_apss_tcu_async_clk", STRING.MID("&clk", 1, &clk_input_length-2), 0)!=-1)
    ( 
      &match=1
    )
  )
  else if (&wild_head==1)
  (
    if (STRING.MID("gcc_apss_tcu_async_clk", &clk_itr_length-&clk_input_length+1, &clk_input_length-1)==STRING.CUT("&clk", 1))
    ( 
      &match=1
    )
  )
  else if (&wild_tail==1)
  (
    if (STRING.MID("gcc_apss_tcu_async_clk", 0, &clk_input_length-1)==STRING.CUT("&clk", -1))
    ( 
      &match=1
    )
  )
  else if ("gcc_apss_tcu_async_clk"=="&clk")
  (
    &match=1
  )
  
  if (&match==1)
  (
    &clk_test=&CLK_TEST_GCC_APSS_TCU_ASYNC_CLK
    &clk_reg=&HWIO_GCC_APSS_TCU_ASYNC_CBCR_ADDR
    &clk_reg_name="GCC_APSS_TCU_ASYNC_CBCR"
    &clk_name="gcc_apss_tcu_async_clk"
    &clk_reg_cbcr_type="sm_pscbc"
    &clk_vote_bit=1.
    &clk_multiplier=4.
    &clk_access_mode="&GCC_access_mode"

    gosub Print_Clk_Info_Line
  )

  &match=0
  &wild_head=0
  &wild_tail=0
  &clk_input_length=STRING.LENGTH("&clk")
  &clk_itr_length=STRING.LENGTH("gcc_bimc_apss_tcu_clk")

  if (STRING.SCAN("&clk", "*", 0)==0)
  (
    &wild_head=1
  )
  if (STRING.SCAN("&clk", "*", 1)==(STRING.LENGTH("&clk")-1))
  (
    &wild_tail=1
  )

  if ((&wild_head==1)&&(&wild_tail==1))
  (
    if (STRING.SCAN("gcc_bimc_apss_tcu_clk", STRING.MID("&clk", 1, &clk_input_length-2), 0)!=-1)
    ( 
      &match=1
    )
  )
  else if (&wild_head==1)
  (
    if (STRING.MID("gcc_bimc_apss_tcu_clk", &clk_itr_length-&clk_input_length+1, &clk_input_length-1)==STRING.CUT("&clk", 1))
    ( 
      &match=1
    )
  )
  else if (&wild_tail==1)
  (
    if (STRING.MID("gcc_bimc_apss_tcu_clk", 0, &clk_input_length-1)==STRING.CUT("&clk", -1))
    ( 
      &match=1
    )
  )
  else if ("gcc_bimc_apss_tcu_clk"=="&clk")
  (
    &match=1
  )
  
  if (&match==1)
  (
    &clk_test=&CLK_TEST_GCC_BIMC_APSS_TCU_CLK
    &clk_reg=&HWIO_GCC_BIMC_APSS_TCU_CBCR_ADDR
    &clk_reg_name="GCC_BIMC_APSS_TCU_CBCR"
    &clk_name="gcc_bimc_apss_tcu_clk"
    &clk_reg_cbcr_type="sm_cbc"
    &clk_vote_bit=1.
    &clk_multiplier=4.
    &clk_access_mode="&GCC_access_mode"

    gosub Print_Clk_Info_Line
  )

  &match=0
  &wild_head=0
  &wild_tail=0
  &clk_input_length=STRING.LENGTH("&clk")
  &clk_itr_length=STRING.LENGTH("gcc_bimc_clk")

  if (STRING.SCAN("&clk", "*", 0)==0)
  (
    &wild_head=1
  )
  if (STRING.SCAN("&clk", "*", 1)==(STRING.LENGTH("&clk")-1))
  (
    &wild_tail=1
  )

  if ((&wild_head==1)&&(&wild_tail==1))
  (
    if (STRING.SCAN("gcc_bimc_clk", STRING.MID("&clk", 1, &clk_input_length-2), 0)!=-1)
    ( 
      &match=1
    )
  )
  else if (&wild_head==1)
  (
    if (STRING.MID("gcc_bimc_clk", &clk_itr_length-&clk_input_length+1, &clk_input_length-1)==STRING.CUT("&clk", 1))
    ( 
      &match=1
    )
  )
  else if (&wild_tail==1)
  (
    if (STRING.MID("gcc_bimc_clk", 0, &clk_input_length-1)==STRING.CUT("&clk", -1))
    ( 
      &match=1
    )
  )
  else if ("gcc_bimc_clk"=="&clk")
  (
    &match=1
  )
  
  if (&match==1)
  (
    &clk_test=&CLK_TEST_GCC_BIMC_CLK
    &clk_reg=&HWIO_GCC_BIMC_CBCR_ADDR
    &clk_reg_name="GCC_BIMC_CBCR"
    &clk_name="gcc_bimc_clk"
    &clk_reg_cbcr_type="sm_cbc"
    &clk_vote_bit=-1.
    &clk_multiplier=4.
    &clk_access_mode="&GCC_access_mode"

    gosub Print_Clk_Info_Line
  )

  &match=0
  &wild_head=0
  &wild_tail=0
  &clk_input_length=STRING.LENGTH("&clk")
  &clk_itr_length=STRING.LENGTH("gcc_debug_mux")

  if (STRING.SCAN("&clk", "*", 0)==0)
  (
    &wild_head=1
  )
  if (STRING.SCAN("&clk", "*", 1)==(STRING.LENGTH("&clk")-1))
  (
    &wild_tail=1
  )

  if ((&wild_head==1)&&(&wild_tail==1))
  (
    if (STRING.SCAN("gcc_debug_mux", STRING.MID("&clk", 1, &clk_input_length-2), 0)!=-1)
    ( 
      &match=1
    )
  )
  else if (&wild_head==1)
  (
    if (STRING.MID("gcc_debug_mux", &clk_itr_length-&clk_input_length+1, &clk_input_length-1)==STRING.CUT("&clk", 1))
    ( 
      &match=1
    )
  )
  else if (&wild_tail==1)
  (
    if (STRING.MID("gcc_debug_mux", 0, &clk_input_length-1)==STRING.CUT("&clk", -1))
    ( 
      &match=1
    )
  )
  else if ("gcc_debug_mux"=="&clk")
  (
    &match=1
  )
  
  if (&match==1)
  (
    &clk_test=0
    &clk_reg=0
    &clk_reg_name="No CBCR"
    &clk_name="gcc_debug_mux"
    &clk_reg_cbcr_type=""
    &clk_vote_bit=-1.
    &clk_multiplier=4.
    &clk_access_mode="&GCC_access_mode"

    gosub Print_Clk_Info_Line
  )

  &match=0
  &wild_head=0
  &wild_tail=0
  &clk_input_length=STRING.LENGTH("&clk")
  &clk_itr_length=STRING.LENGTH("gcc_spdm_bimc_cy_clk")

  if (STRING.SCAN("&clk", "*", 0)==0)
  (
    &wild_head=1
  )
  if (STRING.SCAN("&clk", "*", 1)==(STRING.LENGTH("&clk")-1))
  (
    &wild_tail=1
  )

  if ((&wild_head==1)&&(&wild_tail==1))
  (
    if (STRING.SCAN("gcc_spdm_bimc_cy_clk", STRING.MID("&clk", 1, &clk_input_length-2), 0)!=-1)
    ( 
      &match=1
    )
  )
  else if (&wild_head==1)
  (
    if (STRING.MID("gcc_spdm_bimc_cy_clk", &clk_itr_length-&clk_input_length+1, &clk_input_length-1)==STRING.CUT("&clk", 1))
    ( 
      &match=1
    )
  )
  else if (&wild_tail==1)
  (
    if (STRING.MID("gcc_spdm_bimc_cy_clk", 0, &clk_input_length-1)==STRING.CUT("&clk", -1))
    ( 
      &match=1
    )
  )
  else if ("gcc_spdm_bimc_cy_clk"=="&clk")
  (
    &match=1
  )
  
  if (&match==1)
  (
    &clk_test=&CLK_TEST_GCC_SPDM_BIMC_CY_CLK
    &clk_reg=&HWIO_GCC_SPDM_BIMC_CY_CBCR_ADDR
    &clk_reg_name="GCC_SPDM_BIMC_CY_CBCR"
    &clk_name="gcc_spdm_bimc_cy_clk"
    &clk_reg_cbcr_type="sm_cbc"
    &clk_vote_bit=-1.
    &clk_multiplier=4.
    &clk_access_mode="&GCC_access_mode"

    gosub Print_Clk_Info_Line
  )

  &match=0
  &wild_head=0
  &wild_tail=0
  &clk_input_length=STRING.LENGTH("&clk")
  &clk_itr_length=STRING.LENGTH("gcc_spdm_debug_cy_clk")

  if (STRING.SCAN("&clk", "*", 0)==0)
  (
    &wild_head=1
  )
  if (STRING.SCAN("&clk", "*", 1)==(STRING.LENGTH("&clk")-1))
  (
    &wild_tail=1
  )

  if ((&wild_head==1)&&(&wild_tail==1))
  (
    if (STRING.SCAN("gcc_spdm_debug_cy_clk", STRING.MID("&clk", 1, &clk_input_length-2), 0)!=-1)
    ( 
      &match=1
    )
  )
  else if (&wild_head==1)
  (
    if (STRING.MID("gcc_spdm_debug_cy_clk", &clk_itr_length-&clk_input_length+1, &clk_input_length-1)==STRING.CUT("&clk", 1))
    ( 
      &match=1
    )
  )
  else if (&wild_tail==1)
  (
    if (STRING.MID("gcc_spdm_debug_cy_clk", 0, &clk_input_length-1)==STRING.CUT("&clk", -1))
    ( 
      &match=1
    )
  )
  else if ("gcc_spdm_debug_cy_clk"=="&clk")
  (
    &match=1
  )
  
  if (&match==1)
  (
    &clk_test=0
    &clk_reg=&HWIO_GCC_SPDM_DEBUG_CY_CBCR_ADDR
    &clk_reg_name="GCC_SPDM_DEBUG_CY_CBCR"
    &clk_name="gcc_spdm_debug_cy_clk"
    &clk_reg_cbcr_type="sm_cbc"
    &clk_vote_bit=-1.
    &clk_multiplier=4.
    &clk_access_mode="&GCC_access_mode"

    gosub Print_Clk_Info_Line
  )

  &match=0
  &wild_head=0
  &wild_tail=0
  &clk_input_length=STRING.LENGTH("&clk")
  &clk_itr_length=STRING.LENGTH("gcc_bimc_xo_clk")

  if (STRING.SCAN("&clk", "*", 0)==0)
  (
    &wild_head=1
  )
  if (STRING.SCAN("&clk", "*", 1)==(STRING.LENGTH("&clk")-1))
  (
    &wild_tail=1
  )

  if ((&wild_head==1)&&(&wild_tail==1))
  (
    if (STRING.SCAN("gcc_bimc_xo_clk", STRING.MID("&clk", 1, &clk_input_length-2), 0)!=-1)
    ( 
      &match=1
    )
  )
  else if (&wild_head==1)
  (
    if (STRING.MID("gcc_bimc_xo_clk", &clk_itr_length-&clk_input_length+1, &clk_input_length-1)==STRING.CUT("&clk", 1))
    ( 
      &match=1
    )
  )
  else if (&wild_tail==1)
  (
    if (STRING.MID("gcc_bimc_xo_clk", 0, &clk_input_length-1)==STRING.CUT("&clk", -1))
    ( 
      &match=1
    )
  )
  else if ("gcc_bimc_xo_clk"=="&clk")
  (
    &match=1
  )
  
  if (&match==1)
  (
    &clk_test=&CLK_TEST_GCC_BIMC_XO_CLK
    &clk_reg=&HWIO_GCC_BIMC_XO_CBCR_ADDR
    &clk_reg_name="GCC_BIMC_XO_CBCR"
    &clk_name="gcc_bimc_xo_clk"
    &clk_reg_cbcr_type="sm_cbc"
    &clk_vote_bit=-1.
    &clk_multiplier=4.
    &clk_access_mode="&GCC_access_mode"

    gosub Print_Clk_Info_Line
  )

  &match=0
  &wild_head=0
  &wild_tail=0
  &clk_input_length=STRING.LENGTH("&clk")
  &clk_itr_length=STRING.LENGTH("gcc_bimc_gfx_clk")

  if (STRING.SCAN("&clk", "*", 0)==0)
  (
    &wild_head=1
  )
  if (STRING.SCAN("&clk", "*", 1)==(STRING.LENGTH("&clk")-1))
  (
    &wild_tail=1
  )

  if ((&wild_head==1)&&(&wild_tail==1))
  (
    if (STRING.SCAN("gcc_bimc_gfx_clk", STRING.MID("&clk", 1, &clk_input_length-2), 0)!=-1)
    ( 
      &match=1
    )
  )
  else if (&wild_head==1)
  (
    if (STRING.MID("gcc_bimc_gfx_clk", &clk_itr_length-&clk_input_length+1, &clk_input_length-1)==STRING.CUT("&clk", 1))
    ( 
      &match=1
    )
  )
  else if (&wild_tail==1)
  (
    if (STRING.MID("gcc_bimc_gfx_clk", 0, &clk_input_length-1)==STRING.CUT("&clk", -1))
    ( 
      &match=1
    )
  )
  else if ("gcc_bimc_gfx_clk"=="&clk")
  (
    &match=1
  )
  
  if (&match==1)
  (
    &clk_test=&CLK_TEST_GCC_BIMC_GFX_CLK
    &clk_reg=&HWIO_GCC_BIMC_GFX_CBCR_ADDR
    &clk_reg_name="GCC_BIMC_GFX_CBCR"
    &clk_name="gcc_bimc_gfx_clk"
    &clk_reg_cbcr_type="sm_pscbc"
    &clk_vote_bit=-1.
    &clk_multiplier=4.
    &clk_access_mode="&GCC_access_mode"

    gosub Print_Clk_Info_Line
  )

  &match=0
  &wild_head=0
  &wild_tail=0
  &clk_input_length=STRING.LENGTH("&clk")
  &clk_itr_length=STRING.LENGTH("gcc_bimc_gpu_clk")

  if (STRING.SCAN("&clk", "*", 0)==0)
  (
    &wild_head=1
  )
  if (STRING.SCAN("&clk", "*", 1)==(STRING.LENGTH("&clk")-1))
  (
    &wild_tail=1
  )

  if ((&wild_head==1)&&(&wild_tail==1))
  (
    if (STRING.SCAN("gcc_bimc_gpu_clk", STRING.MID("&clk", 1, &clk_input_length-2), 0)!=-1)
    ( 
      &match=1
    )
  )
  else if (&wild_head==1)
  (
    if (STRING.MID("gcc_bimc_gpu_clk", &clk_itr_length-&clk_input_length+1, &clk_input_length-1)==STRING.CUT("&clk", 1))
    ( 
      &match=1
    )
  )
  else if (&wild_tail==1)
  (
    if (STRING.MID("gcc_bimc_gpu_clk", 0, &clk_input_length-1)==STRING.CUT("&clk", -1))
    ( 
      &match=1
    )
  )
  else if ("gcc_bimc_gpu_clk"=="&clk")
  (
    &match=1
  )
  
  if (&match==1)
  (
    &clk_test=&CLK_TEST_GCC_BIMC_GPU_CLK
    &clk_reg=&HWIO_GCC_BIMC_GPU_CBCR_ADDR
    &clk_reg_name="GCC_BIMC_GPU_CBCR"
    &clk_name="gcc_bimc_gpu_clk"
    &clk_reg_cbcr_type="sm_cbc"
    &clk_vote_bit=-1.
    &clk_multiplier=4.
    &clk_access_mode="&GCC_access_mode"

    gosub Print_Clk_Info_Line
  )

  &match=0
  &wild_head=0
  &wild_tail=0
  &clk_input_length=STRING.LENGTH("&clk")
  &clk_itr_length=STRING.LENGTH("gcc_gfx_tbu_clk")

  if (STRING.SCAN("&clk", "*", 0)==0)
  (
    &wild_head=1
  )
  if (STRING.SCAN("&clk", "*", 1)==(STRING.LENGTH("&clk")-1))
  (
    &wild_tail=1
  )

  if ((&wild_head==1)&&(&wild_tail==1))
  (
    if (STRING.SCAN("gcc_gfx_tbu_clk", STRING.MID("&clk", 1, &clk_input_length-2), 0)!=-1)
    ( 
      &match=1
    )
  )
  else if (&wild_head==1)
  (
    if (STRING.MID("gcc_gfx_tbu_clk", &clk_itr_length-&clk_input_length+1, &clk_input_length-1)==STRING.CUT("&clk", 1))
    ( 
      &match=1
    )
  )
  else if (&wild_tail==1)
  (
    if (STRING.MID("gcc_gfx_tbu_clk", 0, &clk_input_length-1)==STRING.CUT("&clk", -1))
    ( 
      &match=1
    )
  )
  else if ("gcc_gfx_tbu_clk"=="&clk")
  (
    &match=1
  )
  
  if (&match==1)
  (
    &clk_test=&CLK_TEST_GCC_GFX_TBU_CLK
    &clk_reg=&HWIO_GCC_GFX_TBU_CBCR_ADDR
    &clk_reg_name="GCC_GFX_TBU_CBCR"
    &clk_name="gcc_gfx_tbu_clk"
    &clk_reg_cbcr_type="sm_pscbc"
    &clk_vote_bit=3.
    &clk_multiplier=4.
    &clk_access_mode="&GCC_access_mode"

    gosub Print_Clk_Info_Line
  )

  &match=0
  &wild_head=0
  &wild_tail=0
  &clk_input_length=STRING.LENGTH("&clk")
  &clk_itr_length=STRING.LENGTH("gcc_gfx_tcu_clk")

  if (STRING.SCAN("&clk", "*", 0)==0)
  (
    &wild_head=1
  )
  if (STRING.SCAN("&clk", "*", 1)==(STRING.LENGTH("&clk")-1))
  (
    &wild_tail=1
  )

  if ((&wild_head==1)&&(&wild_tail==1))
  (
    if (STRING.SCAN("gcc_gfx_tcu_clk", STRING.MID("&clk", 1, &clk_input_length-2), 0)!=-1)
    ( 
      &match=1
    )
  )
  else if (&wild_head==1)
  (
    if (STRING.MID("gcc_gfx_tcu_clk", &clk_itr_length-&clk_input_length+1, &clk_input_length-1)==STRING.CUT("&clk", 1))
    ( 
      &match=1
    )
  )
  else if (&wild_tail==1)
  (
    if (STRING.MID("gcc_gfx_tcu_clk", 0, &clk_input_length-1)==STRING.CUT("&clk", -1))
    ( 
      &match=1
    )
  )
  else if ("gcc_gfx_tcu_clk"=="&clk")
  (
    &match=1
  )
  
  if (&match==1)
  (
    &clk_test=&CLK_TEST_GCC_GFX_TCU_CLK
    &clk_reg=&HWIO_GCC_GFX_TCU_CBCR_ADDR
    &clk_reg_name="GCC_GFX_TCU_CBCR"
    &clk_name="gcc_gfx_tcu_clk"
    &clk_reg_cbcr_type="sm_pscbc"
    &clk_vote_bit=2.
    &clk_multiplier=4.
    &clk_access_mode="&GCC_access_mode"

    gosub Print_Clk_Info_Line
  )

  &match=0
  &wild_head=0
  &wild_tail=0
  &clk_input_length=STRING.LENGTH("&clk")
  &clk_itr_length=STRING.LENGTH("gcc_blsp1_qup0_i2c_apps_clk")

  if (STRING.SCAN("&clk", "*", 0)==0)
  (
    &wild_head=1
  )
  if (STRING.SCAN("&clk", "*", 1)==(STRING.LENGTH("&clk")-1))
  (
    &wild_tail=1
  )

  if ((&wild_head==1)&&(&wild_tail==1))
  (
    if (STRING.SCAN("gcc_blsp1_qup0_i2c_apps_clk", STRING.MID("&clk", 1, &clk_input_length-2), 0)!=-1)
    ( 
      &match=1
    )
  )
  else if (&wild_head==1)
  (
    if (STRING.MID("gcc_blsp1_qup0_i2c_apps_clk", &clk_itr_length-&clk_input_length+1, &clk_input_length-1)==STRING.CUT("&clk", 1))
    ( 
      &match=1
    )
  )
  else if (&wild_tail==1)
  (
    if (STRING.MID("gcc_blsp1_qup0_i2c_apps_clk", 0, &clk_input_length-1)==STRING.CUT("&clk", -1))
    ( 
      &match=1
    )
  )
  else if ("gcc_blsp1_qup0_i2c_apps_clk"=="&clk")
  (
    &match=1
  )
  
  if (&match==1)
  (
    &clk_test=&CLK_TEST_GCC_BLSP1_QUP0_I2C_APPS_CLK
    &clk_reg=&HWIO_GCC_BLSP1_QUP0_I2C_APPS_CBCR_ADDR
    &clk_reg_name="GCC_BLSP1_QUP0_I2C_APPS_CBCR"
    &clk_name="gcc_blsp1_qup0_i2c_apps_clk"
    &clk_reg_cbcr_type="sm_cbc"
    &clk_vote_bit=-1.
    &clk_multiplier=4.
    &clk_access_mode="&GCC_access_mode"

    gosub Print_Clk_Info_Line
  )

  &match=0
  &wild_head=0
  &wild_tail=0
  &clk_input_length=STRING.LENGTH("&clk")
  &clk_itr_length=STRING.LENGTH("gcc_blsp1_qup0_spi_apps_clk")

  if (STRING.SCAN("&clk", "*", 0)==0)
  (
    &wild_head=1
  )
  if (STRING.SCAN("&clk", "*", 1)==(STRING.LENGTH("&clk")-1))
  (
    &wild_tail=1
  )

  if ((&wild_head==1)&&(&wild_tail==1))
  (
    if (STRING.SCAN("gcc_blsp1_qup0_spi_apps_clk", STRING.MID("&clk", 1, &clk_input_length-2), 0)!=-1)
    ( 
      &match=1
    )
  )
  else if (&wild_head==1)
  (
    if (STRING.MID("gcc_blsp1_qup0_spi_apps_clk", &clk_itr_length-&clk_input_length+1, &clk_input_length-1)==STRING.CUT("&clk", 1))
    ( 
      &match=1
    )
  )
  else if (&wild_tail==1)
  (
    if (STRING.MID("gcc_blsp1_qup0_spi_apps_clk", 0, &clk_input_length-1)==STRING.CUT("&clk", -1))
    ( 
      &match=1
    )
  )
  else if ("gcc_blsp1_qup0_spi_apps_clk"=="&clk")
  (
    &match=1
  )
  
  if (&match==1)
  (
    &clk_test=&CLK_TEST_GCC_BLSP1_QUP0_SPI_APPS_CLK
    &clk_reg=&HWIO_GCC_BLSP1_QUP0_SPI_APPS_CBCR_ADDR
    &clk_reg_name="GCC_BLSP1_QUP0_SPI_APPS_CBCR"
    &clk_name="gcc_blsp1_qup0_spi_apps_clk"
    &clk_reg_cbcr_type="sm_cbc"
    &clk_vote_bit=-1.
    &clk_multiplier=4.
    &clk_access_mode="&GCC_access_mode"

    gosub Print_Clk_Info_Line
  )

  &match=0
  &wild_head=0
  &wild_tail=0
  &clk_input_length=STRING.LENGTH("&clk")
  &clk_itr_length=STRING.LENGTH("gcc_blsp1_qup1_i2c_apps_clk")

  if (STRING.SCAN("&clk", "*", 0)==0)
  (
    &wild_head=1
  )
  if (STRING.SCAN("&clk", "*", 1)==(STRING.LENGTH("&clk")-1))
  (
    &wild_tail=1
  )

  if ((&wild_head==1)&&(&wild_tail==1))
  (
    if (STRING.SCAN("gcc_blsp1_qup1_i2c_apps_clk", STRING.MID("&clk", 1, &clk_input_length-2), 0)!=-1)
    ( 
      &match=1
    )
  )
  else if (&wild_head==1)
  (
    if (STRING.MID("gcc_blsp1_qup1_i2c_apps_clk", &clk_itr_length-&clk_input_length+1, &clk_input_length-1)==STRING.CUT("&clk", 1))
    ( 
      &match=1
    )
  )
  else if (&wild_tail==1)
  (
    if (STRING.MID("gcc_blsp1_qup1_i2c_apps_clk", 0, &clk_input_length-1)==STRING.CUT("&clk", -1))
    ( 
      &match=1
    )
  )
  else if ("gcc_blsp1_qup1_i2c_apps_clk"=="&clk")
  (
    &match=1
  )
  
  if (&match==1)
  (
    &clk_test=&CLK_TEST_GCC_BLSP1_QUP1_I2C_APPS_CLK
    &clk_reg=&HWIO_GCC_BLSP1_QUP1_I2C_APPS_CBCR_ADDR
    &clk_reg_name="GCC_BLSP1_QUP1_I2C_APPS_CBCR"
    &clk_name="gcc_blsp1_qup1_i2c_apps_clk"
    &clk_reg_cbcr_type="sm_cbc"
    &clk_vote_bit=-1.
    &clk_multiplier=4.
    &clk_access_mode="&GCC_access_mode"

    gosub Print_Clk_Info_Line
  )

  &match=0
  &wild_head=0
  &wild_tail=0
  &clk_input_length=STRING.LENGTH("&clk")
  &clk_itr_length=STRING.LENGTH("gcc_blsp1_qup1_spi_apps_clk")

  if (STRING.SCAN("&clk", "*", 0)==0)
  (
    &wild_head=1
  )
  if (STRING.SCAN("&clk", "*", 1)==(STRING.LENGTH("&clk")-1))
  (
    &wild_tail=1
  )

  if ((&wild_head==1)&&(&wild_tail==1))
  (
    if (STRING.SCAN("gcc_blsp1_qup1_spi_apps_clk", STRING.MID("&clk", 1, &clk_input_length-2), 0)!=-1)
    ( 
      &match=1
    )
  )
  else if (&wild_head==1)
  (
    if (STRING.MID("gcc_blsp1_qup1_spi_apps_clk", &clk_itr_length-&clk_input_length+1, &clk_input_length-1)==STRING.CUT("&clk", 1))
    ( 
      &match=1
    )
  )
  else if (&wild_tail==1)
  (
    if (STRING.MID("gcc_blsp1_qup1_spi_apps_clk", 0, &clk_input_length-1)==STRING.CUT("&clk", -1))
    ( 
      &match=1
    )
  )
  else if ("gcc_blsp1_qup1_spi_apps_clk"=="&clk")
  (
    &match=1
  )
  
  if (&match==1)
  (
    &clk_test=&CLK_TEST_GCC_BLSP1_QUP1_SPI_APPS_CLK
    &clk_reg=&HWIO_GCC_BLSP1_QUP1_SPI_APPS_CBCR_ADDR
    &clk_reg_name="GCC_BLSP1_QUP1_SPI_APPS_CBCR"
    &clk_name="gcc_blsp1_qup1_spi_apps_clk"
    &clk_reg_cbcr_type="sm_cbc"
    &clk_vote_bit=-1.
    &clk_multiplier=4.
    &clk_access_mode="&GCC_access_mode"

    gosub Print_Clk_Info_Line
  )

  &match=0
  &wild_head=0
  &wild_tail=0
  &clk_input_length=STRING.LENGTH("&clk")
  &clk_itr_length=STRING.LENGTH("gcc_blsp1_qup2_i2c_apps_clk")

  if (STRING.SCAN("&clk", "*", 0)==0)
  (
    &wild_head=1
  )
  if (STRING.SCAN("&clk", "*", 1)==(STRING.LENGTH("&clk")-1))
  (
    &wild_tail=1
  )

  if ((&wild_head==1)&&(&wild_tail==1))
  (
    if (STRING.SCAN("gcc_blsp1_qup2_i2c_apps_clk", STRING.MID("&clk", 1, &clk_input_length-2), 0)!=-1)
    ( 
      &match=1
    )
  )
  else if (&wild_head==1)
  (
    if (STRING.MID("gcc_blsp1_qup2_i2c_apps_clk", &clk_itr_length-&clk_input_length+1, &clk_input_length-1)==STRING.CUT("&clk", 1))
    ( 
      &match=1
    )
  )
  else if (&wild_tail==1)
  (
    if (STRING.MID("gcc_blsp1_qup2_i2c_apps_clk", 0, &clk_input_length-1)==STRING.CUT("&clk", -1))
    ( 
      &match=1
    )
  )
  else if ("gcc_blsp1_qup2_i2c_apps_clk"=="&clk")
  (
    &match=1
  )
  
  if (&match==1)
  (
    &clk_test=&CLK_TEST_GCC_BLSP1_QUP2_I2C_APPS_CLK
    &clk_reg=&HWIO_GCC_BLSP1_QUP2_I2C_APPS_CBCR_ADDR
    &clk_reg_name="GCC_BLSP1_QUP2_I2C_APPS_CBCR"
    &clk_name="gcc_blsp1_qup2_i2c_apps_clk"
    &clk_reg_cbcr_type="sm_cbc"
    &clk_vote_bit=-1.
    &clk_multiplier=4.
    &clk_access_mode="&GCC_access_mode"

    gosub Print_Clk_Info_Line
  )

  &match=0
  &wild_head=0
  &wild_tail=0
  &clk_input_length=STRING.LENGTH("&clk")
  &clk_itr_length=STRING.LENGTH("gcc_blsp1_qup2_spi_apps_clk")

  if (STRING.SCAN("&clk", "*", 0)==0)
  (
    &wild_head=1
  )
  if (STRING.SCAN("&clk", "*", 1)==(STRING.LENGTH("&clk")-1))
  (
    &wild_tail=1
  )

  if ((&wild_head==1)&&(&wild_tail==1))
  (
    if (STRING.SCAN("gcc_blsp1_qup2_spi_apps_clk", STRING.MID("&clk", 1, &clk_input_length-2), 0)!=-1)
    ( 
      &match=1
    )
  )
  else if (&wild_head==1)
  (
    if (STRING.MID("gcc_blsp1_qup2_spi_apps_clk", &clk_itr_length-&clk_input_length+1, &clk_input_length-1)==STRING.CUT("&clk", 1))
    ( 
      &match=1
    )
  )
  else if (&wild_tail==1)
  (
    if (STRING.MID("gcc_blsp1_qup2_spi_apps_clk", 0, &clk_input_length-1)==STRING.CUT("&clk", -1))
    ( 
      &match=1
    )
  )
  else if ("gcc_blsp1_qup2_spi_apps_clk"=="&clk")
  (
    &match=1
  )
  
  if (&match==1)
  (
    &clk_test=&CLK_TEST_GCC_BLSP1_QUP2_SPI_APPS_CLK
    &clk_reg=&HWIO_GCC_BLSP1_QUP2_SPI_APPS_CBCR_ADDR
    &clk_reg_name="GCC_BLSP1_QUP2_SPI_APPS_CBCR"
    &clk_name="gcc_blsp1_qup2_spi_apps_clk"
    &clk_reg_cbcr_type="sm_cbc"
    &clk_vote_bit=-1.
    &clk_multiplier=4.
    &clk_access_mode="&GCC_access_mode"

    gosub Print_Clk_Info_Line
  )

  &match=0
  &wild_head=0
  &wild_tail=0
  &clk_input_length=STRING.LENGTH("&clk")
  &clk_itr_length=STRING.LENGTH("gcc_blsp1_qup3_i2c_apps_clk")

  if (STRING.SCAN("&clk", "*", 0)==0)
  (
    &wild_head=1
  )
  if (STRING.SCAN("&clk", "*", 1)==(STRING.LENGTH("&clk")-1))
  (
    &wild_tail=1
  )

  if ((&wild_head==1)&&(&wild_tail==1))
  (
    if (STRING.SCAN("gcc_blsp1_qup3_i2c_apps_clk", STRING.MID("&clk", 1, &clk_input_length-2), 0)!=-1)
    ( 
      &match=1
    )
  )
  else if (&wild_head==1)
  (
    if (STRING.MID("gcc_blsp1_qup3_i2c_apps_clk", &clk_itr_length-&clk_input_length+1, &clk_input_length-1)==STRING.CUT("&clk", 1))
    ( 
      &match=1
    )
  )
  else if (&wild_tail==1)
  (
    if (STRING.MID("gcc_blsp1_qup3_i2c_apps_clk", 0, &clk_input_length-1)==STRING.CUT("&clk", -1))
    ( 
      &match=1
    )
  )
  else if ("gcc_blsp1_qup3_i2c_apps_clk"=="&clk")
  (
    &match=1
  )
  
  if (&match==1)
  (
    &clk_test=&CLK_TEST_GCC_BLSP1_QUP3_I2C_APPS_CLK
    &clk_reg=&HWIO_GCC_BLSP1_QUP3_I2C_APPS_CBCR_ADDR
    &clk_reg_name="GCC_BLSP1_QUP3_I2C_APPS_CBCR"
    &clk_name="gcc_blsp1_qup3_i2c_apps_clk"
    &clk_reg_cbcr_type="sm_cbc"
    &clk_vote_bit=-1.
    &clk_multiplier=4.
    &clk_access_mode="&GCC_access_mode"

    gosub Print_Clk_Info_Line
  )

  &match=0
  &wild_head=0
  &wild_tail=0
  &clk_input_length=STRING.LENGTH("&clk")
  &clk_itr_length=STRING.LENGTH("gcc_blsp1_qup3_spi_apps_clk")

  if (STRING.SCAN("&clk", "*", 0)==0)
  (
    &wild_head=1
  )
  if (STRING.SCAN("&clk", "*", 1)==(STRING.LENGTH("&clk")-1))
  (
    &wild_tail=1
  )

  if ((&wild_head==1)&&(&wild_tail==1))
  (
    if (STRING.SCAN("gcc_blsp1_qup3_spi_apps_clk", STRING.MID("&clk", 1, &clk_input_length-2), 0)!=-1)
    ( 
      &match=1
    )
  )
  else if (&wild_head==1)
  (
    if (STRING.MID("gcc_blsp1_qup3_spi_apps_clk", &clk_itr_length-&clk_input_length+1, &clk_input_length-1)==STRING.CUT("&clk", 1))
    ( 
      &match=1
    )
  )
  else if (&wild_tail==1)
  (
    if (STRING.MID("gcc_blsp1_qup3_spi_apps_clk", 0, &clk_input_length-1)==STRING.CUT("&clk", -1))
    ( 
      &match=1
    )
  )
  else if ("gcc_blsp1_qup3_spi_apps_clk"=="&clk")
  (
    &match=1
  )
  
  if (&match==1)
  (
    &clk_test=&CLK_TEST_GCC_BLSP1_QUP3_SPI_APPS_CLK
    &clk_reg=&HWIO_GCC_BLSP1_QUP3_SPI_APPS_CBCR_ADDR
    &clk_reg_name="GCC_BLSP1_QUP3_SPI_APPS_CBCR"
    &clk_name="gcc_blsp1_qup3_spi_apps_clk"
    &clk_reg_cbcr_type="sm_cbc"
    &clk_vote_bit=-1.
    &clk_multiplier=4.
    &clk_access_mode="&GCC_access_mode"

    gosub Print_Clk_Info_Line
  )

  &match=0
  &wild_head=0
  &wild_tail=0
  &clk_input_length=STRING.LENGTH("&clk")
  &clk_itr_length=STRING.LENGTH("gcc_blsp1_qup4_i2c_apps_clk")

  if (STRING.SCAN("&clk", "*", 0)==0)
  (
    &wild_head=1
  )
  if (STRING.SCAN("&clk", "*", 1)==(STRING.LENGTH("&clk")-1))
  (
    &wild_tail=1
  )

  if ((&wild_head==1)&&(&wild_tail==1))
  (
    if (STRING.SCAN("gcc_blsp1_qup4_i2c_apps_clk", STRING.MID("&clk", 1, &clk_input_length-2), 0)!=-1)
    ( 
      &match=1
    )
  )
  else if (&wild_head==1)
  (
    if (STRING.MID("gcc_blsp1_qup4_i2c_apps_clk", &clk_itr_length-&clk_input_length+1, &clk_input_length-1)==STRING.CUT("&clk", 1))
    ( 
      &match=1
    )
  )
  else if (&wild_tail==1)
  (
    if (STRING.MID("gcc_blsp1_qup4_i2c_apps_clk", 0, &clk_input_length-1)==STRING.CUT("&clk", -1))
    ( 
      &match=1
    )
  )
  else if ("gcc_blsp1_qup4_i2c_apps_clk"=="&clk")
  (
    &match=1
  )
  
  if (&match==1)
  (
    &clk_test=&CLK_TEST_GCC_BLSP1_QUP4_I2C_APPS_CLK
    &clk_reg=&HWIO_GCC_BLSP1_QUP4_I2C_APPS_CBCR_ADDR
    &clk_reg_name="GCC_BLSP1_QUP4_I2C_APPS_CBCR"
    &clk_name="gcc_blsp1_qup4_i2c_apps_clk"
    &clk_reg_cbcr_type="sm_cbc"
    &clk_vote_bit=-1.
    &clk_multiplier=4.
    &clk_access_mode="&GCC_access_mode"

    gosub Print_Clk_Info_Line
  )

  &match=0
  &wild_head=0
  &wild_tail=0
  &clk_input_length=STRING.LENGTH("&clk")
  &clk_itr_length=STRING.LENGTH("gcc_blsp1_qup4_spi_apps_clk")

  if (STRING.SCAN("&clk", "*", 0)==0)
  (
    &wild_head=1
  )
  if (STRING.SCAN("&clk", "*", 1)==(STRING.LENGTH("&clk")-1))
  (
    &wild_tail=1
  )

  if ((&wild_head==1)&&(&wild_tail==1))
  (
    if (STRING.SCAN("gcc_blsp1_qup4_spi_apps_clk", STRING.MID("&clk", 1, &clk_input_length-2), 0)!=-1)
    ( 
      &match=1
    )
  )
  else if (&wild_head==1)
  (
    if (STRING.MID("gcc_blsp1_qup4_spi_apps_clk", &clk_itr_length-&clk_input_length+1, &clk_input_length-1)==STRING.CUT("&clk", 1))
    ( 
      &match=1
    )
  )
  else if (&wild_tail==1)
  (
    if (STRING.MID("gcc_blsp1_qup4_spi_apps_clk", 0, &clk_input_length-1)==STRING.CUT("&clk", -1))
    ( 
      &match=1
    )
  )
  else if ("gcc_blsp1_qup4_spi_apps_clk"=="&clk")
  (
    &match=1
  )
  
  if (&match==1)
  (
    &clk_test=&CLK_TEST_GCC_BLSP1_QUP4_SPI_APPS_CLK
    &clk_reg=&HWIO_GCC_BLSP1_QUP4_SPI_APPS_CBCR_ADDR
    &clk_reg_name="GCC_BLSP1_QUP4_SPI_APPS_CBCR"
    &clk_name="gcc_blsp1_qup4_spi_apps_clk"
    &clk_reg_cbcr_type="sm_cbc"
    &clk_vote_bit=-1.
    &clk_multiplier=4.
    &clk_access_mode="&GCC_access_mode"

    gosub Print_Clk_Info_Line
  )

  &match=0
  &wild_head=0
  &wild_tail=0
  &clk_input_length=STRING.LENGTH("&clk")
  &clk_itr_length=STRING.LENGTH("gcc_blsp1_uart0_apps_clk")

  if (STRING.SCAN("&clk", "*", 0)==0)
  (
    &wild_head=1
  )
  if (STRING.SCAN("&clk", "*", 1)==(STRING.LENGTH("&clk")-1))
  (
    &wild_tail=1
  )

  if ((&wild_head==1)&&(&wild_tail==1))
  (
    if (STRING.SCAN("gcc_blsp1_uart0_apps_clk", STRING.MID("&clk", 1, &clk_input_length-2), 0)!=-1)
    ( 
      &match=1
    )
  )
  else if (&wild_head==1)
  (
    if (STRING.MID("gcc_blsp1_uart0_apps_clk", &clk_itr_length-&clk_input_length+1, &clk_input_length-1)==STRING.CUT("&clk", 1))
    ( 
      &match=1
    )
  )
  else if (&wild_tail==1)
  (
    if (STRING.MID("gcc_blsp1_uart0_apps_clk", 0, &clk_input_length-1)==STRING.CUT("&clk", -1))
    ( 
      &match=1
    )
  )
  else if ("gcc_blsp1_uart0_apps_clk"=="&clk")
  (
    &match=1
  )
  
  if (&match==1)
  (
    &clk_test=&CLK_TEST_GCC_BLSP1_UART0_APPS_CLK
    &clk_reg=&HWIO_GCC_BLSP1_UART0_APPS_CBCR_ADDR
    &clk_reg_name="GCC_BLSP1_UART0_APPS_CBCR"
    &clk_name="gcc_blsp1_uart0_apps_clk"
    &clk_reg_cbcr_type="sm_cbc"
    &clk_vote_bit=-1.
    &clk_multiplier=4.
    &clk_access_mode="&GCC_access_mode"

    gosub Print_Clk_Info_Line
  )

  &match=0
  &wild_head=0
  &wild_tail=0
  &clk_input_length=STRING.LENGTH("&clk")
  &clk_itr_length=STRING.LENGTH("gcc_blsp1_uart1_apps_clk")

  if (STRING.SCAN("&clk", "*", 0)==0)
  (
    &wild_head=1
  )
  if (STRING.SCAN("&clk", "*", 1)==(STRING.LENGTH("&clk")-1))
  (
    &wild_tail=1
  )

  if ((&wild_head==1)&&(&wild_tail==1))
  (
    if (STRING.SCAN("gcc_blsp1_uart1_apps_clk", STRING.MID("&clk", 1, &clk_input_length-2), 0)!=-1)
    ( 
      &match=1
    )
  )
  else if (&wild_head==1)
  (
    if (STRING.MID("gcc_blsp1_uart1_apps_clk", &clk_itr_length-&clk_input_length+1, &clk_input_length-1)==STRING.CUT("&clk", 1))
    ( 
      &match=1
    )
  )
  else if (&wild_tail==1)
  (
    if (STRING.MID("gcc_blsp1_uart1_apps_clk", 0, &clk_input_length-1)==STRING.CUT("&clk", -1))
    ( 
      &match=1
    )
  )
  else if ("gcc_blsp1_uart1_apps_clk"=="&clk")
  (
    &match=1
  )
  
  if (&match==1)
  (
    &clk_test=&CLK_TEST_GCC_BLSP1_UART1_APPS_CLK
    &clk_reg=&HWIO_GCC_BLSP1_UART1_APPS_CBCR_ADDR
    &clk_reg_name="GCC_BLSP1_UART1_APPS_CBCR"
    &clk_name="gcc_blsp1_uart1_apps_clk"
    &clk_reg_cbcr_type="sm_cbc"
    &clk_vote_bit=-1.
    &clk_multiplier=4.
    &clk_access_mode="&GCC_access_mode"

    gosub Print_Clk_Info_Line
  )

  &match=0
  &wild_head=0
  &wild_tail=0
  &clk_input_length=STRING.LENGTH("&clk")
  &clk_itr_length=STRING.LENGTH("gcc_blsp1_uart2_apps_clk")

  if (STRING.SCAN("&clk", "*", 0)==0)
  (
    &wild_head=1
  )
  if (STRING.SCAN("&clk", "*", 1)==(STRING.LENGTH("&clk")-1))
  (
    &wild_tail=1
  )

  if ((&wild_head==1)&&(&wild_tail==1))
  (
    if (STRING.SCAN("gcc_blsp1_uart2_apps_clk", STRING.MID("&clk", 1, &clk_input_length-2), 0)!=-1)
    ( 
      &match=1
    )
  )
  else if (&wild_head==1)
  (
    if (STRING.MID("gcc_blsp1_uart2_apps_clk", &clk_itr_length-&clk_input_length+1, &clk_input_length-1)==STRING.CUT("&clk", 1))
    ( 
      &match=1
    )
  )
  else if (&wild_tail==1)
  (
    if (STRING.MID("gcc_blsp1_uart2_apps_clk", 0, &clk_input_length-1)==STRING.CUT("&clk", -1))
    ( 
      &match=1
    )
  )
  else if ("gcc_blsp1_uart2_apps_clk"=="&clk")
  (
    &match=1
  )
  
  if (&match==1)
  (
    &clk_test=&CLK_TEST_GCC_BLSP1_UART2_APPS_CLK
    &clk_reg=&HWIO_GCC_BLSP1_UART2_APPS_CBCR_ADDR
    &clk_reg_name="GCC_BLSP1_UART2_APPS_CBCR"
    &clk_name="gcc_blsp1_uart2_apps_clk"
    &clk_reg_cbcr_type="sm_cbc"
    &clk_vote_bit=-1.
    &clk_multiplier=4.
    &clk_access_mode="&GCC_access_mode"

    gosub Print_Clk_Info_Line
  )

  &match=0
  &wild_head=0
  &wild_tail=0
  &clk_input_length=STRING.LENGTH("&clk")
  &clk_itr_length=STRING.LENGTH("gcc_blsp1_uart3_apps_clk")

  if (STRING.SCAN("&clk", "*", 0)==0)
  (
    &wild_head=1
  )
  if (STRING.SCAN("&clk", "*", 1)==(STRING.LENGTH("&clk")-1))
  (
    &wild_tail=1
  )

  if ((&wild_head==1)&&(&wild_tail==1))
  (
    if (STRING.SCAN("gcc_blsp1_uart3_apps_clk", STRING.MID("&clk", 1, &clk_input_length-2), 0)!=-1)
    ( 
      &match=1
    )
  )
  else if (&wild_head==1)
  (
    if (STRING.MID("gcc_blsp1_uart3_apps_clk", &clk_itr_length-&clk_input_length+1, &clk_input_length-1)==STRING.CUT("&clk", 1))
    ( 
      &match=1
    )
  )
  else if (&wild_tail==1)
  (
    if (STRING.MID("gcc_blsp1_uart3_apps_clk", 0, &clk_input_length-1)==STRING.CUT("&clk", -1))
    ( 
      &match=1
    )
  )
  else if ("gcc_blsp1_uart3_apps_clk"=="&clk")
  (
    &match=1
  )
  
  if (&match==1)
  (
    &clk_test=&CLK_TEST_GCC_BLSP1_UART3_APPS_CLK
    &clk_reg=&HWIO_GCC_BLSP1_UART3_APPS_CBCR_ADDR
    &clk_reg_name="GCC_BLSP1_UART3_APPS_CBCR"
    &clk_name="gcc_blsp1_uart3_apps_clk"
    &clk_reg_cbcr_type="sm_cbc"
    &clk_vote_bit=-1.
    &clk_multiplier=4.
    &clk_access_mode="&GCC_access_mode"

    gosub Print_Clk_Info_Line
  )

  &match=0
  &wild_head=0
  &wild_tail=0
  &clk_input_length=STRING.LENGTH("&clk")
  &clk_itr_length=STRING.LENGTH("gcc_blsp2_qup0_i2c_apps_clk")

  if (STRING.SCAN("&clk", "*", 0)==0)
  (
    &wild_head=1
  )
  if (STRING.SCAN("&clk", "*", 1)==(STRING.LENGTH("&clk")-1))
  (
    &wild_tail=1
  )

  if ((&wild_head==1)&&(&wild_tail==1))
  (
    if (STRING.SCAN("gcc_blsp2_qup0_i2c_apps_clk", STRING.MID("&clk", 1, &clk_input_length-2), 0)!=-1)
    ( 
      &match=1
    )
  )
  else if (&wild_head==1)
  (
    if (STRING.MID("gcc_blsp2_qup0_i2c_apps_clk", &clk_itr_length-&clk_input_length+1, &clk_input_length-1)==STRING.CUT("&clk", 1))
    ( 
      &match=1
    )
  )
  else if (&wild_tail==1)
  (
    if (STRING.MID("gcc_blsp2_qup0_i2c_apps_clk", 0, &clk_input_length-1)==STRING.CUT("&clk", -1))
    ( 
      &match=1
    )
  )
  else if ("gcc_blsp2_qup0_i2c_apps_clk"=="&clk")
  (
    &match=1
  )
  
  if (&match==1)
  (
    &clk_test=&CLK_TEST_GCC_BLSP2_QUP0_I2C_APPS_CLK
    &clk_reg=&HWIO_GCC_BLSP2_QUP0_I2C_APPS_CBCR_ADDR
    &clk_reg_name="GCC_BLSP2_QUP0_I2C_APPS_CBCR"
    &clk_name="gcc_blsp2_qup0_i2c_apps_clk"
    &clk_reg_cbcr_type="sm_cbc"
    &clk_vote_bit=-1.
    &clk_multiplier=4.
    &clk_access_mode="&GCC_access_mode"

    gosub Print_Clk_Info_Line
  )

  &match=0
  &wild_head=0
  &wild_tail=0
  &clk_input_length=STRING.LENGTH("&clk")
  &clk_itr_length=STRING.LENGTH("gcc_blsp2_qup0_spi_apps_clk")

  if (STRING.SCAN("&clk", "*", 0)==0)
  (
    &wild_head=1
  )
  if (STRING.SCAN("&clk", "*", 1)==(STRING.LENGTH("&clk")-1))
  (
    &wild_tail=1
  )

  if ((&wild_head==1)&&(&wild_tail==1))
  (
    if (STRING.SCAN("gcc_blsp2_qup0_spi_apps_clk", STRING.MID("&clk", 1, &clk_input_length-2), 0)!=-1)
    ( 
      &match=1
    )
  )
  else if (&wild_head==1)
  (
    if (STRING.MID("gcc_blsp2_qup0_spi_apps_clk", &clk_itr_length-&clk_input_length+1, &clk_input_length-1)==STRING.CUT("&clk", 1))
    ( 
      &match=1
    )
  )
  else if (&wild_tail==1)
  (
    if (STRING.MID("gcc_blsp2_qup0_spi_apps_clk", 0, &clk_input_length-1)==STRING.CUT("&clk", -1))
    ( 
      &match=1
    )
  )
  else if ("gcc_blsp2_qup0_spi_apps_clk"=="&clk")
  (
    &match=1
  )
  
  if (&match==1)
  (
    &clk_test=&CLK_TEST_GCC_BLSP2_QUP0_SPI_APPS_CLK
    &clk_reg=&HWIO_GCC_BLSP2_QUP0_SPI_APPS_CBCR_ADDR
    &clk_reg_name="GCC_BLSP2_QUP0_SPI_APPS_CBCR"
    &clk_name="gcc_blsp2_qup0_spi_apps_clk"
    &clk_reg_cbcr_type="sm_cbc"
    &clk_vote_bit=-1.
    &clk_multiplier=4.
    &clk_access_mode="&GCC_access_mode"

    gosub Print_Clk_Info_Line
  )

  &match=0
  &wild_head=0
  &wild_tail=0
  &clk_input_length=STRING.LENGTH("&clk")
  &clk_itr_length=STRING.LENGTH("gcc_blsp2_uart0_apps_clk")

  if (STRING.SCAN("&clk", "*", 0)==0)
  (
    &wild_head=1
  )
  if (STRING.SCAN("&clk", "*", 1)==(STRING.LENGTH("&clk")-1))
  (
    &wild_tail=1
  )

  if ((&wild_head==1)&&(&wild_tail==1))
  (
    if (STRING.SCAN("gcc_blsp2_uart0_apps_clk", STRING.MID("&clk", 1, &clk_input_length-2), 0)!=-1)
    ( 
      &match=1
    )
  )
  else if (&wild_head==1)
  (
    if (STRING.MID("gcc_blsp2_uart0_apps_clk", &clk_itr_length-&clk_input_length+1, &clk_input_length-1)==STRING.CUT("&clk", 1))
    ( 
      &match=1
    )
  )
  else if (&wild_tail==1)
  (
    if (STRING.MID("gcc_blsp2_uart0_apps_clk", 0, &clk_input_length-1)==STRING.CUT("&clk", -1))
    ( 
      &match=1
    )
  )
  else if ("gcc_blsp2_uart0_apps_clk"=="&clk")
  (
    &match=1
  )
  
  if (&match==1)
  (
    &clk_test=&CLK_TEST_GCC_BLSP2_UART0_APPS_CLK
    &clk_reg=&HWIO_GCC_BLSP2_UART0_APPS_CBCR_ADDR
    &clk_reg_name="GCC_BLSP2_UART0_APPS_CBCR"
    &clk_name="gcc_blsp2_uart0_apps_clk"
    &clk_reg_cbcr_type="sm_cbc"
    &clk_vote_bit=-1.
    &clk_multiplier=4.
    &clk_access_mode="&GCC_access_mode"

    gosub Print_Clk_Info_Line
  )

  &match=0
  &wild_head=0
  &wild_tail=0
  &clk_input_length=STRING.LENGTH("&clk")
  &clk_itr_length=STRING.LENGTH("gcc_blsp1_uart0_sim_clk")

  if (STRING.SCAN("&clk", "*", 0)==0)
  (
    &wild_head=1
  )
  if (STRING.SCAN("&clk", "*", 1)==(STRING.LENGTH("&clk")-1))
  (
    &wild_tail=1
  )

  if ((&wild_head==1)&&(&wild_tail==1))
  (
    if (STRING.SCAN("gcc_blsp1_uart0_sim_clk", STRING.MID("&clk", 1, &clk_input_length-2), 0)!=-1)
    ( 
      &match=1
    )
  )
  else if (&wild_head==1)
  (
    if (STRING.MID("gcc_blsp1_uart0_sim_clk", &clk_itr_length-&clk_input_length+1, &clk_input_length-1)==STRING.CUT("&clk", 1))
    ( 
      &match=1
    )
  )
  else if (&wild_tail==1)
  (
    if (STRING.MID("gcc_blsp1_uart0_sim_clk", 0, &clk_input_length-1)==STRING.CUT("&clk", -1))
    ( 
      &match=1
    )
  )
  else if ("gcc_blsp1_uart0_sim_clk"=="&clk")
  (
    &match=1
  )
  
  if (&match==1)
  (
    &clk_test=&CLK_TEST_GCC_BLSP1_UART0_SIM_CLK
    &clk_reg=&HWIO_GCC_BLSP1_UART0_SIM_CBCR_ADDR
    &clk_reg_name="GCC_BLSP1_UART0_SIM_CBCR"
    &clk_name="gcc_blsp1_uart0_sim_clk"
    &clk_reg_cbcr_type="sm_cbc"
    &clk_vote_bit=-1.
    &clk_multiplier=4.
    &clk_access_mode="&GCC_access_mode"

    gosub Print_Clk_Info_Line
  )

  &match=0
  &wild_head=0
  &wild_tail=0
  &clk_input_length=STRING.LENGTH("&clk")
  &clk_itr_length=STRING.LENGTH("gcc_blsp1_uart1_sim_clk")

  if (STRING.SCAN("&clk", "*", 0)==0)
  (
    &wild_head=1
  )
  if (STRING.SCAN("&clk", "*", 1)==(STRING.LENGTH("&clk")-1))
  (
    &wild_tail=1
  )

  if ((&wild_head==1)&&(&wild_tail==1))
  (
    if (STRING.SCAN("gcc_blsp1_uart1_sim_clk", STRING.MID("&clk", 1, &clk_input_length-2), 0)!=-1)
    ( 
      &match=1
    )
  )
  else if (&wild_head==1)
  (
    if (STRING.MID("gcc_blsp1_uart1_sim_clk", &clk_itr_length-&clk_input_length+1, &clk_input_length-1)==STRING.CUT("&clk", 1))
    ( 
      &match=1
    )
  )
  else if (&wild_tail==1)
  (
    if (STRING.MID("gcc_blsp1_uart1_sim_clk", 0, &clk_input_length-1)==STRING.CUT("&clk", -1))
    ( 
      &match=1
    )
  )
  else if ("gcc_blsp1_uart1_sim_clk"=="&clk")
  (
    &match=1
  )
  
  if (&match==1)
  (
    &clk_test=&CLK_TEST_GCC_BLSP1_UART1_SIM_CLK
    &clk_reg=&HWIO_GCC_BLSP1_UART1_SIM_CBCR_ADDR
    &clk_reg_name="GCC_BLSP1_UART1_SIM_CBCR"
    &clk_name="gcc_blsp1_uart1_sim_clk"
    &clk_reg_cbcr_type="sm_cbc"
    &clk_vote_bit=-1.
    &clk_multiplier=4.
    &clk_access_mode="&GCC_access_mode"

    gosub Print_Clk_Info_Line
  )

  &match=0
  &wild_head=0
  &wild_tail=0
  &clk_input_length=STRING.LENGTH("&clk")
  &clk_itr_length=STRING.LENGTH("gcc_blsp1_uart2_sim_clk")

  if (STRING.SCAN("&clk", "*", 0)==0)
  (
    &wild_head=1
  )
  if (STRING.SCAN("&clk", "*", 1)==(STRING.LENGTH("&clk")-1))
  (
    &wild_tail=1
  )

  if ((&wild_head==1)&&(&wild_tail==1))
  (
    if (STRING.SCAN("gcc_blsp1_uart2_sim_clk", STRING.MID("&clk", 1, &clk_input_length-2), 0)!=-1)
    ( 
      &match=1
    )
  )
  else if (&wild_head==1)
  (
    if (STRING.MID("gcc_blsp1_uart2_sim_clk", &clk_itr_length-&clk_input_length+1, &clk_input_length-1)==STRING.CUT("&clk", 1))
    ( 
      &match=1
    )
  )
  else if (&wild_tail==1)
  (
    if (STRING.MID("gcc_blsp1_uart2_sim_clk", 0, &clk_input_length-1)==STRING.CUT("&clk", -1))
    ( 
      &match=1
    )
  )
  else if ("gcc_blsp1_uart2_sim_clk"=="&clk")
  (
    &match=1
  )
  
  if (&match==1)
  (
    &clk_test=&CLK_TEST_GCC_BLSP1_UART2_SIM_CLK
    &clk_reg=&HWIO_GCC_BLSP1_UART2_SIM_CBCR_ADDR
    &clk_reg_name="GCC_BLSP1_UART2_SIM_CBCR"
    &clk_name="gcc_blsp1_uart2_sim_clk"
    &clk_reg_cbcr_type="sm_cbc"
    &clk_vote_bit=-1.
    &clk_multiplier=4.
    &clk_access_mode="&GCC_access_mode"

    gosub Print_Clk_Info_Line
  )

  &match=0
  &wild_head=0
  &wild_tail=0
  &clk_input_length=STRING.LENGTH("&clk")
  &clk_itr_length=STRING.LENGTH("gcc_blsp1_uart3_sim_clk")

  if (STRING.SCAN("&clk", "*", 0)==0)
  (
    &wild_head=1
  )
  if (STRING.SCAN("&clk", "*", 1)==(STRING.LENGTH("&clk")-1))
  (
    &wild_tail=1
  )

  if ((&wild_head==1)&&(&wild_tail==1))
  (
    if (STRING.SCAN("gcc_blsp1_uart3_sim_clk", STRING.MID("&clk", 1, &clk_input_length-2), 0)!=-1)
    ( 
      &match=1
    )
  )
  else if (&wild_head==1)
  (
    if (STRING.MID("gcc_blsp1_uart3_sim_clk", &clk_itr_length-&clk_input_length+1, &clk_input_length-1)==STRING.CUT("&clk", 1))
    ( 
      &match=1
    )
  )
  else if (&wild_tail==1)
  (
    if (STRING.MID("gcc_blsp1_uart3_sim_clk", 0, &clk_input_length-1)==STRING.CUT("&clk", -1))
    ( 
      &match=1
    )
  )
  else if ("gcc_blsp1_uart3_sim_clk"=="&clk")
  (
    &match=1
  )
  
  if (&match==1)
  (
    &clk_test=&CLK_TEST_GCC_BLSP1_UART3_SIM_CLK
    &clk_reg=&HWIO_GCC_BLSP1_UART3_SIM_CBCR_ADDR
    &clk_reg_name="GCC_BLSP1_UART3_SIM_CBCR"
    &clk_name="gcc_blsp1_uart3_sim_clk"
    &clk_reg_cbcr_type="sm_cbc"
    &clk_vote_bit=-1.
    &clk_multiplier=4.
    &clk_access_mode="&GCC_access_mode"

    gosub Print_Clk_Info_Line
  )

  &match=0
  &wild_head=0
  &wild_tail=0
  &clk_input_length=STRING.LENGTH("&clk")
  &clk_itr_length=STRING.LENGTH("gcc_blsp2_uart0_sim_clk")

  if (STRING.SCAN("&clk", "*", 0)==0)
  (
    &wild_head=1
  )
  if (STRING.SCAN("&clk", "*", 1)==(STRING.LENGTH("&clk")-1))
  (
    &wild_tail=1
  )

  if ((&wild_head==1)&&(&wild_tail==1))
  (
    if (STRING.SCAN("gcc_blsp2_uart0_sim_clk", STRING.MID("&clk", 1, &clk_input_length-2), 0)!=-1)
    ( 
      &match=1
    )
  )
  else if (&wild_head==1)
  (
    if (STRING.MID("gcc_blsp2_uart0_sim_clk", &clk_itr_length-&clk_input_length+1, &clk_input_length-1)==STRING.CUT("&clk", 1))
    ( 
      &match=1
    )
  )
  else if (&wild_tail==1)
  (
    if (STRING.MID("gcc_blsp2_uart0_sim_clk", 0, &clk_input_length-1)==STRING.CUT("&clk", -1))
    ( 
      &match=1
    )
  )
  else if ("gcc_blsp2_uart0_sim_clk"=="&clk")
  (
    &match=1
  )
  
  if (&match==1)
  (
    &clk_test=&CLK_TEST_GCC_BLSP2_UART0_SIM_CLK
    &clk_reg=&HWIO_GCC_BLSP2_UART0_SIM_CBCR_ADDR
    &clk_reg_name="GCC_BLSP2_UART0_SIM_CBCR"
    &clk_name="gcc_blsp2_uart0_sim_clk"
    &clk_reg_cbcr_type="sm_cbc"
    &clk_vote_bit=-1.
    &clk_multiplier=4.
    &clk_access_mode="&GCC_access_mode"

    gosub Print_Clk_Info_Line
  )

  &match=0
  &wild_head=0
  &wild_tail=0
  &clk_input_length=STRING.LENGTH("&clk")
  &clk_itr_length=STRING.LENGTH("gcc_mdss_byte0_clk")

  if (STRING.SCAN("&clk", "*", 0)==0)
  (
    &wild_head=1
  )
  if (STRING.SCAN("&clk", "*", 1)==(STRING.LENGTH("&clk")-1))
  (
    &wild_tail=1
  )

  if ((&wild_head==1)&&(&wild_tail==1))
  (
    if (STRING.SCAN("gcc_mdss_byte0_clk", STRING.MID("&clk", 1, &clk_input_length-2), 0)!=-1)
    ( 
      &match=1
    )
  )
  else if (&wild_head==1)
  (
    if (STRING.MID("gcc_mdss_byte0_clk", &clk_itr_length-&clk_input_length+1, &clk_input_length-1)==STRING.CUT("&clk", 1))
    ( 
      &match=1
    )
  )
  else if (&wild_tail==1)
  (
    if (STRING.MID("gcc_mdss_byte0_clk", 0, &clk_input_length-1)==STRING.CUT("&clk", -1))
    ( 
      &match=1
    )
  )
  else if ("gcc_mdss_byte0_clk"=="&clk")
  (
    &match=1
  )
  
  if (&match==1)
  (
    &clk_test=&CLK_TEST_GCC_MDSS_BYTE0_CLK
    &clk_reg=&HWIO_GCC_MDSS_BYTE0_CBCR_ADDR
    &clk_reg_name="GCC_MDSS_BYTE0_CBCR"
    &clk_name="gcc_mdss_byte0_clk"
    &clk_reg_cbcr_type="sm_cbc"
    &clk_vote_bit=-1.
    &clk_multiplier=4.
    &clk_access_mode="&GCC_access_mode"

    gosub Print_Clk_Info_Line
  )

  &match=0
  &wild_head=0
  &wild_tail=0
  &clk_input_length=STRING.LENGTH("&clk")
  &clk_itr_length=STRING.LENGTH("gcc_bimc_cdsp_clk")

  if (STRING.SCAN("&clk", "*", 0)==0)
  (
    &wild_head=1
  )
  if (STRING.SCAN("&clk", "*", 1)==(STRING.LENGTH("&clk")-1))
  (
    &wild_tail=1
  )

  if ((&wild_head==1)&&(&wild_tail==1))
  (
    if (STRING.SCAN("gcc_bimc_cdsp_clk", STRING.MID("&clk", 1, &clk_input_length-2), 0)!=-1)
    ( 
      &match=1
    )
  )
  else if (&wild_head==1)
  (
    if (STRING.MID("gcc_bimc_cdsp_clk", &clk_itr_length-&clk_input_length+1, &clk_input_length-1)==STRING.CUT("&clk", 1))
    ( 
      &match=1
    )
  )
  else if (&wild_tail==1)
  (
    if (STRING.MID("gcc_bimc_cdsp_clk", 0, &clk_input_length-1)==STRING.CUT("&clk", -1))
    ( 
      &match=1
    )
  )
  else if ("gcc_bimc_cdsp_clk"=="&clk")
  (
    &match=1
  )
  
  if (&match==1)
  (
    &clk_test=&CLK_TEST_GCC_BIMC_CDSP_CLK
    &clk_reg=&HWIO_GCC_BIMC_CDSP_CBCR_ADDR
    &clk_reg_name="GCC_BIMC_CDSP_CBCR"
    &clk_name="gcc_bimc_cdsp_clk"
    &clk_reg_cbcr_type="sm_cbc"
    &clk_vote_bit=-1.
    &clk_multiplier=4.
    &clk_access_mode="&GCC_access_mode"

    gosub Print_Clk_Info_Line
  )

  &match=0
  &wild_head=0
  &wild_tail=0
  &clk_input_length=STRING.LENGTH("&clk")
  &clk_itr_length=STRING.LENGTH("gcc_cdsp_bimc_clk")

  if (STRING.SCAN("&clk", "*", 0)==0)
  (
    &wild_head=1
  )
  if (STRING.SCAN("&clk", "*", 1)==(STRING.LENGTH("&clk")-1))
  (
    &wild_tail=1
  )

  if ((&wild_head==1)&&(&wild_tail==1))
  (
    if (STRING.SCAN("gcc_cdsp_bimc_clk", STRING.MID("&clk", 1, &clk_input_length-2), 0)!=-1)
    ( 
      &match=1
    )
  )
  else if (&wild_head==1)
  (
    if (STRING.MID("gcc_cdsp_bimc_clk", &clk_itr_length-&clk_input_length+1, &clk_input_length-1)==STRING.CUT("&clk", 1))
    ( 
      &match=1
    )
  )
  else if (&wild_tail==1)
  (
    if (STRING.MID("gcc_cdsp_bimc_clk", 0, &clk_input_length-1)==STRING.CUT("&clk", -1))
    ( 
      &match=1
    )
  )
  else if ("gcc_cdsp_bimc_clk"=="&clk")
  (
    &match=1
  )
  
  if (&match==1)
  (
    &clk_test=&CLK_TEST_GCC_CDSP_BIMC_CLK
    &clk_reg=&HWIO_GCC_CDSP_BIMC_CBCR_ADDR
    &clk_reg_name="GCC_CDSP_BIMC_CBCR"
    &clk_name="gcc_cdsp_bimc_clk"
    &clk_reg_cbcr_type="sm_cbc"
    &clk_vote_bit=-1.
    &clk_multiplier=4.
    &clk_access_mode="&GCC_access_mode"

    gosub Print_Clk_Info_Line
  )

  &match=0
  &wild_head=0
  &wild_tail=0
  &clk_input_length=STRING.LENGTH("&clk")
  &clk_itr_length=STRING.LENGTH("gcc_cdsp_tbu_clk")

  if (STRING.SCAN("&clk", "*", 0)==0)
  (
    &wild_head=1
  )
  if (STRING.SCAN("&clk", "*", 1)==(STRING.LENGTH("&clk")-1))
  (
    &wild_tail=1
  )

  if ((&wild_head==1)&&(&wild_tail==1))
  (
    if (STRING.SCAN("gcc_cdsp_tbu_clk", STRING.MID("&clk", 1, &clk_input_length-2), 0)!=-1)
    ( 
      &match=1
    )
  )
  else if (&wild_head==1)
  (
    if (STRING.MID("gcc_cdsp_tbu_clk", &clk_itr_length-&clk_input_length+1, &clk_input_length-1)==STRING.CUT("&clk", 1))
    ( 
      &match=1
    )
  )
  else if (&wild_tail==1)
  (
    if (STRING.MID("gcc_cdsp_tbu_clk", 0, &clk_input_length-1)==STRING.CUT("&clk", -1))
    ( 
      &match=1
    )
  )
  else if ("gcc_cdsp_tbu_clk"=="&clk")
  (
    &match=1
  )
  
  if (&match==1)
  (
    &clk_test=&CLK_TEST_GCC_CDSP_TBU_CLK
    &clk_reg=&HWIO_GCC_CDSP_TBU_CBCR_ADDR
    &clk_reg_name="GCC_CDSP_TBU_CBCR"
    &clk_name="gcc_cdsp_tbu_clk"
    &clk_reg_cbcr_type="sm_pscbc"
    &clk_vote_bit=9.
    &clk_multiplier=4.
    &clk_access_mode="&GCC_access_mode"

    gosub Print_Clk_Info_Line
  )

  &match=0
  &wild_head=0
  &wild_tail=0
  &clk_input_length=STRING.LENGTH("&clk")
  &clk_itr_length=STRING.LENGTH("gcc_crypto_clk")

  if (STRING.SCAN("&clk", "*", 0)==0)
  (
    &wild_head=1
  )
  if (STRING.SCAN("&clk", "*", 1)==(STRING.LENGTH("&clk")-1))
  (
    &wild_tail=1
  )

  if ((&wild_head==1)&&(&wild_tail==1))
  (
    if (STRING.SCAN("gcc_crypto_clk", STRING.MID("&clk", 1, &clk_input_length-2), 0)!=-1)
    ( 
      &match=1
    )
  )
  else if (&wild_head==1)
  (
    if (STRING.MID("gcc_crypto_clk", &clk_itr_length-&clk_input_length+1, &clk_input_length-1)==STRING.CUT("&clk", 1))
    ( 
      &match=1
    )
  )
  else if (&wild_tail==1)
  (
    if (STRING.MID("gcc_crypto_clk", 0, &clk_input_length-1)==STRING.CUT("&clk", -1))
    ( 
      &match=1
    )
  )
  else if ("gcc_crypto_clk"=="&clk")
  (
    &match=1
  )
  
  if (&match==1)
  (
    &clk_test=&CLK_TEST_GCC_CRYPTO_CLK
    &clk_reg=&HWIO_GCC_CRYPTO_CBCR_ADDR
    &clk_reg_name="GCC_CRYPTO_CBCR"
    &clk_name="gcc_crypto_clk"
    &clk_reg_cbcr_type="sm_pscbc"
    &clk_vote_bit=2.
    &clk_multiplier=4.
    &clk_access_mode="&GCC_access_mode"

    gosub Print_Clk_Info_Line
  )

  &match=0
  &wild_head=0
  &wild_tail=0
  &clk_input_length=STRING.LENGTH("&clk")
  &clk_itr_length=STRING.LENGTH("gcc_eth_rgmii_clk")

  if (STRING.SCAN("&clk", "*", 0)==0)
  (
    &wild_head=1
  )
  if (STRING.SCAN("&clk", "*", 1)==(STRING.LENGTH("&clk")-1))
  (
    &wild_tail=1
  )

  if ((&wild_head==1)&&(&wild_tail==1))
  (
    if (STRING.SCAN("gcc_eth_rgmii_clk", STRING.MID("&clk", 1, &clk_input_length-2), 0)!=-1)
    ( 
      &match=1
    )
  )
  else if (&wild_head==1)
  (
    if (STRING.MID("gcc_eth_rgmii_clk", &clk_itr_length-&clk_input_length+1, &clk_input_length-1)==STRING.CUT("&clk", 1))
    ( 
      &match=1
    )
  )
  else if (&wild_tail==1)
  (
    if (STRING.MID("gcc_eth_rgmii_clk", 0, &clk_input_length-1)==STRING.CUT("&clk", -1))
    ( 
      &match=1
    )
  )
  else if ("gcc_eth_rgmii_clk"=="&clk")
  (
    &match=1
  )
  
  if (&match==1)
  (
    &clk_test=&CLK_TEST_GCC_ETH_RGMII_CLK
    &clk_reg=&HWIO_GCC_ETH_RGMII_CBCR_ADDR
    &clk_reg_name="GCC_ETH_RGMII_CBCR"
    &clk_name="gcc_eth_rgmii_clk"
    &clk_reg_cbcr_type="sm_cbc"
    &clk_vote_bit=-1.
    &clk_multiplier=4.
    &clk_access_mode="&GCC_access_mode"

    gosub Print_Clk_Info_Line
  )

  &match=0
  &wild_head=0
  &wild_tail=0
  &clk_input_length=STRING.LENGTH("&clk")
  &clk_itr_length=STRING.LENGTH("gcc_eth_ptp_clk")

  if (STRING.SCAN("&clk", "*", 0)==0)
  (
    &wild_head=1
  )
  if (STRING.SCAN("&clk", "*", 1)==(STRING.LENGTH("&clk")-1))
  (
    &wild_tail=1
  )

  if ((&wild_head==1)&&(&wild_tail==1))
  (
    if (STRING.SCAN("gcc_eth_ptp_clk", STRING.MID("&clk", 1, &clk_input_length-2), 0)!=-1)
    ( 
      &match=1
    )
  )
  else if (&wild_head==1)
  (
    if (STRING.MID("gcc_eth_ptp_clk", &clk_itr_length-&clk_input_length+1, &clk_input_length-1)==STRING.CUT("&clk", 1))
    ( 
      &match=1
    )
  )
  else if (&wild_tail==1)
  (
    if (STRING.MID("gcc_eth_ptp_clk", 0, &clk_input_length-1)==STRING.CUT("&clk", -1))
    ( 
      &match=1
    )
  )
  else if ("gcc_eth_ptp_clk"=="&clk")
  (
    &match=1
  )
  
  if (&match==1)
  (
    &clk_test=&CLK_TEST_GCC_ETH_PTP_CLK
    &clk_reg=&HWIO_GCC_ETH_PTP_CBCR_ADDR
    &clk_reg_name="GCC_ETH_PTP_CBCR"
    &clk_name="gcc_eth_ptp_clk"
    &clk_reg_cbcr_type="sm_cbc"
    &clk_vote_bit=-1.
    &clk_multiplier=4.
    &clk_access_mode="&GCC_access_mode"

    gosub Print_Clk_Info_Line
  )

  &match=0
  &wild_head=0
  &wild_tail=0
  &clk_input_length=STRING.LENGTH("&clk")
  &clk_itr_length=STRING.LENGTH("gcc_mdss_esc0_clk")

  if (STRING.SCAN("&clk", "*", 0)==0)
  (
    &wild_head=1
  )
  if (STRING.SCAN("&clk", "*", 1)==(STRING.LENGTH("&clk")-1))
  (
    &wild_tail=1
  )

  if ((&wild_head==1)&&(&wild_tail==1))
  (
    if (STRING.SCAN("gcc_mdss_esc0_clk", STRING.MID("&clk", 1, &clk_input_length-2), 0)!=-1)
    ( 
      &match=1
    )
  )
  else if (&wild_head==1)
  (
    if (STRING.MID("gcc_mdss_esc0_clk", &clk_itr_length-&clk_input_length+1, &clk_input_length-1)==STRING.CUT("&clk", 1))
    ( 
      &match=1
    )
  )
  else if (&wild_tail==1)
  (
    if (STRING.MID("gcc_mdss_esc0_clk", 0, &clk_input_length-1)==STRING.CUT("&clk", -1))
    ( 
      &match=1
    )
  )
  else if ("gcc_mdss_esc0_clk"=="&clk")
  (
    &match=1
  )
  
  if (&match==1)
  (
    &clk_test=&CLK_TEST_GCC_MDSS_ESC0_CLK
    &clk_reg=&HWIO_GCC_MDSS_ESC0_CBCR_ADDR
    &clk_reg_name="GCC_MDSS_ESC0_CBCR"
    &clk_name="gcc_mdss_esc0_clk"
    &clk_reg_cbcr_type="sm_cbc"
    &clk_vote_bit=-1.
    &clk_multiplier=4.
    &clk_access_mode="&GCC_access_mode"

    gosub Print_Clk_Info_Line
  )

  &match=0
  &wild_head=0
  &wild_tail=0
  &clk_input_length=STRING.LENGTH("&clk")
  &clk_itr_length=STRING.LENGTH("gcc_bimc_sleep_clk")

  if (STRING.SCAN("&clk", "*", 0)==0)
  (
    &wild_head=1
  )
  if (STRING.SCAN("&clk", "*", 1)==(STRING.LENGTH("&clk")-1))
  (
    &wild_tail=1
  )

  if ((&wild_head==1)&&(&wild_tail==1))
  (
    if (STRING.SCAN("gcc_bimc_sleep_clk", STRING.MID("&clk", 1, &clk_input_length-2), 0)!=-1)
    ( 
      &match=1
    )
  )
  else if (&wild_head==1)
  (
    if (STRING.MID("gcc_bimc_sleep_clk", &clk_itr_length-&clk_input_length+1, &clk_input_length-1)==STRING.CUT("&clk", 1))
    ( 
      &match=1
    )
  )
  else if (&wild_tail==1)
  (
    if (STRING.MID("gcc_bimc_sleep_clk", 0, &clk_input_length-1)==STRING.CUT("&clk", -1))
    ( 
      &match=1
    )
  )
  else if ("gcc_bimc_sleep_clk"=="&clk")
  (
    &match=1
  )
  
  if (&match==1)
  (
    &clk_test=&CLK_TEST_GCC_BIMC_SLEEP_CLK
    &clk_reg=&HWIO_GCC_BIMC_SLEEP_CBCR_ADDR
    &clk_reg_name="GCC_BIMC_SLEEP_CBCR"
    &clk_name="gcc_bimc_sleep_clk"
    &clk_reg_cbcr_type="sm_cbc"
    &clk_vote_bit=-1.
    &clk_multiplier=4.
    &clk_access_mode="&GCC_access_mode"

    gosub Print_Clk_Info_Line
  )

  &match=0
  &wild_head=0
  &wild_tail=0
  &clk_input_length=STRING.LENGTH("&clk")
  &clk_itr_length=STRING.LENGTH("gcc_blsp1_sleep_clk")

  if (STRING.SCAN("&clk", "*", 0)==0)
  (
    &wild_head=1
  )
  if (STRING.SCAN("&clk", "*", 1)==(STRING.LENGTH("&clk")-1))
  (
    &wild_tail=1
  )

  if ((&wild_head==1)&&(&wild_tail==1))
  (
    if (STRING.SCAN("gcc_blsp1_sleep_clk", STRING.MID("&clk", 1, &clk_input_length-2), 0)!=-1)
    ( 
      &match=1
    )
  )
  else if (&wild_head==1)
  (
    if (STRING.MID("gcc_blsp1_sleep_clk", &clk_itr_length-&clk_input_length+1, &clk_input_length-1)==STRING.CUT("&clk", 1))
    ( 
      &match=1
    )
  )
  else if (&wild_tail==1)
  (
    if (STRING.MID("gcc_blsp1_sleep_clk", 0, &clk_input_length-1)==STRING.CUT("&clk", -1))
    ( 
      &match=1
    )
  )
  else if ("gcc_blsp1_sleep_clk"=="&clk")
  (
    &match=1
  )
  
  if (&match==1)
  (
    &clk_test=&CLK_TEST_GCC_BLSP1_SLEEP_CLK
    &clk_reg=&HWIO_GCC_BLSP1_SLEEP_CBCR_ADDR
    &clk_reg_name="GCC_BLSP1_SLEEP_CBCR"
    &clk_name="gcc_blsp1_sleep_clk"
    &clk_reg_cbcr_type="sm_cbc"
    &clk_vote_bit=9.
    &clk_multiplier=4.
    &clk_access_mode="&GCC_access_mode"

    gosub Print_Clk_Info_Line
  )

  &match=0
  &wild_head=0
  &wild_tail=0
  &clk_input_length=STRING.LENGTH("&clk")
  &clk_itr_length=STRING.LENGTH("gcc_blsp2_sleep_clk")

  if (STRING.SCAN("&clk", "*", 0)==0)
  (
    &wild_head=1
  )
  if (STRING.SCAN("&clk", "*", 1)==(STRING.LENGTH("&clk")-1))
  (
    &wild_tail=1
  )

  if ((&wild_head==1)&&(&wild_tail==1))
  (
    if (STRING.SCAN("gcc_blsp2_sleep_clk", STRING.MID("&clk", 1, &clk_input_length-2), 0)!=-1)
    ( 
      &match=1
    )
  )
  else if (&wild_head==1)
  (
    if (STRING.MID("gcc_blsp2_sleep_clk", &clk_itr_length-&clk_input_length+1, &clk_input_length-1)==STRING.CUT("&clk", 1))
    ( 
      &match=1
    )
  )
  else if (&wild_tail==1)
  (
    if (STRING.MID("gcc_blsp2_sleep_clk", 0, &clk_input_length-1)==STRING.CUT("&clk", -1))
    ( 
      &match=1
    )
  )
  else if ("gcc_blsp2_sleep_clk"=="&clk")
  (
    &match=1
  )
  
  if (&match==1)
  (
    &clk_test=&CLK_TEST_GCC_BLSP2_SLEEP_CLK
    &clk_reg=&HWIO_GCC_BLSP2_SLEEP_CBCR_ADDR
    &clk_reg_name="GCC_BLSP2_SLEEP_CBCR"
    &clk_name="gcc_blsp2_sleep_clk"
    &clk_reg_cbcr_type="sm_cbc"
    &clk_vote_bit=19.
    &clk_multiplier=4.
    &clk_access_mode="&GCC_access_mode"

    gosub Print_Clk_Info_Line
  )

  &match=0
  &wild_head=0
  &wild_tail=0
  &clk_input_length=STRING.LENGTH("&clk")
  &clk_itr_length=STRING.LENGTH("gcc_ddr_dim_sleep_clk")

  if (STRING.SCAN("&clk", "*", 0)==0)
  (
    &wild_head=1
  )
  if (STRING.SCAN("&clk", "*", 1)==(STRING.LENGTH("&clk")-1))
  (
    &wild_tail=1
  )

  if ((&wild_head==1)&&(&wild_tail==1))
  (
    if (STRING.SCAN("gcc_ddr_dim_sleep_clk", STRING.MID("&clk", 1, &clk_input_length-2), 0)!=-1)
    ( 
      &match=1
    )
  )
  else if (&wild_head==1)
  (
    if (STRING.MID("gcc_ddr_dim_sleep_clk", &clk_itr_length-&clk_input_length+1, &clk_input_length-1)==STRING.CUT("&clk", 1))
    ( 
      &match=1
    )
  )
  else if (&wild_tail==1)
  (
    if (STRING.MID("gcc_ddr_dim_sleep_clk", 0, &clk_input_length-1)==STRING.CUT("&clk", -1))
    ( 
      &match=1
    )
  )
  else if ("gcc_ddr_dim_sleep_clk"=="&clk")
  (
    &match=1
  )
  
  if (&match==1)
  (
    &clk_test=&CLK_TEST_GCC_DDR_DIM_SLEEP_CLK
    &clk_reg=&HWIO_GCC_DDR_DIM_SLEEP_CBCR_ADDR
    &clk_reg_name="GCC_DDR_DIM_SLEEP_CBCR"
    &clk_name="gcc_ddr_dim_sleep_clk"
    &clk_reg_cbcr_type="sm_cbc"
    &clk_vote_bit=-1.
    &clk_multiplier=4.
    &clk_access_mode="&GCC_access_mode"

    gosub Print_Clk_Info_Line
  )

  &match=0
  &wild_head=0
  &wild_tail=0
  &clk_input_length=STRING.LENGTH("&clk")
  &clk_itr_length=STRING.LENGTH("gcc_im_sleep_clk")

  if (STRING.SCAN("&clk", "*", 0)==0)
  (
    &wild_head=1
  )
  if (STRING.SCAN("&clk", "*", 1)==(STRING.LENGTH("&clk")-1))
  (
    &wild_tail=1
  )

  if ((&wild_head==1)&&(&wild_tail==1))
  (
    if (STRING.SCAN("gcc_im_sleep_clk", STRING.MID("&clk", 1, &clk_input_length-2), 0)!=-1)
    ( 
      &match=1
    )
  )
  else if (&wild_head==1)
  (
    if (STRING.MID("gcc_im_sleep_clk", &clk_itr_length-&clk_input_length+1, &clk_input_length-1)==STRING.CUT("&clk", 1))
    ( 
      &match=1
    )
  )
  else if (&wild_tail==1)
  (
    if (STRING.MID("gcc_im_sleep_clk", 0, &clk_input_length-1)==STRING.CUT("&clk", -1))
    ( 
      &match=1
    )
  )
  else if ("gcc_im_sleep_clk"=="&clk")
  (
    &match=1
  )
  
  if (&match==1)
  (
    &clk_test=&CLK_TEST_GCC_IM_SLEEP_CLK
    &clk_reg=&HWIO_GCC_GCC_IM_SLEEP_CBCR_ADDR
    &clk_reg_name="GCC_GCC_IM_SLEEP_CBCR"
    &clk_name="gcc_im_sleep_clk"
    &clk_reg_cbcr_type="sm_cbc"
    &clk_vote_bit=-1.
    &clk_multiplier=4.
    &clk_access_mode="&GCC_access_mode"

    gosub Print_Clk_Info_Line
  )

  &match=0
  &wild_head=0
  &wild_tail=0
  &clk_input_length=STRING.LENGTH("&clk")
  &clk_itr_length=STRING.LENGTH("gcc_qpic_system_clk")

  if (STRING.SCAN("&clk", "*", 0)==0)
  (
    &wild_head=1
  )
  if (STRING.SCAN("&clk", "*", 1)==(STRING.LENGTH("&clk")-1))
  (
    &wild_tail=1
  )

  if ((&wild_head==1)&&(&wild_tail==1))
  (
    if (STRING.SCAN("gcc_qpic_system_clk", STRING.MID("&clk", 1, &clk_input_length-2), 0)!=-1)
    ( 
      &match=1
    )
  )
  else if (&wild_head==1)
  (
    if (STRING.MID("gcc_qpic_system_clk", &clk_itr_length-&clk_input_length+1, &clk_input_length-1)==STRING.CUT("&clk", 1))
    ( 
      &match=1
    )
  )
  else if (&wild_tail==1)
  (
    if (STRING.MID("gcc_qpic_system_clk", 0, &clk_input_length-1)==STRING.CUT("&clk", -1))
    ( 
      &match=1
    )
  )
  else if ("gcc_qpic_system_clk"=="&clk")
  (
    &match=1
  )
  
  if (&match==1)
  (
    &clk_test=&CLK_TEST_GCC_QPIC_SYSTEM_CLK
    &clk_reg=&HWIO_GCC_QPIC_SYSTEM_CBCR_ADDR
    &clk_reg_name="GCC_QPIC_SYSTEM_CBCR"
    &clk_name="gcc_qpic_system_clk"
    &clk_reg_cbcr_type="sm_cbc"
    &clk_vote_bit=-1.
    &clk_multiplier=4.
    &clk_access_mode="&GCC_access_mode"

    gosub Print_Clk_Info_Line
  )

  &match=0
  &wild_head=0
  &wild_tail=0
  &clk_input_length=STRING.LENGTH("&clk")
  &clk_itr_length=STRING.LENGTH("gcc_rpm_sleep_clk")

  if (STRING.SCAN("&clk", "*", 0)==0)
  (
    &wild_head=1
  )
  if (STRING.SCAN("&clk", "*", 1)==(STRING.LENGTH("&clk")-1))
  (
    &wild_tail=1
  )

  if ((&wild_head==1)&&(&wild_tail==1))
  (
    if (STRING.SCAN("gcc_rpm_sleep_clk", STRING.MID("&clk", 1, &clk_input_length-2), 0)!=-1)
    ( 
      &match=1
    )
  )
  else if (&wild_head==1)
  (
    if (STRING.MID("gcc_rpm_sleep_clk", &clk_itr_length-&clk_input_length+1, &clk_input_length-1)==STRING.CUT("&clk", 1))
    ( 
      &match=1
    )
  )
  else if (&wild_tail==1)
  (
    if (STRING.MID("gcc_rpm_sleep_clk", 0, &clk_input_length-1)==STRING.CUT("&clk", -1))
    ( 
      &match=1
    )
  )
  else if ("gcc_rpm_sleep_clk"=="&clk")
  (
    &match=1
  )
  
  if (&match==1)
  (
    &clk_test=&CLK_TEST_GCC_RPM_SLEEP_CLK
    &clk_reg=&HWIO_GCC_RPM_SLEEP_CBCR_ADDR
    &clk_reg_name="GCC_RPM_SLEEP_CBCR"
    &clk_name="gcc_rpm_sleep_clk"
    &clk_reg_cbcr_type="sm_cbc"
    &clk_vote_bit=-1.
    &clk_multiplier=4.
    &clk_access_mode="&GCC_access_mode"

    gosub Print_Clk_Info_Line
  )

  &match=0
  &wild_head=0
  &wild_tail=0
  &clk_input_length=STRING.LENGTH("&clk")
  &clk_itr_length=STRING.LENGTH("gcc_usb2a_phy_sleep_clk")

  if (STRING.SCAN("&clk", "*", 0)==0)
  (
    &wild_head=1
  )
  if (STRING.SCAN("&clk", "*", 1)==(STRING.LENGTH("&clk")-1))
  (
    &wild_tail=1
  )

  if ((&wild_head==1)&&(&wild_tail==1))
  (
    if (STRING.SCAN("gcc_usb2a_phy_sleep_clk", STRING.MID("&clk", 1, &clk_input_length-2), 0)!=-1)
    ( 
      &match=1
    )
  )
  else if (&wild_head==1)
  (
    if (STRING.MID("gcc_usb2a_phy_sleep_clk", &clk_itr_length-&clk_input_length+1, &clk_input_length-1)==STRING.CUT("&clk", 1))
    ( 
      &match=1
    )
  )
  else if (&wild_tail==1)
  (
    if (STRING.MID("gcc_usb2a_phy_sleep_clk", 0, &clk_input_length-1)==STRING.CUT("&clk", -1))
    ( 
      &match=1
    )
  )
  else if ("gcc_usb2a_phy_sleep_clk"=="&clk")
  (
    &match=1
  )
  
  if (&match==1)
  (
    &clk_test=&CLK_TEST_GCC_USB2A_PHY_SLEEP_CLK
    &clk_reg=&HWIO_GCC_USB2A_PHY_SLEEP_CBCR_ADDR
    &clk_reg_name="GCC_USB2A_PHY_SLEEP_CBCR"
    &clk_name="gcc_usb2a_phy_sleep_clk"
    &clk_reg_cbcr_type="sm_cbc"
    &clk_vote_bit=-1.
    &clk_multiplier=4.
    &clk_access_mode="&GCC_access_mode"

    gosub Print_Clk_Info_Line
  )

  &match=0
  &wild_head=0
  &wild_tail=0
  &clk_input_length=STRING.LENGTH("&clk")
  &clk_itr_length=STRING.LENGTH("gcc_usb30_sleep_clk")

  if (STRING.SCAN("&clk", "*", 0)==0)
  (
    &wild_head=1
  )
  if (STRING.SCAN("&clk", "*", 1)==(STRING.LENGTH("&clk")-1))
  (
    &wild_tail=1
  )

  if ((&wild_head==1)&&(&wild_tail==1))
  (
    if (STRING.SCAN("gcc_usb30_sleep_clk", STRING.MID("&clk", 1, &clk_input_length-2), 0)!=-1)
    ( 
      &match=1
    )
  )
  else if (&wild_head==1)
  (
    if (STRING.MID("gcc_usb30_sleep_clk", &clk_itr_length-&clk_input_length+1, &clk_input_length-1)==STRING.CUT("&clk", 1))
    ( 
      &match=1
    )
  )
  else if (&wild_tail==1)
  (
    if (STRING.MID("gcc_usb30_sleep_clk", 0, &clk_input_length-1)==STRING.CUT("&clk", -1))
    ( 
      &match=1
    )
  )
  else if ("gcc_usb30_sleep_clk"=="&clk")
  (
    &match=1
  )
  
  if (&match==1)
  (
    &clk_test=&CLK_TEST_GCC_USB30_SLEEP_CLK
    &clk_reg=&HWIO_GCC_USB30_SLEEP_CBCR_ADDR
    &clk_reg_name="GCC_USB30_SLEEP_CBCR"
    &clk_name="gcc_usb30_sleep_clk"
    &clk_reg_cbcr_type="sm_cbc"
    &clk_vote_bit=-1.
    &clk_multiplier=4.
    &clk_access_mode="&GCC_access_mode"

    gosub Print_Clk_Info_Line
  )

  &match=0
  &wild_head=0
  &wild_tail=0
  &clk_input_length=STRING.LENGTH("&clk")
  &clk_itr_length=STRING.LENGTH("gcc_usb_hs_inactivity_timers_clk")

  if (STRING.SCAN("&clk", "*", 0)==0)
  (
    &wild_head=1
  )
  if (STRING.SCAN("&clk", "*", 1)==(STRING.LENGTH("&clk")-1))
  (
    &wild_tail=1
  )

  if ((&wild_head==1)&&(&wild_tail==1))
  (
    if (STRING.SCAN("gcc_usb_hs_inactivity_timers_clk", STRING.MID("&clk", 1, &clk_input_length-2), 0)!=-1)
    ( 
      &match=1
    )
  )
  else if (&wild_head==1)
  (
    if (STRING.MID("gcc_usb_hs_inactivity_timers_clk", &clk_itr_length-&clk_input_length+1, &clk_input_length-1)==STRING.CUT("&clk", 1))
    ( 
      &match=1
    )
  )
  else if (&wild_tail==1)
  (
    if (STRING.MID("gcc_usb_hs_inactivity_timers_clk", 0, &clk_input_length-1)==STRING.CUT("&clk", -1))
    ( 
      &match=1
    )
  )
  else if ("gcc_usb_hs_inactivity_timers_clk"=="&clk")
  (
    &match=1
  )
  
  if (&match==1)
  (
    &clk_test=&CLK_TEST_GCC_USB_HS_INACTIVITY_TIMERS_CLK
    &clk_reg=&HWIO_GCC_USB_HS_INACTIVITY_TIMERS_CBCR_ADDR
    &clk_reg_name="GCC_USB_HS_INACTIVITY_TIMERS_CBCR"
    &clk_name="gcc_usb_hs_inactivity_timers_clk"
    &clk_reg_cbcr_type="sm_cbc"
    &clk_vote_bit=-1.
    &clk_multiplier=4.
    &clk_access_mode="&GCC_access_mode"

    gosub Print_Clk_Info_Line
  )

  &match=0
  &wild_head=0
  &wild_tail=0
  &clk_input_length=STRING.LENGTH("&clk")
  &clk_itr_length=STRING.LENGTH("lpass_sleep_clk")

  if (STRING.SCAN("&clk", "*", 0)==0)
  (
    &wild_head=1
  )
  if (STRING.SCAN("&clk", "*", 1)==(STRING.LENGTH("&clk")-1))
  (
    &wild_tail=1
  )

  if ((&wild_head==1)&&(&wild_tail==1))
  (
    if (STRING.SCAN("lpass_sleep_clk", STRING.MID("&clk", 1, &clk_input_length-2), 0)!=-1)
    ( 
      &match=1
    )
  )
  else if (&wild_head==1)
  (
    if (STRING.MID("lpass_sleep_clk", &clk_itr_length-&clk_input_length+1, &clk_input_length-1)==STRING.CUT("&clk", 1))
    ( 
      &match=1
    )
  )
  else if (&wild_tail==1)
  (
    if (STRING.MID("lpass_sleep_clk", 0, &clk_input_length-1)==STRING.CUT("&clk", -1))
    ( 
      &match=1
    )
  )
  else if ("lpass_sleep_clk"=="&clk")
  (
    &match=1
  )
  
  if (&match==1)
  (
    &clk_test=&CLK_TEST_LPASS_SLEEP_CLK
    &clk_reg=&HWIO_GCC_LPASS_SLEEP_CBCR_ADDR
    &clk_reg_name="GCC_LPASS_SLEEP_CBCR"
    &clk_name="lpass_sleep_clk"
    &clk_reg_cbcr_type="sm_cbc"
    &clk_vote_bit=-1.
    &clk_multiplier=4.
    &clk_access_mode="&GCC_access_mode"

    gosub Print_Clk_Info_Line
  )

  &match=0
  &wild_head=0
  &wild_tail=0
  &clk_input_length=STRING.LENGTH("&clk")
  &clk_itr_length=STRING.LENGTH("gcc_dcc_xo_clk")

  if (STRING.SCAN("&clk", "*", 0)==0)
  (
    &wild_head=1
  )
  if (STRING.SCAN("&clk", "*", 1)==(STRING.LENGTH("&clk")-1))
  (
    &wild_tail=1
  )

  if ((&wild_head==1)&&(&wild_tail==1))
  (
    if (STRING.SCAN("gcc_dcc_xo_clk", STRING.MID("&clk", 1, &clk_input_length-2), 0)!=-1)
    ( 
      &match=1
    )
  )
  else if (&wild_head==1)
  (
    if (STRING.MID("gcc_dcc_xo_clk", &clk_itr_length-&clk_input_length+1, &clk_input_length-1)==STRING.CUT("&clk", 1))
    ( 
      &match=1
    )
  )
  else if (&wild_tail==1)
  (
    if (STRING.MID("gcc_dcc_xo_clk", 0, &clk_input_length-1)==STRING.CUT("&clk", -1))
    ( 
      &match=1
    )
  )
  else if ("gcc_dcc_xo_clk"=="&clk")
  (
    &match=1
  )
  
  if (&match==1)
  (
    &clk_test=&CLK_TEST_GCC_DCC_XO_CLK
    &clk_reg=&HWIO_GCC_DCC_XO_CBCR_ADDR
    &clk_reg_name="GCC_DCC_XO_CBCR"
    &clk_name="gcc_dcc_xo_clk"
    &clk_reg_cbcr_type="sm_cbc"
    &clk_vote_bit=-1.
    &clk_multiplier=4.
    &clk_access_mode="&GCC_access_mode"

    gosub Print_Clk_Info_Line
  )

  &match=0
  &wild_head=0
  &wild_tail=0
  &clk_input_length=STRING.LENGTH("&clk")
  &clk_itr_length=STRING.LENGTH("gcc_dcd_xo_clk")

  if (STRING.SCAN("&clk", "*", 0)==0)
  (
    &wild_head=1
  )
  if (STRING.SCAN("&clk", "*", 1)==(STRING.LENGTH("&clk")-1))
  (
    &wild_tail=1
  )

  if ((&wild_head==1)&&(&wild_tail==1))
  (
    if (STRING.SCAN("gcc_dcd_xo_clk", STRING.MID("&clk", 1, &clk_input_length-2), 0)!=-1)
    ( 
      &match=1
    )
  )
  else if (&wild_head==1)
  (
    if (STRING.MID("gcc_dcd_xo_clk", &clk_itr_length-&clk_input_length+1, &clk_input_length-1)==STRING.CUT("&clk", 1))
    ( 
      &match=1
    )
  )
  else if (&wild_tail==1)
  (
    if (STRING.MID("gcc_dcd_xo_clk", 0, &clk_input_length-1)==STRING.CUT("&clk", -1))
    ( 
      &match=1
    )
  )
  else if ("gcc_dcd_xo_clk"=="&clk")
  (
    &match=1
  )
  
  if (&match==1)
  (
    &clk_test=&CLK_TEST_GCC_DCD_XO_CLK
    &clk_reg=&HWIO_GCC_DCD_XO_CBCR_ADDR
    &clk_reg_name="GCC_DCD_XO_CBCR"
    &clk_name="gcc_dcd_xo_clk"
    &clk_reg_cbcr_type="sm_cbc"
    &clk_vote_bit=-1.
    &clk_multiplier=4.
    &clk_access_mode="&GCC_access_mode"

    gosub Print_Clk_Info_Line
  )

  &match=0
  &wild_head=0
  &wild_tail=0
  &clk_input_length=STRING.LENGTH("&clk")
  &clk_itr_length=STRING.LENGTH("gcc_geni_ir_s_clk")

  if (STRING.SCAN("&clk", "*", 0)==0)
  (
    &wild_head=1
  )
  if (STRING.SCAN("&clk", "*", 1)==(STRING.LENGTH("&clk")-1))
  (
    &wild_tail=1
  )

  if ((&wild_head==1)&&(&wild_tail==1))
  (
    if (STRING.SCAN("gcc_geni_ir_s_clk", STRING.MID("&clk", 1, &clk_input_length-2), 0)!=-1)
    ( 
      &match=1
    )
  )
  else if (&wild_head==1)
  (
    if (STRING.MID("gcc_geni_ir_s_clk", &clk_itr_length-&clk_input_length+1, &clk_input_length-1)==STRING.CUT("&clk", 1))
    ( 
      &match=1
    )
  )
  else if (&wild_tail==1)
  (
    if (STRING.MID("gcc_geni_ir_s_clk", 0, &clk_input_length-1)==STRING.CUT("&clk", -1))
    ( 
      &match=1
    )
  )
  else if ("gcc_geni_ir_s_clk"=="&clk")
  (
    &match=1
  )
  
  if (&match==1)
  (
    &clk_test=&CLK_TEST_GCC_GENI_IR_S_CLK
    &clk_reg=&HWIO_GCC_GENI_IR_S_CBCR_ADDR
    &clk_reg_name="GCC_GENI_IR_S_CBCR"
    &clk_name="gcc_geni_ir_s_clk"
    &clk_reg_cbcr_type="sm_pscbc"
    &clk_vote_bit=-1.
    &clk_multiplier=4.
    &clk_access_mode="&GCC_access_mode"

    gosub Print_Clk_Info_Line
  )

  &match=0
  &wild_head=0
  &wild_tail=0
  &clk_input_length=STRING.LENGTH("&clk")
  &clk_itr_length=STRING.LENGTH("gcc_xo_clk")

  if (STRING.SCAN("&clk", "*", 0)==0)
  (
    &wild_head=1
  )
  if (STRING.SCAN("&clk", "*", 1)==(STRING.LENGTH("&clk")-1))
  (
    &wild_tail=1
  )

  if ((&wild_head==1)&&(&wild_tail==1))
  (
    if (STRING.SCAN("gcc_xo_clk", STRING.MID("&clk", 1, &clk_input_length-2), 0)!=-1)
    ( 
      &match=1
    )
  )
  else if (&wild_head==1)
  (
    if (STRING.MID("gcc_xo_clk", &clk_itr_length-&clk_input_length+1, &clk_input_length-1)==STRING.CUT("&clk", 1))
    ( 
      &match=1
    )
  )
  else if (&wild_tail==1)
  (
    if (STRING.MID("gcc_xo_clk", 0, &clk_input_length-1)==STRING.CUT("&clk", -1))
    ( 
      &match=1
    )
  )
  else if ("gcc_xo_clk"=="&clk")
  (
    &match=1
  )
  
  if (&match==1)
  (
    &clk_test=&CLK_TEST_GCC_XO_CLK
    &clk_reg=&HWIO_GCC_GCC_XO_CBCR_ADDR
    &clk_reg_name="GCC_GCC_XO_CBCR"
    &clk_name="gcc_xo_clk"
    &clk_reg_cbcr_type="sm_cbc"
    &clk_vote_bit=-1.
    &clk_multiplier=4.
    &clk_access_mode="&GCC_access_mode"

    gosub Print_Clk_Info_Line
  )

  &match=0
  &wild_head=0
  &wild_tail=0
  &clk_input_length=STRING.LENGTH("&clk")
  &clk_itr_length=STRING.LENGTH("gcc_xo_div4_clk")

  if (STRING.SCAN("&clk", "*", 0)==0)
  (
    &wild_head=1
  )
  if (STRING.SCAN("&clk", "*", 1)==(STRING.LENGTH("&clk")-1))
  (
    &wild_tail=1
  )

  if ((&wild_head==1)&&(&wild_tail==1))
  (
    if (STRING.SCAN("gcc_xo_div4_clk", STRING.MID("&clk", 1, &clk_input_length-2), 0)!=-1)
    ( 
      &match=1
    )
  )
  else if (&wild_head==1)
  (
    if (STRING.MID("gcc_xo_div4_clk", &clk_itr_length-&clk_input_length+1, &clk_input_length-1)==STRING.CUT("&clk", 1))
    ( 
      &match=1
    )
  )
  else if (&wild_tail==1)
  (
    if (STRING.MID("gcc_xo_div4_clk", 0, &clk_input_length-1)==STRING.CUT("&clk", -1))
    ( 
      &match=1
    )
  )
  else if ("gcc_xo_div4_clk"=="&clk")
  (
    &match=1
  )
  
  if (&match==1)
  (
    &clk_test=&CLK_TEST_GCC_XO_DIV4_CLK
    &clk_reg=&HWIO_GCC_GCC_XO_DIV4_CBCR_ADDR
    &clk_reg_name="GCC_GCC_XO_DIV4_CBCR"
    &clk_name="gcc_xo_div4_clk"
    &clk_reg_cbcr_type="sm_cbc"
    &clk_vote_bit=-1.
    &clk_multiplier=4.
    &clk_access_mode="&GCC_access_mode"

    gosub Print_Clk_Info_Line
  )

  &match=0
  &wild_head=0
  &wild_tail=0
  &clk_input_length=STRING.LENGTH("&clk")
  &clk_itr_length=STRING.LENGTH("gcc_oxili_gfx3d_clk")

  if (STRING.SCAN("&clk", "*", 0)==0)
  (
    &wild_head=1
  )
  if (STRING.SCAN("&clk", "*", 1)==(STRING.LENGTH("&clk")-1))
  (
    &wild_tail=1
  )

  if ((&wild_head==1)&&(&wild_tail==1))
  (
    if (STRING.SCAN("gcc_oxili_gfx3d_clk", STRING.MID("&clk", 1, &clk_input_length-2), 0)!=-1)
    ( 
      &match=1
    )
  )
  else if (&wild_head==1)
  (
    if (STRING.MID("gcc_oxili_gfx3d_clk", &clk_itr_length-&clk_input_length+1, &clk_input_length-1)==STRING.CUT("&clk", 1))
    ( 
      &match=1
    )
  )
  else if (&wild_tail==1)
  (
    if (STRING.MID("gcc_oxili_gfx3d_clk", 0, &clk_input_length-1)==STRING.CUT("&clk", -1))
    ( 
      &match=1
    )
  )
  else if ("gcc_oxili_gfx3d_clk"=="&clk")
  (
    &match=1
  )
  
  if (&match==1)
  (
    &clk_test=&CLK_TEST_GCC_OXILI_GFX3D_CLK
    &clk_reg=&HWIO_GCC_OXILI_GFX3D_CBCR_ADDR
    &clk_reg_name="GCC_OXILI_GFX3D_CBCR"
    &clk_name="gcc_oxili_gfx3d_clk"
    &clk_reg_cbcr_type="sm_pscbc"
    &clk_vote_bit=-1.
    &clk_multiplier=4.
    &clk_access_mode="&GCC_access_mode"

    gosub Print_Clk_Info_Line
  )

  &match=0
  &wild_head=0
  &wild_tail=0
  &clk_input_length=STRING.LENGTH("&clk")
  &clk_itr_length=STRING.LENGTH("gcc_gp1_clk")

  if (STRING.SCAN("&clk", "*", 0)==0)
  (
    &wild_head=1
  )
  if (STRING.SCAN("&clk", "*", 1)==(STRING.LENGTH("&clk")-1))
  (
    &wild_tail=1
  )

  if ((&wild_head==1)&&(&wild_tail==1))
  (
    if (STRING.SCAN("gcc_gp1_clk", STRING.MID("&clk", 1, &clk_input_length-2), 0)!=-1)
    ( 
      &match=1
    )
  )
  else if (&wild_head==1)
  (
    if (STRING.MID("gcc_gp1_clk", &clk_itr_length-&clk_input_length+1, &clk_input_length-1)==STRING.CUT("&clk", 1))
    ( 
      &match=1
    )
  )
  else if (&wild_tail==1)
  (
    if (STRING.MID("gcc_gp1_clk", 0, &clk_input_length-1)==STRING.CUT("&clk", -1))
    ( 
      &match=1
    )
  )
  else if ("gcc_gp1_clk"=="&clk")
  (
    &match=1
  )
  
  if (&match==1)
  (
    &clk_test=&CLK_TEST_GCC_GP1_CLK
    &clk_reg=&HWIO_GCC_GP1_CBCR_ADDR
    &clk_reg_name="GCC_GP1_CBCR"
    &clk_name="gcc_gp1_clk"
    &clk_reg_cbcr_type="sm_cbc"
    &clk_vote_bit=-1.
    &clk_multiplier=4.
    &clk_access_mode="&GCC_access_mode"

    gosub Print_Clk_Info_Line
  )

  &match=0
  &wild_head=0
  &wild_tail=0
  &clk_input_length=STRING.LENGTH("&clk")
  &clk_itr_length=STRING.LENGTH("gcc_gp2_clk")

  if (STRING.SCAN("&clk", "*", 0)==0)
  (
    &wild_head=1
  )
  if (STRING.SCAN("&clk", "*", 1)==(STRING.LENGTH("&clk")-1))
  (
    &wild_tail=1
  )

  if ((&wild_head==1)&&(&wild_tail==1))
  (
    if (STRING.SCAN("gcc_gp2_clk", STRING.MID("&clk", 1, &clk_input_length-2), 0)!=-1)
    ( 
      &match=1
    )
  )
  else if (&wild_head==1)
  (
    if (STRING.MID("gcc_gp2_clk", &clk_itr_length-&clk_input_length+1, &clk_input_length-1)==STRING.CUT("&clk", 1))
    ( 
      &match=1
    )
  )
  else if (&wild_tail==1)
  (
    if (STRING.MID("gcc_gp2_clk", 0, &clk_input_length-1)==STRING.CUT("&clk", -1))
    ( 
      &match=1
    )
  )
  else if ("gcc_gp2_clk"=="&clk")
  (
    &match=1
  )
  
  if (&match==1)
  (
    &clk_test=&CLK_TEST_GCC_GP2_CLK
    &clk_reg=&HWIO_GCC_GP2_CBCR_ADDR
    &clk_reg_name="GCC_GP2_CBCR"
    &clk_name="gcc_gp2_clk"
    &clk_reg_cbcr_type="sm_cbc"
    &clk_vote_bit=-1.
    &clk_multiplier=4.
    &clk_access_mode="&GCC_access_mode"

    gosub Print_Clk_Info_Line
  )

  &match=0
  &wild_head=0
  &wild_tail=0
  &clk_input_length=STRING.LENGTH("&clk")
  &clk_itr_length=STRING.LENGTH("gcc_gp3_clk")

  if (STRING.SCAN("&clk", "*", 0)==0)
  (
    &wild_head=1
  )
  if (STRING.SCAN("&clk", "*", 1)==(STRING.LENGTH("&clk")-1))
  (
    &wild_tail=1
  )

  if ((&wild_head==1)&&(&wild_tail==1))
  (
    if (STRING.SCAN("gcc_gp3_clk", STRING.MID("&clk", 1, &clk_input_length-2), 0)!=-1)
    ( 
      &match=1
    )
  )
  else if (&wild_head==1)
  (
    if (STRING.MID("gcc_gp3_clk", &clk_itr_length-&clk_input_length+1, &clk_input_length-1)==STRING.CUT("&clk", 1))
    ( 
      &match=1
    )
  )
  else if (&wild_tail==1)
  (
    if (STRING.MID("gcc_gp3_clk", 0, &clk_input_length-1)==STRING.CUT("&clk", -1))
    ( 
      &match=1
    )
  )
  else if ("gcc_gp3_clk"=="&clk")
  (
    &match=1
  )
  
  if (&match==1)
  (
    &clk_test=&CLK_TEST_GCC_GP3_CLK
    &clk_reg=&HWIO_GCC_GP3_CBCR_ADDR
    &clk_reg_name="GCC_GP3_CBCR"
    &clk_name="gcc_gp3_clk"
    &clk_reg_cbcr_type="sm_cbc"
    &clk_vote_bit=-1.
    &clk_multiplier=4.
    &clk_access_mode="&GCC_access_mode"

    gosub Print_Clk_Info_Line
  )

  &match=0
  &wild_head=0
  &wild_tail=0
  &clk_input_length=STRING.LENGTH("&clk")
  &clk_itr_length=STRING.LENGTH("gcc_mdss_hdmi_app_clk")

  if (STRING.SCAN("&clk", "*", 0)==0)
  (
    &wild_head=1
  )
  if (STRING.SCAN("&clk", "*", 1)==(STRING.LENGTH("&clk")-1))
  (
    &wild_tail=1
  )

  if ((&wild_head==1)&&(&wild_tail==1))
  (
    if (STRING.SCAN("gcc_mdss_hdmi_app_clk", STRING.MID("&clk", 1, &clk_input_length-2), 0)!=-1)
    ( 
      &match=1
    )
  )
  else if (&wild_head==1)
  (
    if (STRING.MID("gcc_mdss_hdmi_app_clk", &clk_itr_length-&clk_input_length+1, &clk_input_length-1)==STRING.CUT("&clk", 1))
    ( 
      &match=1
    )
  )
  else if (&wild_tail==1)
  (
    if (STRING.MID("gcc_mdss_hdmi_app_clk", 0, &clk_input_length-1)==STRING.CUT("&clk", -1))
    ( 
      &match=1
    )
  )
  else if ("gcc_mdss_hdmi_app_clk"=="&clk")
  (
    &match=1
  )
  
  if (&match==1)
  (
    &clk_test=&CLK_TEST_GCC_MDSS_HDMI_APP_CLK
    &clk_reg=&HWIO_GCC_MDSS_HDMI_APP_CBCR_ADDR
    &clk_reg_name="GCC_MDSS_HDMI_APP_CBCR"
    &clk_name="gcc_mdss_hdmi_app_clk"
    &clk_reg_cbcr_type="sm_cbc"
    &clk_vote_bit=-1.
    &clk_multiplier=4.
    &clk_access_mode="&GCC_access_mode"

    gosub Print_Clk_Info_Line
  )

  &match=0
  &wild_head=0
  &wild_tail=0
  &clk_input_length=STRING.LENGTH("&clk")
  &clk_itr_length=STRING.LENGTH("gcc_mdss_hdmi_pclk_clk")

  if (STRING.SCAN("&clk", "*", 0)==0)
  (
    &wild_head=1
  )
  if (STRING.SCAN("&clk", "*", 1)==(STRING.LENGTH("&clk")-1))
  (
    &wild_tail=1
  )

  if ((&wild_head==1)&&(&wild_tail==1))
  (
    if (STRING.SCAN("gcc_mdss_hdmi_pclk_clk", STRING.MID("&clk", 1, &clk_input_length-2), 0)!=-1)
    ( 
      &match=1
    )
  )
  else if (&wild_head==1)
  (
    if (STRING.MID("gcc_mdss_hdmi_pclk_clk", &clk_itr_length-&clk_input_length+1, &clk_input_length-1)==STRING.CUT("&clk", 1))
    ( 
      &match=1
    )
  )
  else if (&wild_tail==1)
  (
    if (STRING.MID("gcc_mdss_hdmi_pclk_clk", 0, &clk_input_length-1)==STRING.CUT("&clk", -1))
    ( 
      &match=1
    )
  )
  else if ("gcc_mdss_hdmi_pclk_clk"=="&clk")
  (
    &match=1
  )
  
  if (&match==1)
  (
    &clk_test=&CLK_TEST_GCC_MDSS_HDMI_PCLK_CLK
    &clk_reg=&HWIO_GCC_MDSS_HDMI_PCLK_CBCR_ADDR
    &clk_reg_name="GCC_MDSS_HDMI_PCLK_CBCR"
    &clk_name="gcc_mdss_hdmi_pclk_clk"
    &clk_reg_cbcr_type="sm_cbc"
    &clk_vote_bit=-1.
    &clk_multiplier=4.
    &clk_access_mode="&GCC_access_mode"

    gosub Print_Clk_Info_Line
  )

  &match=0
  &wild_head=0
  &wild_tail=0
  &clk_input_length=STRING.LENGTH("&clk")
  &clk_itr_length=STRING.LENGTH("gcc_bimc_lpass_clk")

  if (STRING.SCAN("&clk", "*", 0)==0)
  (
    &wild_head=1
  )
  if (STRING.SCAN("&clk", "*", 1)==(STRING.LENGTH("&clk")-1))
  (
    &wild_tail=1
  )

  if ((&wild_head==1)&&(&wild_tail==1))
  (
    if (STRING.SCAN("gcc_bimc_lpass_clk", STRING.MID("&clk", 1, &clk_input_length-2), 0)!=-1)
    ( 
      &match=1
    )
  )
  else if (&wild_head==1)
  (
    if (STRING.MID("gcc_bimc_lpass_clk", &clk_itr_length-&clk_input_length+1, &clk_input_length-1)==STRING.CUT("&clk", 1))
    ( 
      &match=1
    )
  )
  else if (&wild_tail==1)
  (
    if (STRING.MID("gcc_bimc_lpass_clk", 0, &clk_input_length-1)==STRING.CUT("&clk", -1))
    ( 
      &match=1
    )
  )
  else if ("gcc_bimc_lpass_clk"=="&clk")
  (
    &match=1
  )
  
  if (&match==1)
  (
    &clk_test=&CLK_TEST_GCC_BIMC_LPASS_CLK
    &clk_reg=&HWIO_GCC_BIMC_LPASS_CBCR_ADDR
    &clk_reg_name="GCC_BIMC_LPASS_CBCR"
    &clk_name="gcc_bimc_lpass_clk"
    &clk_reg_cbcr_type="sm_cbc"
    &clk_vote_bit=-1.
    &clk_multiplier=4.
    &clk_access_mode="&GCC_access_mode"

    gosub Print_Clk_Info_Line
  )

  &match=0
  &wild_head=0
  &wild_tail=0
  &clk_input_length=STRING.LENGTH("&clk")
  &clk_itr_length=STRING.LENGTH("gcc_lpass_agnoc_clk")

  if (STRING.SCAN("&clk", "*", 0)==0)
  (
    &wild_head=1
  )
  if (STRING.SCAN("&clk", "*", 1)==(STRING.LENGTH("&clk")-1))
  (
    &wild_tail=1
  )

  if ((&wild_head==1)&&(&wild_tail==1))
  (
    if (STRING.SCAN("gcc_lpass_agnoc_clk", STRING.MID("&clk", 1, &clk_input_length-2), 0)!=-1)
    ( 
      &match=1
    )
  )
  else if (&wild_head==1)
  (
    if (STRING.MID("gcc_lpass_agnoc_clk", &clk_itr_length-&clk_input_length+1, &clk_input_length-1)==STRING.CUT("&clk", 1))
    ( 
      &match=1
    )
  )
  else if (&wild_tail==1)
  (
    if (STRING.MID("gcc_lpass_agnoc_clk", 0, &clk_input_length-1)==STRING.CUT("&clk", -1))
    ( 
      &match=1
    )
  )
  else if ("gcc_lpass_agnoc_clk"=="&clk")
  (
    &match=1
  )
  
  if (&match==1)
  (
    &clk_test=&CLK_TEST_GCC_LPASS_AGNOC_CLK
    &clk_reg=&HWIO_GCC_LPASS_AGNOC_CBCR_ADDR
    &clk_reg_name="GCC_LPASS_AGNOC_CBCR"
    &clk_name="gcc_lpass_agnoc_clk"
    &clk_reg_cbcr_type="sm_cbc"
    &clk_vote_bit=-1.
    &clk_multiplier=4.
    &clk_access_mode="&GCC_access_mode"

    gosub Print_Clk_Info_Line
  )

  &match=0
  &wild_head=0
  &wild_tail=0
  &clk_input_length=STRING.LENGTH("&clk")
  &clk_itr_length=STRING.LENGTH("gcc_lpass_core_mport_clk")

  if (STRING.SCAN("&clk", "*", 0)==0)
  (
    &wild_head=1
  )
  if (STRING.SCAN("&clk", "*", 1)==(STRING.LENGTH("&clk")-1))
  (
    &wild_tail=1
  )

  if ((&wild_head==1)&&(&wild_tail==1))
  (
    if (STRING.SCAN("gcc_lpass_core_mport_clk", STRING.MID("&clk", 1, &clk_input_length-2), 0)!=-1)
    ( 
      &match=1
    )
  )
  else if (&wild_head==1)
  (
    if (STRING.MID("gcc_lpass_core_mport_clk", &clk_itr_length-&clk_input_length+1, &clk_input_length-1)==STRING.CUT("&clk", 1))
    ( 
      &match=1
    )
  )
  else if (&wild_tail==1)
  (
    if (STRING.MID("gcc_lpass_core_mport_clk", 0, &clk_input_length-1)==STRING.CUT("&clk", -1))
    ( 
      &match=1
    )
  )
  else if ("gcc_lpass_core_mport_clk"=="&clk")
  (
    &match=1
  )
  
  if (&match==1)
  (
    &clk_test=&CLK_TEST_GCC_LPASS_CORE_MPORT_CLK
    &clk_reg=&HWIO_GCC_LPASS_CORE_MPORT_CBCR_ADDR
    &clk_reg_name="GCC_LPASS_CORE_MPORT_CBCR"
    &clk_name="gcc_lpass_core_mport_clk"
    &clk_reg_cbcr_type="sm_cbc"
    &clk_vote_bit=-1.
    &clk_multiplier=4.
    &clk_access_mode="&GCC_access_mode"

    gosub Print_Clk_Info_Line
  )

  &match=0
  &wild_head=0
  &wild_tail=0
  &clk_input_length=STRING.LENGTH("&clk")
  &clk_itr_length=STRING.LENGTH("gcc_lpass_hw_af_clk")

  if (STRING.SCAN("&clk", "*", 0)==0)
  (
    &wild_head=1
  )
  if (STRING.SCAN("&clk", "*", 1)==(STRING.LENGTH("&clk")-1))
  (
    &wild_tail=1
  )

  if ((&wild_head==1)&&(&wild_tail==1))
  (
    if (STRING.SCAN("gcc_lpass_hw_af_clk", STRING.MID("&clk", 1, &clk_input_length-2), 0)!=-1)
    ( 
      &match=1
    )
  )
  else if (&wild_head==1)
  (
    if (STRING.MID("gcc_lpass_hw_af_clk", &clk_itr_length-&clk_input_length+1, &clk_input_length-1)==STRING.CUT("&clk", 1))
    ( 
      &match=1
    )
  )
  else if (&wild_tail==1)
  (
    if (STRING.MID("gcc_lpass_hw_af_clk", 0, &clk_input_length-1)==STRING.CUT("&clk", -1))
    ( 
      &match=1
    )
  )
  else if ("gcc_lpass_hw_af_clk"=="&clk")
  (
    &match=1
  )
  
  if (&match==1)
  (
    &clk_test=&CLK_TEST_GCC_LPASS_HW_AF_CLK
    &clk_reg=&HWIO_GCC_LPASS_HW_AF_CBCR_ADDR
    &clk_reg_name="GCC_LPASS_HW_AF_CBCR"
    &clk_name="gcc_lpass_hw_af_clk"
    &clk_reg_cbcr_type="sm_pscbc"
    &clk_vote_bit=-1.
    &clk_multiplier=4.
    &clk_access_mode="&GCC_access_mode"

    gosub Print_Clk_Info_Line
  )

  &match=0
  &wild_head=0
  &wild_tail=0
  &clk_input_length=STRING.LENGTH("&clk")
  &clk_itr_length=STRING.LENGTH("gcc_lpass_q6_axim_clk")

  if (STRING.SCAN("&clk", "*", 0)==0)
  (
    &wild_head=1
  )
  if (STRING.SCAN("&clk", "*", 1)==(STRING.LENGTH("&clk")-1))
  (
    &wild_tail=1
  )

  if ((&wild_head==1)&&(&wild_tail==1))
  (
    if (STRING.SCAN("gcc_lpass_q6_axim_clk", STRING.MID("&clk", 1, &clk_input_length-2), 0)!=-1)
    ( 
      &match=1
    )
  )
  else if (&wild_head==1)
  (
    if (STRING.MID("gcc_lpass_q6_axim_clk", &clk_itr_length-&clk_input_length+1, &clk_input_length-1)==STRING.CUT("&clk", 1))
    ( 
      &match=1
    )
  )
  else if (&wild_tail==1)
  (
    if (STRING.MID("gcc_lpass_q6_axim_clk", 0, &clk_input_length-1)==STRING.CUT("&clk", -1))
    ( 
      &match=1
    )
  )
  else if ("gcc_lpass_q6_axim_clk"=="&clk")
  (
    &match=1
  )
  
  if (&match==1)
  (
    &clk_test=&CLK_TEST_GCC_LPASS_Q6_AXIM_CLK
    &clk_reg=&HWIO_GCC_LPASS_Q6_AXIM_CBCR_ADDR
    &clk_reg_name="GCC_LPASS_Q6_AXIM_CBCR"
    &clk_name="gcc_lpass_q6_axim_clk"
    &clk_reg_cbcr_type="sm_cbc"
    &clk_vote_bit=-1.
    &clk_multiplier=4.
    &clk_access_mode="&GCC_access_mode"

    gosub Print_Clk_Info_Line
  )

  &match=0
  &wild_head=0
  &wild_tail=0
  &clk_input_length=STRING.LENGTH("&clk")
  &clk_itr_length=STRING.LENGTH("gcc_lpass_tbu_clk")

  if (STRING.SCAN("&clk", "*", 0)==0)
  (
    &wild_head=1
  )
  if (STRING.SCAN("&clk", "*", 1)==(STRING.LENGTH("&clk")-1))
  (
    &wild_tail=1
  )

  if ((&wild_head==1)&&(&wild_tail==1))
  (
    if (STRING.SCAN("gcc_lpass_tbu_clk", STRING.MID("&clk", 1, &clk_input_length-2), 0)!=-1)
    ( 
      &match=1
    )
  )
  else if (&wild_head==1)
  (
    if (STRING.MID("gcc_lpass_tbu_clk", &clk_itr_length-&clk_input_length+1, &clk_input_length-1)==STRING.CUT("&clk", 1))
    ( 
      &match=1
    )
  )
  else if (&wild_tail==1)
  (
    if (STRING.MID("gcc_lpass_tbu_clk", 0, &clk_input_length-1)==STRING.CUT("&clk", -1))
    ( 
      &match=1
    )
  )
  else if ("gcc_lpass_tbu_clk"=="&clk")
  (
    &match=1
  )
  
  if (&match==1)
  (
    &clk_test=&CLK_TEST_GCC_LPASS_TBU_CLK
    &clk_reg=&HWIO_GCC_LPASS_TBU_CBCR_ADDR
    &clk_reg_name="GCC_LPASS_TBU_CBCR"
    &clk_name="gcc_lpass_tbu_clk"
    &clk_reg_cbcr_type="sm_pscbc"
    &clk_vote_bit=18.
    &clk_multiplier=4.
    &clk_access_mode="&GCC_access_mode"

    gosub Print_Clk_Info_Line
  )

  &match=0
  &wild_head=0
  &wild_tail=0
  &clk_input_length=STRING.LENGTH("&clk")
  &clk_itr_length=STRING.LENGTH("gcc_mdss_mdp_clk")

  if (STRING.SCAN("&clk", "*", 0)==0)
  (
    &wild_head=1
  )
  if (STRING.SCAN("&clk", "*", 1)==(STRING.LENGTH("&clk")-1))
  (
    &wild_tail=1
  )

  if ((&wild_head==1)&&(&wild_tail==1))
  (
    if (STRING.SCAN("gcc_mdss_mdp_clk", STRING.MID("&clk", 1, &clk_input_length-2), 0)!=-1)
    ( 
      &match=1
    )
  )
  else if (&wild_head==1)
  (
    if (STRING.MID("gcc_mdss_mdp_clk", &clk_itr_length-&clk_input_length+1, &clk_input_length-1)==STRING.CUT("&clk", 1))
    ( 
      &match=1
    )
  )
  else if (&wild_tail==1)
  (
    if (STRING.MID("gcc_mdss_mdp_clk", 0, &clk_input_length-1)==STRING.CUT("&clk", -1))
    ( 
      &match=1
    )
  )
  else if ("gcc_mdss_mdp_clk"=="&clk")
  (
    &match=1
  )
  
  if (&match==1)
  (
    &clk_test=&CLK_TEST_GCC_MDSS_MDP_CLK
    &clk_reg=&HWIO_GCC_MDSS_MDP_CBCR_ADDR
    &clk_reg_name="GCC_MDSS_MDP_CBCR"
    &clk_name="gcc_mdss_mdp_clk"
    &clk_reg_cbcr_type="sm_pscbc"
    &clk_vote_bit=-1.
    &clk_multiplier=4.
    &clk_access_mode="&GCC_access_mode"

    gosub Print_Clk_Info_Line
  )

  &match=0
  &wild_head=0
  &wild_tail=0
  &clk_input_length=STRING.LENGTH("&clk")
  &clk_itr_length=STRING.LENGTH("gcc_bimc_mdss_clk")

  if (STRING.SCAN("&clk", "*", 0)==0)
  (
    &wild_head=1
  )
  if (STRING.SCAN("&clk", "*", 1)==(STRING.LENGTH("&clk")-1))
  (
    &wild_tail=1
  )

  if ((&wild_head==1)&&(&wild_tail==1))
  (
    if (STRING.SCAN("gcc_bimc_mdss_clk", STRING.MID("&clk", 1, &clk_input_length-2), 0)!=-1)
    ( 
      &match=1
    )
  )
  else if (&wild_head==1)
  (
    if (STRING.MID("gcc_bimc_mdss_clk", &clk_itr_length-&clk_input_length+1, &clk_input_length-1)==STRING.CUT("&clk", 1))
    ( 
      &match=1
    )
  )
  else if (&wild_tail==1)
  (
    if (STRING.MID("gcc_bimc_mdss_clk", 0, &clk_input_length-1)==STRING.CUT("&clk", -1))
    ( 
      &match=1
    )
  )
  else if ("gcc_bimc_mdss_clk"=="&clk")
  (
    &match=1
  )
  
  if (&match==1)
  (
    &clk_test=&CLK_TEST_GCC_BIMC_MDSS_CLK
    &clk_reg=&HWIO_GCC_BIMC_MDSS_CBCR_ADDR
    &clk_reg_name="GCC_BIMC_MDSS_CBCR"
    &clk_name="gcc_bimc_mdss_clk"
    &clk_reg_cbcr_type="sm_cbc"
    &clk_vote_bit=-1.
    &clk_multiplier=4.
    &clk_access_mode="&GCC_access_mode"

    gosub Print_Clk_Info_Line
  )

  &match=0
  &wild_head=0
  &wild_tail=0
  &clk_input_length=STRING.LENGTH("&clk")
  &clk_itr_length=STRING.LENGTH("gcc_mdp_tbu_clk")

  if (STRING.SCAN("&clk", "*", 0)==0)
  (
    &wild_head=1
  )
  if (STRING.SCAN("&clk", "*", 1)==(STRING.LENGTH("&clk")-1))
  (
    &wild_tail=1
  )

  if ((&wild_head==1)&&(&wild_tail==1))
  (
    if (STRING.SCAN("gcc_mdp_tbu_clk", STRING.MID("&clk", 1, &clk_input_length-2), 0)!=-1)
    ( 
      &match=1
    )
  )
  else if (&wild_head==1)
  (
    if (STRING.MID("gcc_mdp_tbu_clk", &clk_itr_length-&clk_input_length+1, &clk_input_length-1)==STRING.CUT("&clk", 1))
    ( 
      &match=1
    )
  )
  else if (&wild_tail==1)
  (
    if (STRING.MID("gcc_mdp_tbu_clk", 0, &clk_input_length-1)==STRING.CUT("&clk", -1))
    ( 
      &match=1
    )
  )
  else if ("gcc_mdp_tbu_clk"=="&clk")
  (
    &match=1
  )
  
  if (&match==1)
  (
    &clk_test=&CLK_TEST_GCC_MDP_TBU_CLK
    &clk_reg=&HWIO_GCC_MDP_TBU_CBCR_ADDR
    &clk_reg_name="GCC_MDP_TBU_CBCR"
    &clk_name="gcc_mdp_tbu_clk"
    &clk_reg_cbcr_type="sm_pscbc"
    &clk_vote_bit=4.
    &clk_multiplier=4.
    &clk_access_mode="&GCC_access_mode"

    gosub Print_Clk_Info_Line
  )

  &match=0
  &wild_head=0
  &wild_tail=0
  &clk_input_length=STRING.LENGTH("&clk")
  &clk_itr_length=STRING.LENGTH("gcc_mdss_axi_clk")

  if (STRING.SCAN("&clk", "*", 0)==0)
  (
    &wild_head=1
  )
  if (STRING.SCAN("&clk", "*", 1)==(STRING.LENGTH("&clk")-1))
  (
    &wild_tail=1
  )

  if ((&wild_head==1)&&(&wild_tail==1))
  (
    if (STRING.SCAN("gcc_mdss_axi_clk", STRING.MID("&clk", 1, &clk_input_length-2), 0)!=-1)
    ( 
      &match=1
    )
  )
  else if (&wild_head==1)
  (
    if (STRING.MID("gcc_mdss_axi_clk", &clk_itr_length-&clk_input_length+1, &clk_input_length-1)==STRING.CUT("&clk", 1))
    ( 
      &match=1
    )
  )
  else if (&wild_tail==1)
  (
    if (STRING.MID("gcc_mdss_axi_clk", 0, &clk_input_length-1)==STRING.CUT("&clk", -1))
    ( 
      &match=1
    )
  )
  else if ("gcc_mdss_axi_clk"=="&clk")
  (
    &match=1
  )
  
  if (&match==1)
  (
    &clk_test=&CLK_TEST_GCC_MDSS_AXI_CLK
    &clk_reg=&HWIO_GCC_MDSS_AXI_CBCR_ADDR
    &clk_reg_name="GCC_MDSS_AXI_CBCR"
    &clk_name="gcc_mdss_axi_clk"
    &clk_reg_cbcr_type="sm_pscbc"
    &clk_vote_bit=-1.
    &clk_multiplier=4.
    &clk_access_mode="&GCC_access_mode"

    gosub Print_Clk_Info_Line
  )

  &match=0
  &wild_head=0
  &wild_tail=0
  &clk_input_length=STRING.LENGTH("&clk")
  &clk_itr_length=STRING.LENGTH("gcc_pcie_0_aux_clk")

  if (STRING.SCAN("&clk", "*", 0)==0)
  (
    &wild_head=1
  )
  if (STRING.SCAN("&clk", "*", 1)==(STRING.LENGTH("&clk")-1))
  (
    &wild_tail=1
  )

  if ((&wild_head==1)&&(&wild_tail==1))
  (
    if (STRING.SCAN("gcc_pcie_0_aux_clk", STRING.MID("&clk", 1, &clk_input_length-2), 0)!=-1)
    ( 
      &match=1
    )
  )
  else if (&wild_head==1)
  (
    if (STRING.MID("gcc_pcie_0_aux_clk", &clk_itr_length-&clk_input_length+1, &clk_input_length-1)==STRING.CUT("&clk", 1))
    ( 
      &match=1
    )
  )
  else if (&wild_tail==1)
  (
    if (STRING.MID("gcc_pcie_0_aux_clk", 0, &clk_input_length-1)==STRING.CUT("&clk", -1))
    ( 
      &match=1
    )
  )
  else if ("gcc_pcie_0_aux_clk"=="&clk")
  (
    &match=1
  )
  
  if (&match==1)
  (
    &clk_test=&CLK_TEST_GCC_PCIE_0_AUX_CLK
    &clk_reg=&HWIO_GCC_PCIE_0_AUX_CBCR_ADDR
    &clk_reg_name="GCC_PCIE_0_AUX_CBCR"
    &clk_name="gcc_pcie_0_aux_clk"
    &clk_reg_cbcr_type="sm_cbc"
    &clk_vote_bit=27.
    &clk_multiplier=4.
    &clk_access_mode="&GCC_access_mode"

    gosub Print_Clk_Info_Line
  )

  &match=0
  &wild_head=0
  &wild_tail=0
  &clk_input_length=STRING.LENGTH("&clk")
  &clk_itr_length=STRING.LENGTH("gcc_pcie_0_pipe_clk")

  if (STRING.SCAN("&clk", "*", 0)==0)
  (
    &wild_head=1
  )
  if (STRING.SCAN("&clk", "*", 1)==(STRING.LENGTH("&clk")-1))
  (
    &wild_tail=1
  )

  if ((&wild_head==1)&&(&wild_tail==1))
  (
    if (STRING.SCAN("gcc_pcie_0_pipe_clk", STRING.MID("&clk", 1, &clk_input_length-2), 0)!=-1)
    ( 
      &match=1
    )
  )
  else if (&wild_head==1)
  (
    if (STRING.MID("gcc_pcie_0_pipe_clk", &clk_itr_length-&clk_input_length+1, &clk_input_length-1)==STRING.CUT("&clk", 1))
    ( 
      &match=1
    )
  )
  else if (&wild_tail==1)
  (
    if (STRING.MID("gcc_pcie_0_pipe_clk", 0, &clk_input_length-1)==STRING.CUT("&clk", -1))
    ( 
      &match=1
    )
  )
  else if ("gcc_pcie_0_pipe_clk"=="&clk")
  (
    &match=1
  )
  
  if (&match==1)
  (
    &clk_test=&CLK_TEST_GCC_PCIE_0_PIPE_CLK
    &clk_reg=&HWIO_GCC_PCIE_0_PIPE_CBCR_ADDR
    &clk_reg_name="GCC_PCIE_0_PIPE_CBCR"
    &clk_name="gcc_pcie_0_pipe_clk"
    &clk_reg_cbcr_type="sm_pscbc"
    &clk_vote_bit=28.
    &clk_multiplier=4.
    &clk_access_mode="&GCC_access_mode"

    gosub Print_Clk_Info_Line
  )

  &match=0
  &wild_head=0
  &wild_tail=0
  &clk_input_length=STRING.LENGTH("&clk")
  &clk_itr_length=STRING.LENGTH("gcc_mdss_pclk0_clk")

  if (STRING.SCAN("&clk", "*", 0)==0)
  (
    &wild_head=1
  )
  if (STRING.SCAN("&clk", "*", 1)==(STRING.LENGTH("&clk")-1))
  (
    &wild_tail=1
  )

  if ((&wild_head==1)&&(&wild_tail==1))
  (
    if (STRING.SCAN("gcc_mdss_pclk0_clk", STRING.MID("&clk", 1, &clk_input_length-2), 0)!=-1)
    ( 
      &match=1
    )
  )
  else if (&wild_head==1)
  (
    if (STRING.MID("gcc_mdss_pclk0_clk", &clk_itr_length-&clk_input_length+1, &clk_input_length-1)==STRING.CUT("&clk", 1))
    ( 
      &match=1
    )
  )
  else if (&wild_tail==1)
  (
    if (STRING.MID("gcc_mdss_pclk0_clk", 0, &clk_input_length-1)==STRING.CUT("&clk", -1))
    ( 
      &match=1
    )
  )
  else if ("gcc_mdss_pclk0_clk"=="&clk")
  (
    &match=1
  )
  
  if (&match==1)
  (
    &clk_test=&CLK_TEST_GCC_MDSS_PCLK0_CLK
    &clk_reg=&HWIO_GCC_MDSS_PCLK0_CBCR_ADDR
    &clk_reg_name="GCC_MDSS_PCLK0_CBCR"
    &clk_name="gcc_mdss_pclk0_clk"
    &clk_reg_cbcr_type="sm_cbc"
    &clk_vote_bit=-1.
    &clk_multiplier=4.
    &clk_access_mode="&GCC_access_mode"

    gosub Print_Clk_Info_Line
  )

  &match=0
  &wild_head=0
  &wild_tail=0
  &clk_input_length=STRING.LENGTH("&clk")
  &clk_itr_length=STRING.LENGTH("gcc_ahb_clk")

  if (STRING.SCAN("&clk", "*", 0)==0)
  (
    &wild_head=1
  )
  if (STRING.SCAN("&clk", "*", 1)==(STRING.LENGTH("&clk")-1))
  (
    &wild_tail=1
  )

  if ((&wild_head==1)&&(&wild_tail==1))
  (
    if (STRING.SCAN("gcc_ahb_clk", STRING.MID("&clk", 1, &clk_input_length-2), 0)!=-1)
    ( 
      &match=1
    )
  )
  else if (&wild_head==1)
  (
    if (STRING.MID("gcc_ahb_clk", &clk_itr_length-&clk_input_length+1, &clk_input_length-1)==STRING.CUT("&clk", 1))
    ( 
      &match=1
    )
  )
  else if (&wild_tail==1)
  (
    if (STRING.MID("gcc_ahb_clk", 0, &clk_input_length-1)==STRING.CUT("&clk", -1))
    ( 
      &match=1
    )
  )
  else if ("gcc_ahb_clk"=="&clk")
  (
    &match=1
  )
  
  if (&match==1)
  (
    &clk_test=&CLK_TEST_GCC_AHB_CLK
    &clk_reg=&HWIO_GCC_GCC_AHB_CBCR_ADDR
    &clk_reg_name="GCC_GCC_AHB_CBCR"
    &clk_name="gcc_ahb_clk"
    &clk_reg_cbcr_type="sm_cbc"
    &clk_vote_bit=-1.
    &clk_multiplier=4.
    &clk_access_mode="&GCC_access_mode"

    gosub Print_Clk_Info_Line
  )

  &match=0
  &wild_head=0
  &wild_tail=0
  &clk_input_length=STRING.LENGTH("&clk")
  &clk_itr_length=STRING.LENGTH("gcc_bimc_cfg_ahb_clk")

  if (STRING.SCAN("&clk", "*", 0)==0)
  (
    &wild_head=1
  )
  if (STRING.SCAN("&clk", "*", 1)==(STRING.LENGTH("&clk")-1))
  (
    &wild_tail=1
  )

  if ((&wild_head==1)&&(&wild_tail==1))
  (
    if (STRING.SCAN("gcc_bimc_cfg_ahb_clk", STRING.MID("&clk", 1, &clk_input_length-2), 0)!=-1)
    ( 
      &match=1
    )
  )
  else if (&wild_head==1)
  (
    if (STRING.MID("gcc_bimc_cfg_ahb_clk", &clk_itr_length-&clk_input_length+1, &clk_input_length-1)==STRING.CUT("&clk", 1))
    ( 
      &match=1
    )
  )
  else if (&wild_tail==1)
  (
    if (STRING.MID("gcc_bimc_cfg_ahb_clk", 0, &clk_input_length-1)==STRING.CUT("&clk", -1))
    ( 
      &match=1
    )
  )
  else if ("gcc_bimc_cfg_ahb_clk"=="&clk")
  (
    &match=1
  )
  
  if (&match==1)
  (
    &clk_test=&CLK_TEST_GCC_BIMC_CFG_AHB_CLK
    &clk_reg=&HWIO_GCC_BIMC_CFG_AHB_CBCR_ADDR
    &clk_reg_name="GCC_BIMC_CFG_AHB_CBCR"
    &clk_name="gcc_bimc_cfg_ahb_clk"
    &clk_reg_cbcr_type="sm_cbc"
    &clk_vote_bit=-1.
    &clk_multiplier=4.
    &clk_access_mode="&GCC_access_mode"

    gosub Print_Clk_Info_Line
  )

  &match=0
  &wild_head=0
  &wild_tail=0
  &clk_input_length=STRING.LENGTH("&clk")
  &clk_itr_length=STRING.LENGTH("gcc_blsp1_ahb_clk")

  if (STRING.SCAN("&clk", "*", 0)==0)
  (
    &wild_head=1
  )
  if (STRING.SCAN("&clk", "*", 1)==(STRING.LENGTH("&clk")-1))
  (
    &wild_tail=1
  )

  if ((&wild_head==1)&&(&wild_tail==1))
  (
    if (STRING.SCAN("gcc_blsp1_ahb_clk", STRING.MID("&clk", 1, &clk_input_length-2), 0)!=-1)
    ( 
      &match=1
    )
  )
  else if (&wild_head==1)
  (
    if (STRING.MID("gcc_blsp1_ahb_clk", &clk_itr_length-&clk_input_length+1, &clk_input_length-1)==STRING.CUT("&clk", 1))
    ( 
      &match=1
    )
  )
  else if (&wild_tail==1)
  (
    if (STRING.MID("gcc_blsp1_ahb_clk", 0, &clk_input_length-1)==STRING.CUT("&clk", -1))
    ( 
      &match=1
    )
  )
  else if ("gcc_blsp1_ahb_clk"=="&clk")
  (
    &match=1
  )
  
  if (&match==1)
  (
    &clk_test=&CLK_TEST_GCC_BLSP1_AHB_CLK
    &clk_reg=&HWIO_GCC_BLSP1_AHB_CBCR_ADDR
    &clk_reg_name="GCC_BLSP1_AHB_CBCR"
    &clk_name="gcc_blsp1_ahb_clk"
    &clk_reg_cbcr_type="sm_pscbc"
    &clk_vote_bit=10.
    &clk_multiplier=4.
    &clk_access_mode="&GCC_access_mode"

    gosub Print_Clk_Info_Line
  )

  &match=0
  &wild_head=0
  &wild_tail=0
  &clk_input_length=STRING.LENGTH("&clk")
  &clk_itr_length=STRING.LENGTH("gcc_blsp2_ahb_clk")

  if (STRING.SCAN("&clk", "*", 0)==0)
  (
    &wild_head=1
  )
  if (STRING.SCAN("&clk", "*", 1)==(STRING.LENGTH("&clk")-1))
  (
    &wild_tail=1
  )

  if ((&wild_head==1)&&(&wild_tail==1))
  (
    if (STRING.SCAN("gcc_blsp2_ahb_clk", STRING.MID("&clk", 1, &clk_input_length-2), 0)!=-1)
    ( 
      &match=1
    )
  )
  else if (&wild_head==1)
  (
    if (STRING.MID("gcc_blsp2_ahb_clk", &clk_itr_length-&clk_input_length+1, &clk_input_length-1)==STRING.CUT("&clk", 1))
    ( 
      &match=1
    )
  )
  else if (&wild_tail==1)
  (
    if (STRING.MID("gcc_blsp2_ahb_clk", 0, &clk_input_length-1)==STRING.CUT("&clk", -1))
    ( 
      &match=1
    )
  )
  else if ("gcc_blsp2_ahb_clk"=="&clk")
  (
    &match=1
  )
  
  if (&match==1)
  (
    &clk_test=&CLK_TEST_GCC_BLSP2_AHB_CLK
    &clk_reg=&HWIO_GCC_BLSP2_AHB_CBCR_ADDR
    &clk_reg_name="GCC_BLSP2_AHB_CBCR"
    &clk_name="gcc_blsp2_ahb_clk"
    &clk_reg_cbcr_type="sm_pscbc"
    &clk_vote_bit=20.
    &clk_multiplier=4.
    &clk_access_mode="&GCC_access_mode"

    gosub Print_Clk_Info_Line
  )

  &match=0
  &wild_head=0
  &wild_tail=0
  &clk_input_length=STRING.LENGTH("&clk")
  &clk_itr_length=STRING.LENGTH("gcc_boot_rom_ahb_clk")

  if (STRING.SCAN("&clk", "*", 0)==0)
  (
    &wild_head=1
  )
  if (STRING.SCAN("&clk", "*", 1)==(STRING.LENGTH("&clk")-1))
  (
    &wild_tail=1
  )

  if ((&wild_head==1)&&(&wild_tail==1))
  (
    if (STRING.SCAN("gcc_boot_rom_ahb_clk", STRING.MID("&clk", 1, &clk_input_length-2), 0)!=-1)
    ( 
      &match=1
    )
  )
  else if (&wild_head==1)
  (
    if (STRING.MID("gcc_boot_rom_ahb_clk", &clk_itr_length-&clk_input_length+1, &clk_input_length-1)==STRING.CUT("&clk", 1))
    ( 
      &match=1
    )
  )
  else if (&wild_tail==1)
  (
    if (STRING.MID("gcc_boot_rom_ahb_clk", 0, &clk_input_length-1)==STRING.CUT("&clk", -1))
    ( 
      &match=1
    )
  )
  else if ("gcc_boot_rom_ahb_clk"=="&clk")
  (
    &match=1
  )
  
  if (&match==1)
  (
    &clk_test=&CLK_TEST_GCC_BOOT_ROM_AHB_CLK
    &clk_reg=&HWIO_GCC_BOOT_ROM_AHB_CBCR_ADDR
    &clk_reg_name="GCC_BOOT_ROM_AHB_CBCR"
    &clk_name="gcc_boot_rom_ahb_clk"
    &clk_reg_cbcr_type="sm_pscbc"
    &clk_vote_bit=7.
    &clk_multiplier=4.
    &clk_access_mode="&GCC_access_mode"

    gosub Print_Clk_Info_Line
  )

  &match=0
  &wild_head=0
  &wild_tail=0
  &clk_input_length=STRING.LENGTH("&clk")
  &clk_itr_length=STRING.LENGTH("gcc_cdsp_cfg_ahb_clk")

  if (STRING.SCAN("&clk", "*", 0)==0)
  (
    &wild_head=1
  )
  if (STRING.SCAN("&clk", "*", 1)==(STRING.LENGTH("&clk")-1))
  (
    &wild_tail=1
  )

  if ((&wild_head==1)&&(&wild_tail==1))
  (
    if (STRING.SCAN("gcc_cdsp_cfg_ahb_clk", STRING.MID("&clk", 1, &clk_input_length-2), 0)!=-1)
    ( 
      &match=1
    )
  )
  else if (&wild_head==1)
  (
    if (STRING.MID("gcc_cdsp_cfg_ahb_clk", &clk_itr_length-&clk_input_length+1, &clk_input_length-1)==STRING.CUT("&clk", 1))
    ( 
      &match=1
    )
  )
  else if (&wild_tail==1)
  (
    if (STRING.MID("gcc_cdsp_cfg_ahb_clk", 0, &clk_input_length-1)==STRING.CUT("&clk", -1))
    ( 
      &match=1
    )
  )
  else if ("gcc_cdsp_cfg_ahb_clk"=="&clk")
  (
    &match=1
  )
  
  if (&match==1)
  (
    &clk_test=&CLK_TEST_GCC_CDSP_CFG_AHB_CLK
    &clk_reg=&HWIO_GCC_CDSP_CFG_AHB_CBCR_ADDR
    &clk_reg_name="GCC_CDSP_CFG_AHB_CBCR"
    &clk_name="gcc_cdsp_cfg_ahb_clk"
    &clk_reg_cbcr_type="sm_cbc"
    &clk_vote_bit=-1.
    &clk_multiplier=4.
    &clk_access_mode="&GCC_access_mode"

    gosub Print_Clk_Info_Line
  )

  &match=0
  &wild_head=0
  &wild_tail=0
  &clk_input_length=STRING.LENGTH("&clk")
  &clk_itr_length=STRING.LENGTH("gcc_crypto_ahb_clk")

  if (STRING.SCAN("&clk", "*", 0)==0)
  (
    &wild_head=1
  )
  if (STRING.SCAN("&clk", "*", 1)==(STRING.LENGTH("&clk")-1))
  (
    &wild_tail=1
  )

  if ((&wild_head==1)&&(&wild_tail==1))
  (
    if (STRING.SCAN("gcc_crypto_ahb_clk", STRING.MID("&clk", 1, &clk_input_length-2), 0)!=-1)
    ( 
      &match=1
    )
  )
  else if (&wild_head==1)
  (
    if (STRING.MID("gcc_crypto_ahb_clk", &clk_itr_length-&clk_input_length+1, &clk_input_length-1)==STRING.CUT("&clk", 1))
    ( 
      &match=1
    )
  )
  else if (&wild_tail==1)
  (
    if (STRING.MID("gcc_crypto_ahb_clk", 0, &clk_input_length-1)==STRING.CUT("&clk", -1))
    ( 
      &match=1
    )
  )
  else if ("gcc_crypto_ahb_clk"=="&clk")
  (
    &match=1
  )
  
  if (&match==1)
  (
    &clk_test=&CLK_TEST_GCC_CRYPTO_AHB_CLK
    &clk_reg=&HWIO_GCC_CRYPTO_AHB_CBCR_ADDR
    &clk_reg_name="GCC_CRYPTO_AHB_CBCR"
    &clk_name="gcc_crypto_ahb_clk"
    &clk_reg_cbcr_type="sm_cbc"
    &clk_vote_bit=0.
    &clk_multiplier=4.
    &clk_access_mode="&GCC_access_mode"

    gosub Print_Clk_Info_Line
  )

  &match=0
  &wild_head=0
  &wild_tail=0
  &clk_input_length=STRING.LENGTH("&clk")
  &clk_itr_length=STRING.LENGTH("gcc_crypto_axi_clk")

  if (STRING.SCAN("&clk", "*", 0)==0)
  (
    &wild_head=1
  )
  if (STRING.SCAN("&clk", "*", 1)==(STRING.LENGTH("&clk")-1))
  (
    &wild_tail=1
  )

  if ((&wild_head==1)&&(&wild_tail==1))
  (
    if (STRING.SCAN("gcc_crypto_axi_clk", STRING.MID("&clk", 1, &clk_input_length-2), 0)!=-1)
    ( 
      &match=1
    )
  )
  else if (&wild_head==1)
  (
    if (STRING.MID("gcc_crypto_axi_clk", &clk_itr_length-&clk_input_length+1, &clk_input_length-1)==STRING.CUT("&clk", 1))
    ( 
      &match=1
    )
  )
  else if (&wild_tail==1)
  (
    if (STRING.MID("gcc_crypto_axi_clk", 0, &clk_input_length-1)==STRING.CUT("&clk", -1))
    ( 
      &match=1
    )
  )
  else if ("gcc_crypto_axi_clk"=="&clk")
  (
    &match=1
  )
  
  if (&match==1)
  (
    &clk_test=&CLK_TEST_GCC_CRYPTO_AXI_CLK
    &clk_reg=&HWIO_GCC_CRYPTO_AXI_CBCR_ADDR
    &clk_reg_name="GCC_CRYPTO_AXI_CBCR"
    &clk_name="gcc_crypto_axi_clk"
    &clk_reg_cbcr_type="sm_cbc"
    &clk_vote_bit=1.
    &clk_multiplier=4.
    &clk_access_mode="&GCC_access_mode"

    gosub Print_Clk_Info_Line
  )

  &match=0
  &wild_head=0
  &wild_tail=0
  &clk_input_length=STRING.LENGTH("&clk")
  &clk_itr_length=STRING.LENGTH("gcc_dcc_clk")

  if (STRING.SCAN("&clk", "*", 0)==0)
  (
    &wild_head=1
  )
  if (STRING.SCAN("&clk", "*", 1)==(STRING.LENGTH("&clk")-1))
  (
    &wild_tail=1
  )

  if ((&wild_head==1)&&(&wild_tail==1))
  (
    if (STRING.SCAN("gcc_dcc_clk", STRING.MID("&clk", 1, &clk_input_length-2), 0)!=-1)
    ( 
      &match=1
    )
  )
  else if (&wild_head==1)
  (
    if (STRING.MID("gcc_dcc_clk", &clk_itr_length-&clk_input_length+1, &clk_input_length-1)==STRING.CUT("&clk", 1))
    ( 
      &match=1
    )
  )
  else if (&wild_tail==1)
  (
    if (STRING.MID("gcc_dcc_clk", 0, &clk_input_length-1)==STRING.CUT("&clk", -1))
    ( 
      &match=1
    )
  )
  else if ("gcc_dcc_clk"=="&clk")
  (
    &match=1
  )
  
  if (&match==1)
  (
    &clk_test=&CLK_TEST_GCC_DCC_CLK
    &clk_reg=&HWIO_GCC_DCC_CBCR_ADDR
    &clk_reg_name="GCC_DCC_CBCR"
    &clk_name="gcc_dcc_clk"
    &clk_reg_cbcr_type="sm_pscbc"
    &clk_vote_bit=-1.
    &clk_multiplier=4.
    &clk_access_mode="&GCC_access_mode"

    gosub Print_Clk_Info_Line
  )

  &match=0
  &wild_head=0
  &wild_tail=0
  &clk_input_length=STRING.LENGTH("&clk")
  &clk_itr_length=STRING.LENGTH("gcc_eth_slave_ahb_clk")

  if (STRING.SCAN("&clk", "*", 0)==0)
  (
    &wild_head=1
  )
  if (STRING.SCAN("&clk", "*", 1)==(STRING.LENGTH("&clk")-1))
  (
    &wild_tail=1
  )

  if ((&wild_head==1)&&(&wild_tail==1))
  (
    if (STRING.SCAN("gcc_eth_slave_ahb_clk", STRING.MID("&clk", 1, &clk_input_length-2), 0)!=-1)
    ( 
      &match=1
    )
  )
  else if (&wild_head==1)
  (
    if (STRING.MID("gcc_eth_slave_ahb_clk", &clk_itr_length-&clk_input_length+1, &clk_input_length-1)==STRING.CUT("&clk", 1))
    ( 
      &match=1
    )
  )
  else if (&wild_tail==1)
  (
    if (STRING.MID("gcc_eth_slave_ahb_clk", 0, &clk_input_length-1)==STRING.CUT("&clk", -1))
    ( 
      &match=1
    )
  )
  else if ("gcc_eth_slave_ahb_clk"=="&clk")
  (
    &match=1
  )
  
  if (&match==1)
  (
    &clk_test=&CLK_TEST_GCC_ETH_SLAVE_AHB_CLK
    &clk_reg=&HWIO_GCC_ETH_SLAVE_AHB_CBCR_ADDR
    &clk_reg_name="GCC_ETH_SLAVE_AHB_CBCR"
    &clk_name="gcc_eth_slave_ahb_clk"
    &clk_reg_cbcr_type="sm_cbc"
    &clk_vote_bit=-1.
    &clk_multiplier=4.
    &clk_access_mode="&GCC_access_mode"

    gosub Print_Clk_Info_Line
  )

  &match=0
  &wild_head=0
  &wild_tail=0
  &clk_input_length=STRING.LENGTH("&clk")
  &clk_itr_length=STRING.LENGTH("gcc_geni_ir_h_clk")

  if (STRING.SCAN("&clk", "*", 0)==0)
  (
    &wild_head=1
  )
  if (STRING.SCAN("&clk", "*", 1)==(STRING.LENGTH("&clk")-1))
  (
    &wild_tail=1
  )

  if ((&wild_head==1)&&(&wild_tail==1))
  (
    if (STRING.SCAN("gcc_geni_ir_h_clk", STRING.MID("&clk", 1, &clk_input_length-2), 0)!=-1)
    ( 
      &match=1
    )
  )
  else if (&wild_head==1)
  (
    if (STRING.MID("gcc_geni_ir_h_clk", &clk_itr_length-&clk_input_length+1, &clk_input_length-1)==STRING.CUT("&clk", 1))
    ( 
      &match=1
    )
  )
  else if (&wild_tail==1)
  (
    if (STRING.MID("gcc_geni_ir_h_clk", 0, &clk_input_length-1)==STRING.CUT("&clk", -1))
    ( 
      &match=1
    )
  )
  else if ("gcc_geni_ir_h_clk"=="&clk")
  (
    &match=1
  )
  
  if (&match==1)
  (
    &clk_test=&CLK_TEST_GCC_GENI_IR_H_CLK
    &clk_reg=0
    &clk_reg_name="No CBCR"
    &clk_name="gcc_geni_ir_h_clk"
    &clk_reg_cbcr_type=""
    &clk_vote_bit=-1.
    &clk_multiplier=4.
    &clk_access_mode="&GCC_access_mode"

    gosub Print_Clk_Info_Line
  )

  &match=0
  &wild_head=0
  &wild_tail=0
  &clk_input_length=STRING.LENGTH("&clk")
  &clk_itr_length=STRING.LENGTH("gcc_geni_ir_xpu_clk")

  if (STRING.SCAN("&clk", "*", 0)==0)
  (
    &wild_head=1
  )
  if (STRING.SCAN("&clk", "*", 1)==(STRING.LENGTH("&clk")-1))
  (
    &wild_tail=1
  )

  if ((&wild_head==1)&&(&wild_tail==1))
  (
    if (STRING.SCAN("gcc_geni_ir_xpu_clk", STRING.MID("&clk", 1, &clk_input_length-2), 0)!=-1)
    ( 
      &match=1
    )
  )
  else if (&wild_head==1)
  (
    if (STRING.MID("gcc_geni_ir_xpu_clk", &clk_itr_length-&clk_input_length+1, &clk_input_length-1)==STRING.CUT("&clk", 1))
    ( 
      &match=1
    )
  )
  else if (&wild_tail==1)
  (
    if (STRING.MID("gcc_geni_ir_xpu_clk", 0, &clk_input_length-1)==STRING.CUT("&clk", -1))
    ( 
      &match=1
    )
  )
  else if ("gcc_geni_ir_xpu_clk"=="&clk")
  (
    &match=1
  )
  
  if (&match==1)
  (
    &clk_test=&CLK_TEST_GCC_GENI_IR_XPU_CLK
    &clk_reg=&HWIO_GCC_GENI_IR_XPU_CBCR_ADDR
    &clk_reg_name="GCC_GENI_IR_XPU_CBCR"
    &clk_name="gcc_geni_ir_xpu_clk"
    &clk_reg_cbcr_type="sm_cbc"
    &clk_vote_bit=-1.
    &clk_multiplier=4.
    &clk_access_mode="&GCC_access_mode"

    gosub Print_Clk_Info_Line
  )

  &match=0
  &wild_head=0
  &wild_tail=0
  &clk_input_length=STRING.LENGTH("&clk")
  &clk_itr_length=STRING.LENGTH("gcc_gtcu_ahb_clk")

  if (STRING.SCAN("&clk", "*", 0)==0)
  (
    &wild_head=1
  )
  if (STRING.SCAN("&clk", "*", 1)==(STRING.LENGTH("&clk")-1))
  (
    &wild_tail=1
  )

  if ((&wild_head==1)&&(&wild_tail==1))
  (
    if (STRING.SCAN("gcc_gtcu_ahb_clk", STRING.MID("&clk", 1, &clk_input_length-2), 0)!=-1)
    ( 
      &match=1
    )
  )
  else if (&wild_head==1)
  (
    if (STRING.MID("gcc_gtcu_ahb_clk", &clk_itr_length-&clk_input_length+1, &clk_input_length-1)==STRING.CUT("&clk", 1))
    ( 
      &match=1
    )
  )
  else if (&wild_tail==1)
  (
    if (STRING.MID("gcc_gtcu_ahb_clk", 0, &clk_input_length-1)==STRING.CUT("&clk", -1))
    ( 
      &match=1
    )
  )
  else if ("gcc_gtcu_ahb_clk"=="&clk")
  (
    &match=1
  )
  
  if (&match==1)
  (
    &clk_test=&CLK_TEST_GCC_GTCU_AHB_CLK
    &clk_reg=&HWIO_GCC_GTCU_AHB_CBCR_ADDR
    &clk_reg_name="GCC_GTCU_AHB_CBCR"
    &clk_name="gcc_gtcu_ahb_clk"
    &clk_reg_cbcr_type="sm_cbc"
    &clk_vote_bit=13.
    &clk_multiplier=4.
    &clk_access_mode="&GCC_access_mode"

    gosub Print_Clk_Info_Line
  )

  &match=0
  &wild_head=0
  &wild_tail=0
  &clk_input_length=STRING.LENGTH("&clk")
  &clk_itr_length=STRING.LENGTH("gcc_imem_cfg_ahb_clk")

  if (STRING.SCAN("&clk", "*", 0)==0)
  (
    &wild_head=1
  )
  if (STRING.SCAN("&clk", "*", 1)==(STRING.LENGTH("&clk")-1))
  (
    &wild_tail=1
  )

  if ((&wild_head==1)&&(&wild_tail==1))
  (
    if (STRING.SCAN("gcc_imem_cfg_ahb_clk", STRING.MID("&clk", 1, &clk_input_length-2), 0)!=-1)
    ( 
      &match=1
    )
  )
  else if (&wild_head==1)
  (
    if (STRING.MID("gcc_imem_cfg_ahb_clk", &clk_itr_length-&clk_input_length+1, &clk_input_length-1)==STRING.CUT("&clk", 1))
    ( 
      &match=1
    )
  )
  else if (&wild_tail==1)
  (
    if (STRING.MID("gcc_imem_cfg_ahb_clk", 0, &clk_input_length-1)==STRING.CUT("&clk", -1))
    ( 
      &match=1
    )
  )
  else if ("gcc_imem_cfg_ahb_clk"=="&clk")
  (
    &match=1
  )
  
  if (&match==1)
  (
    &clk_test=&CLK_TEST_GCC_IMEM_CFG_AHB_CLK
    &clk_reg=&HWIO_GCC_IMEM_CFG_AHB_CBCR_ADDR
    &clk_reg_name="GCC_IMEM_CFG_AHB_CBCR"
    &clk_name="gcc_imem_cfg_ahb_clk"
    &clk_reg_cbcr_type="sm_cbc"
    &clk_vote_bit=-1.
    &clk_multiplier=4.
    &clk_access_mode="&GCC_access_mode"

    gosub Print_Clk_Info_Line
  )

  &match=0
  &wild_head=0
  &wild_tail=0
  &clk_input_length=STRING.LENGTH("&clk")
  &clk_itr_length=STRING.LENGTH("gcc_lpass_agnoc_cfg_clk")

  if (STRING.SCAN("&clk", "*", 0)==0)
  (
    &wild_head=1
  )
  if (STRING.SCAN("&clk", "*", 1)==(STRING.LENGTH("&clk")-1))
  (
    &wild_tail=1
  )

  if ((&wild_head==1)&&(&wild_tail==1))
  (
    if (STRING.SCAN("gcc_lpass_agnoc_cfg_clk", STRING.MID("&clk", 1, &clk_input_length-2), 0)!=-1)
    ( 
      &match=1
    )
  )
  else if (&wild_head==1)
  (
    if (STRING.MID("gcc_lpass_agnoc_cfg_clk", &clk_itr_length-&clk_input_length+1, &clk_input_length-1)==STRING.CUT("&clk", 1))
    ( 
      &match=1
    )
  )
  else if (&wild_tail==1)
  (
    if (STRING.MID("gcc_lpass_agnoc_cfg_clk", 0, &clk_input_length-1)==STRING.CUT("&clk", -1))
    ( 
      &match=1
    )
  )
  else if ("gcc_lpass_agnoc_cfg_clk"=="&clk")
  (
    &match=1
  )
  
  if (&match==1)
  (
    &clk_test=&CLK_TEST_GCC_LPASS_AGNOC_CFG_CLK
    &clk_reg=&HWIO_GCC_LPASS_AGNOC_CFG_CBCR_ADDR
    &clk_reg_name="GCC_LPASS_AGNOC_CFG_CBCR"
    &clk_name="gcc_lpass_agnoc_cfg_clk"
    &clk_reg_cbcr_type="sm_cbc"
    &clk_vote_bit=-1.
    &clk_multiplier=4.
    &clk_access_mode="&GCC_access_mode"

    gosub Print_Clk_Info_Line
  )

  &match=0
  &wild_head=0
  &wild_tail=0
  &clk_input_length=STRING.LENGTH("&clk")
  &clk_itr_length=STRING.LENGTH("gcc_lpass_agnoc_mpu_cfg_clk")

  if (STRING.SCAN("&clk", "*", 0)==0)
  (
    &wild_head=1
  )
  if (STRING.SCAN("&clk", "*", 1)==(STRING.LENGTH("&clk")-1))
  (
    &wild_tail=1
  )

  if ((&wild_head==1)&&(&wild_tail==1))
  (
    if (STRING.SCAN("gcc_lpass_agnoc_mpu_cfg_clk", STRING.MID("&clk", 1, &clk_input_length-2), 0)!=-1)
    ( 
      &match=1
    )
  )
  else if (&wild_head==1)
  (
    if (STRING.MID("gcc_lpass_agnoc_mpu_cfg_clk", &clk_itr_length-&clk_input_length+1, &clk_input_length-1)==STRING.CUT("&clk", 1))
    ( 
      &match=1
    )
  )
  else if (&wild_tail==1)
  (
    if (STRING.MID("gcc_lpass_agnoc_mpu_cfg_clk", 0, &clk_input_length-1)==STRING.CUT("&clk", -1))
    ( 
      &match=1
    )
  )
  else if ("gcc_lpass_agnoc_mpu_cfg_clk"=="&clk")
  (
    &match=1
  )
  
  if (&match==1)
  (
    &clk_test=&CLK_TEST_GCC_LPASS_AGNOC_MPU_CFG_CLK
    &clk_reg=&HWIO_GCC_LPASS_AGNOC_MPU_CFG_CBCR_ADDR
    &clk_reg_name="GCC_LPASS_AGNOC_MPU_CFG_CBCR"
    &clk_name="gcc_lpass_agnoc_mpu_cfg_clk"
    &clk_reg_cbcr_type="sm_cbc"
    &clk_vote_bit=-1.
    &clk_multiplier=4.
    &clk_access_mode="&GCC_access_mode"

    gosub Print_Clk_Info_Line
  )

  &match=0
  &wild_head=0
  &wild_tail=0
  &clk_input_length=STRING.LENGTH("&clk")
  &clk_itr_length=STRING.LENGTH("gcc_lpass_mpu_cfg_clk")

  if (STRING.SCAN("&clk", "*", 0)==0)
  (
    &wild_head=1
  )
  if (STRING.SCAN("&clk", "*", 1)==(STRING.LENGTH("&clk")-1))
  (
    &wild_tail=1
  )

  if ((&wild_head==1)&&(&wild_tail==1))
  (
    if (STRING.SCAN("gcc_lpass_mpu_cfg_clk", STRING.MID("&clk", 1, &clk_input_length-2), 0)!=-1)
    ( 
      &match=1
    )
  )
  else if (&wild_head==1)
  (
    if (STRING.MID("gcc_lpass_mpu_cfg_clk", &clk_itr_length-&clk_input_length+1, &clk_input_length-1)==STRING.CUT("&clk", 1))
    ( 
      &match=1
    )
  )
  else if (&wild_tail==1)
  (
    if (STRING.MID("gcc_lpass_mpu_cfg_clk", 0, &clk_input_length-1)==STRING.CUT("&clk", -1))
    ( 
      &match=1
    )
  )
  else if ("gcc_lpass_mpu_cfg_clk"=="&clk")
  (
    &match=1
  )
  
  if (&match==1)
  (
    &clk_test=&CLK_TEST_GCC_LPASS_MPU_CFG_CLK
    &clk_reg=&HWIO_GCC_LPASS_MPU_CFG_CBCR_ADDR
    &clk_reg_name="GCC_LPASS_MPU_CFG_CBCR"
    &clk_name="gcc_lpass_mpu_cfg_clk"
    &clk_reg_cbcr_type="sm_cbc"
    &clk_vote_bit=-1.
    &clk_multiplier=4.
    &clk_access_mode="&GCC_access_mode"

    gosub Print_Clk_Info_Line
  )

  &match=0
  &wild_head=0
  &wild_tail=0
  &clk_input_length=STRING.LENGTH("&clk")
  &clk_itr_length=STRING.LENGTH("gcc_mdss_ahb_clk")

  if (STRING.SCAN("&clk", "*", 0)==0)
  (
    &wild_head=1
  )
  if (STRING.SCAN("&clk", "*", 1)==(STRING.LENGTH("&clk")-1))
  (
    &wild_tail=1
  )

  if ((&wild_head==1)&&(&wild_tail==1))
  (
    if (STRING.SCAN("gcc_mdss_ahb_clk", STRING.MID("&clk", 1, &clk_input_length-2), 0)!=-1)
    ( 
      &match=1
    )
  )
  else if (&wild_head==1)
  (
    if (STRING.MID("gcc_mdss_ahb_clk", &clk_itr_length-&clk_input_length+1, &clk_input_length-1)==STRING.CUT("&clk", 1))
    ( 
      &match=1
    )
  )
  else if (&wild_tail==1)
  (
    if (STRING.MID("gcc_mdss_ahb_clk", 0, &clk_input_length-1)==STRING.CUT("&clk", -1))
    ( 
      &match=1
    )
  )
  else if ("gcc_mdss_ahb_clk"=="&clk")
  (
    &match=1
  )
  
  if (&match==1)
  (
    &clk_test=&CLK_TEST_GCC_MDSS_AHB_CLK
    &clk_reg=&HWIO_GCC_MDSS_AHB_CBCR_ADDR
    &clk_reg_name="GCC_MDSS_AHB_CBCR"
    &clk_name="gcc_mdss_ahb_clk"
    &clk_reg_cbcr_type="sm_cbc"
    &clk_vote_bit=-1.
    &clk_multiplier=4.
    &clk_access_mode="&GCC_access_mode"

    gosub Print_Clk_Info_Line
  )

  &match=0
  &wild_head=0
  &wild_tail=0
  &clk_input_length=STRING.LENGTH("&clk")
  &clk_itr_length=STRING.LENGTH("gcc_mpm_ahb_clk")

  if (STRING.SCAN("&clk", "*", 0)==0)
  (
    &wild_head=1
  )
  if (STRING.SCAN("&clk", "*", 1)==(STRING.LENGTH("&clk")-1))
  (
    &wild_tail=1
  )

  if ((&wild_head==1)&&(&wild_tail==1))
  (
    if (STRING.SCAN("gcc_mpm_ahb_clk", STRING.MID("&clk", 1, &clk_input_length-2), 0)!=-1)
    ( 
      &match=1
    )
  )
  else if (&wild_head==1)
  (
    if (STRING.MID("gcc_mpm_ahb_clk", &clk_itr_length-&clk_input_length+1, &clk_input_length-1)==STRING.CUT("&clk", 1))
    ( 
      &match=1
    )
  )
  else if (&wild_tail==1)
  (
    if (STRING.MID("gcc_mpm_ahb_clk", 0, &clk_input_length-1)==STRING.CUT("&clk", -1))
    ( 
      &match=1
    )
  )
  else if ("gcc_mpm_ahb_clk"=="&clk")
  (
    &match=1
  )
  
  if (&match==1)
  (
    &clk_test=&CLK_TEST_GCC_MPM_AHB_CLK
    &clk_reg=&HWIO_GCC_MPM_AHB_CBCR_ADDR
    &clk_reg_name="GCC_MPM_AHB_CBCR"
    &clk_name="gcc_mpm_ahb_clk"
    &clk_reg_cbcr_type="sm_cbc"
    &clk_vote_bit=12.
    &clk_multiplier=4.
    &clk_access_mode="&GCC_access_mode"

    gosub Print_Clk_Info_Line
  )

  &match=0
  &wild_head=0
  &wild_tail=0
  &clk_input_length=STRING.LENGTH("&clk")
  &clk_itr_length=STRING.LENGTH("gcc_msg_ram_ahb_clk")

  if (STRING.SCAN("&clk", "*", 0)==0)
  (
    &wild_head=1
  )
  if (STRING.SCAN("&clk", "*", 1)==(STRING.LENGTH("&clk")-1))
  (
    &wild_tail=1
  )

  if ((&wild_head==1)&&(&wild_tail==1))
  (
    if (STRING.SCAN("gcc_msg_ram_ahb_clk", STRING.MID("&clk", 1, &clk_input_length-2), 0)!=-1)
    ( 
      &match=1
    )
  )
  else if (&wild_head==1)
  (
    if (STRING.MID("gcc_msg_ram_ahb_clk", &clk_itr_length-&clk_input_length+1, &clk_input_length-1)==STRING.CUT("&clk", 1))
    ( 
      &match=1
    )
  )
  else if (&wild_tail==1)
  (
    if (STRING.MID("gcc_msg_ram_ahb_clk", 0, &clk_input_length-1)==STRING.CUT("&clk", -1))
    ( 
      &match=1
    )
  )
  else if ("gcc_msg_ram_ahb_clk"=="&clk")
  (
    &match=1
  )
  
  if (&match==1)
  (
    &clk_test=&CLK_TEST_GCC_MSG_RAM_AHB_CLK
    &clk_reg=&HWIO_GCC_MSG_RAM_AHB_CBCR_ADDR
    &clk_reg_name="GCC_MSG_RAM_AHB_CBCR"
    &clk_name="gcc_msg_ram_ahb_clk"
    &clk_reg_cbcr_type="sm_pscbc"
    &clk_vote_bit=6.
    &clk_multiplier=4.
    &clk_access_mode="&GCC_access_mode"

    gosub Print_Clk_Info_Line
  )

  &match=0
  &wild_head=0
  &wild_tail=0
  &clk_input_length=STRING.LENGTH("&clk")
  &clk_itr_length=STRING.LENGTH("gcc_noc_conf_xpu_ahb_clk")

  if (STRING.SCAN("&clk", "*", 0)==0)
  (
    &wild_head=1
  )
  if (STRING.SCAN("&clk", "*", 1)==(STRING.LENGTH("&clk")-1))
  (
    &wild_tail=1
  )

  if ((&wild_head==1)&&(&wild_tail==1))
  (
    if (STRING.SCAN("gcc_noc_conf_xpu_ahb_clk", STRING.MID("&clk", 1, &clk_input_length-2), 0)!=-1)
    ( 
      &match=1
    )
  )
  else if (&wild_head==1)
  (
    if (STRING.MID("gcc_noc_conf_xpu_ahb_clk", &clk_itr_length-&clk_input_length+1, &clk_input_length-1)==STRING.CUT("&clk", 1))
    ( 
      &match=1
    )
  )
  else if (&wild_tail==1)
  (
    if (STRING.MID("gcc_noc_conf_xpu_ahb_clk", 0, &clk_input_length-1)==STRING.CUT("&clk", -1))
    ( 
      &match=1
    )
  )
  else if ("gcc_noc_conf_xpu_ahb_clk"=="&clk")
  (
    &match=1
  )
  
  if (&match==1)
  (
    &clk_test=&CLK_TEST_GCC_NOC_CONF_XPU_AHB_CLK
    &clk_reg=&HWIO_GCC_NOC_CONF_XPU_AHB_CBCR_ADDR
    &clk_reg_name="GCC_NOC_CONF_XPU_AHB_CBCR"
    &clk_name="gcc_noc_conf_xpu_ahb_clk"
    &clk_reg_cbcr_type="sm_cbc"
    &clk_vote_bit=-1.
    &clk_multiplier=4.
    &clk_access_mode="&GCC_access_mode"

    gosub Print_Clk_Info_Line
  )

  &match=0
  &wild_head=0
  &wild_tail=0
  &clk_input_length=STRING.LENGTH("&clk")
  &clk_itr_length=STRING.LENGTH("gcc_oxili_ahb_clk")

  if (STRING.SCAN("&clk", "*", 0)==0)
  (
    &wild_head=1
  )
  if (STRING.SCAN("&clk", "*", 1)==(STRING.LENGTH("&clk")-1))
  (
    &wild_tail=1
  )

  if ((&wild_head==1)&&(&wild_tail==1))
  (
    if (STRING.SCAN("gcc_oxili_ahb_clk", STRING.MID("&clk", 1, &clk_input_length-2), 0)!=-1)
    ( 
      &match=1
    )
  )
  else if (&wild_head==1)
  (
    if (STRING.MID("gcc_oxili_ahb_clk", &clk_itr_length-&clk_input_length+1, &clk_input_length-1)==STRING.CUT("&clk", 1))
    ( 
      &match=1
    )
  )
  else if (&wild_tail==1)
  (
    if (STRING.MID("gcc_oxili_ahb_clk", 0, &clk_input_length-1)==STRING.CUT("&clk", -1))
    ( 
      &match=1
    )
  )
  else if ("gcc_oxili_ahb_clk"=="&clk")
  (
    &match=1
  )
  
  if (&match==1)
  (
    &clk_test=&CLK_TEST_GCC_OXILI_AHB_CLK
    &clk_reg=&HWIO_GCC_OXILI_AHB_CBCR_ADDR
    &clk_reg_name="GCC_OXILI_AHB_CBCR"
    &clk_name="gcc_oxili_ahb_clk"
    &clk_reg_cbcr_type="sm_cbc"
    &clk_vote_bit=-1.
    &clk_multiplier=4.
    &clk_access_mode="&GCC_access_mode"

    gosub Print_Clk_Info_Line
  )

  &match=0
  &wild_head=0
  &wild_tail=0
  &clk_input_length=STRING.LENGTH("&clk")
  &clk_itr_length=STRING.LENGTH("gcc_pcie_0_cfg_ahb_clk")

  if (STRING.SCAN("&clk", "*", 0)==0)
  (
    &wild_head=1
  )
  if (STRING.SCAN("&clk", "*", 1)==(STRING.LENGTH("&clk")-1))
  (
    &wild_tail=1
  )

  if ((&wild_head==1)&&(&wild_tail==1))
  (
    if (STRING.SCAN("gcc_pcie_0_cfg_ahb_clk", STRING.MID("&clk", 1, &clk_input_length-2), 0)!=-1)
    ( 
      &match=1
    )
  )
  else if (&wild_head==1)
  (
    if (STRING.MID("gcc_pcie_0_cfg_ahb_clk", &clk_itr_length-&clk_input_length+1, &clk_input_length-1)==STRING.CUT("&clk", 1))
    ( 
      &match=1
    )
  )
  else if (&wild_tail==1)
  (
    if (STRING.MID("gcc_pcie_0_cfg_ahb_clk", 0, &clk_input_length-1)==STRING.CUT("&clk", -1))
    ( 
      &match=1
    )
  )
  else if ("gcc_pcie_0_cfg_ahb_clk"=="&clk")
  (
    &match=1
  )
  
  if (&match==1)
  (
    &clk_test=&CLK_TEST_GCC_PCIE_0_CFG_AHB_CLK
    &clk_reg=&HWIO_GCC_PCIE_0_CFG_AHB_CBCR_ADDR
    &clk_reg_name="GCC_PCIE_0_CFG_AHB_CBCR"
    &clk_name="gcc_pcie_0_cfg_ahb_clk"
    &clk_reg_cbcr_type="sm_cbc"
    &clk_vote_bit=11.
    &clk_multiplier=4.
    &clk_access_mode="&GCC_access_mode"

    gosub Print_Clk_Info_Line
  )

  &match=0
  &wild_head=0
  &wild_tail=0
  &clk_input_length=STRING.LENGTH("&clk")
  &clk_itr_length=STRING.LENGTH("gcc_pcnoc_ahb_clk")

  if (STRING.SCAN("&clk", "*", 0)==0)
  (
    &wild_head=1
  )
  if (STRING.SCAN("&clk", "*", 1)==(STRING.LENGTH("&clk")-1))
  (
    &wild_tail=1
  )

  if ((&wild_head==1)&&(&wild_tail==1))
  (
    if (STRING.SCAN("gcc_pcnoc_ahb_clk", STRING.MID("&clk", 1, &clk_input_length-2), 0)!=-1)
    ( 
      &match=1
    )
  )
  else if (&wild_head==1)
  (
    if (STRING.MID("gcc_pcnoc_ahb_clk", &clk_itr_length-&clk_input_length+1, &clk_input_length-1)==STRING.CUT("&clk", 1))
    ( 
      &match=1
    )
  )
  else if (&wild_tail==1)
  (
    if (STRING.MID("gcc_pcnoc_ahb_clk", 0, &clk_input_length-1)==STRING.CUT("&clk", -1))
    ( 
      &match=1
    )
  )
  else if ("gcc_pcnoc_ahb_clk"=="&clk")
  (
    &match=1
  )
  
  if (&match==1)
  (
    &clk_test=&CLK_TEST_GCC_PCNOC_AHB_CLK
    &clk_reg=&HWIO_GCC_PCNOC_AHB_CBCR_ADDR
    &clk_reg_name="GCC_PCNOC_AHB_CBCR"
    &clk_name="gcc_pcnoc_ahb_clk"
    &clk_reg_cbcr_type="sm_cbc"
    &clk_vote_bit=-1.
    &clk_multiplier=4.
    &clk_access_mode="&GCC_access_mode"

    gosub Print_Clk_Info_Line
  )

  &match=0
  &wild_head=0
  &wild_tail=0
  &clk_input_length=STRING.LENGTH("&clk")
  &clk_itr_length=STRING.LENGTH("gcc_pcnoc_bus_timeout0_ahb_clk")

  if (STRING.SCAN("&clk", "*", 0)==0)
  (
    &wild_head=1
  )
  if (STRING.SCAN("&clk", "*", 1)==(STRING.LENGTH("&clk")-1))
  (
    &wild_tail=1
  )

  if ((&wild_head==1)&&(&wild_tail==1))
  (
    if (STRING.SCAN("gcc_pcnoc_bus_timeout0_ahb_clk", STRING.MID("&clk", 1, &clk_input_length-2), 0)!=-1)
    ( 
      &match=1
    )
  )
  else if (&wild_head==1)
  (
    if (STRING.MID("gcc_pcnoc_bus_timeout0_ahb_clk", &clk_itr_length-&clk_input_length+1, &clk_input_length-1)==STRING.CUT("&clk", 1))
    ( 
      &match=1
    )
  )
  else if (&wild_tail==1)
  (
    if (STRING.MID("gcc_pcnoc_bus_timeout0_ahb_clk", 0, &clk_input_length-1)==STRING.CUT("&clk", -1))
    ( 
      &match=1
    )
  )
  else if ("gcc_pcnoc_bus_timeout0_ahb_clk"=="&clk")
  (
    &match=1
  )
  
  if (&match==1)
  (
    &clk_test=&CLK_TEST_GCC_PCNOC_BUS_TIMEOUT0_AHB_CLK
    &clk_reg=&HWIO_GCC_PCNOC_BUS_TIMEOUT0_AHB_CBCR_ADDR
    &clk_reg_name="GCC_PCNOC_BUS_TIMEOUT0_AHB_CBCR"
    &clk_name="gcc_pcnoc_bus_timeout0_ahb_clk"
    &clk_reg_cbcr_type="sm_cbc"
    &clk_vote_bit=-1.
    &clk_multiplier=4.
    &clk_access_mode="&GCC_access_mode"

    gosub Print_Clk_Info_Line
  )

  &match=0
  &wild_head=0
  &wild_tail=0
  &clk_input_length=STRING.LENGTH("&clk")
  &clk_itr_length=STRING.LENGTH("gcc_pcnoc_bus_timeout1_ahb_clk")

  if (STRING.SCAN("&clk", "*", 0)==0)
  (
    &wild_head=1
  )
  if (STRING.SCAN("&clk", "*", 1)==(STRING.LENGTH("&clk")-1))
  (
    &wild_tail=1
  )

  if ((&wild_head==1)&&(&wild_tail==1))
  (
    if (STRING.SCAN("gcc_pcnoc_bus_timeout1_ahb_clk", STRING.MID("&clk", 1, &clk_input_length-2), 0)!=-1)
    ( 
      &match=1
    )
  )
  else if (&wild_head==1)
  (
    if (STRING.MID("gcc_pcnoc_bus_timeout1_ahb_clk", &clk_itr_length-&clk_input_length+1, &clk_input_length-1)==STRING.CUT("&clk", 1))
    ( 
      &match=1
    )
  )
  else if (&wild_tail==1)
  (
    if (STRING.MID("gcc_pcnoc_bus_timeout1_ahb_clk", 0, &clk_input_length-1)==STRING.CUT("&clk", -1))
    ( 
      &match=1
    )
  )
  else if ("gcc_pcnoc_bus_timeout1_ahb_clk"=="&clk")
  (
    &match=1
  )
  
  if (&match==1)
  (
    &clk_test=&CLK_TEST_GCC_PCNOC_BUS_TIMEOUT1_AHB_CLK
    &clk_reg=&HWIO_GCC_PCNOC_BUS_TIMEOUT1_AHB_CBCR_ADDR
    &clk_reg_name="GCC_PCNOC_BUS_TIMEOUT1_AHB_CBCR"
    &clk_name="gcc_pcnoc_bus_timeout1_ahb_clk"
    &clk_reg_cbcr_type="sm_cbc"
    &clk_vote_bit=-1.
    &clk_multiplier=4.
    &clk_access_mode="&GCC_access_mode"

    gosub Print_Clk_Info_Line
  )

  &match=0
  &wild_head=0
  &wild_tail=0
  &clk_input_length=STRING.LENGTH("&clk")
  &clk_itr_length=STRING.LENGTH("gcc_pcnoc_bus_timeout2_ahb_clk")

  if (STRING.SCAN("&clk", "*", 0)==0)
  (
    &wild_head=1
  )
  if (STRING.SCAN("&clk", "*", 1)==(STRING.LENGTH("&clk")-1))
  (
    &wild_tail=1
  )

  if ((&wild_head==1)&&(&wild_tail==1))
  (
    if (STRING.SCAN("gcc_pcnoc_bus_timeout2_ahb_clk", STRING.MID("&clk", 1, &clk_input_length-2), 0)!=-1)
    ( 
      &match=1
    )
  )
  else if (&wild_head==1)
  (
    if (STRING.MID("gcc_pcnoc_bus_timeout2_ahb_clk", &clk_itr_length-&clk_input_length+1, &clk_input_length-1)==STRING.CUT("&clk", 1))
    ( 
      &match=1
    )
  )
  else if (&wild_tail==1)
  (
    if (STRING.MID("gcc_pcnoc_bus_timeout2_ahb_clk", 0, &clk_input_length-1)==STRING.CUT("&clk", -1))
    ( 
      &match=1
    )
  )
  else if ("gcc_pcnoc_bus_timeout2_ahb_clk"=="&clk")
  (
    &match=1
  )
  
  if (&match==1)
  (
    &clk_test=&CLK_TEST_GCC_PCNOC_BUS_TIMEOUT2_AHB_CLK
    &clk_reg=&HWIO_GCC_PCNOC_BUS_TIMEOUT2_AHB_CBCR_ADDR
    &clk_reg_name="GCC_PCNOC_BUS_TIMEOUT2_AHB_CBCR"
    &clk_name="gcc_pcnoc_bus_timeout2_ahb_clk"
    &clk_reg_cbcr_type="sm_cbc"
    &clk_vote_bit=-1.
    &clk_multiplier=4.
    &clk_access_mode="&GCC_access_mode"

    gosub Print_Clk_Info_Line
  )

  &match=0
  &wild_head=0
  &wild_tail=0
  &clk_input_length=STRING.LENGTH("&clk")
  &clk_itr_length=STRING.LENGTH("gcc_pcnoc_bus_timeout3_ahb_clk")

  if (STRING.SCAN("&clk", "*", 0)==0)
  (
    &wild_head=1
  )
  if (STRING.SCAN("&clk", "*", 1)==(STRING.LENGTH("&clk")-1))
  (
    &wild_tail=1
  )

  if ((&wild_head==1)&&(&wild_tail==1))
  (
    if (STRING.SCAN("gcc_pcnoc_bus_timeout3_ahb_clk", STRING.MID("&clk", 1, &clk_input_length-2), 0)!=-1)
    ( 
      &match=1
    )
  )
  else if (&wild_head==1)
  (
    if (STRING.MID("gcc_pcnoc_bus_timeout3_ahb_clk", &clk_itr_length-&clk_input_length+1, &clk_input_length-1)==STRING.CUT("&clk", 1))
    ( 
      &match=1
    )
  )
  else if (&wild_tail==1)
  (
    if (STRING.MID("gcc_pcnoc_bus_timeout3_ahb_clk", 0, &clk_input_length-1)==STRING.CUT("&clk", -1))
    ( 
      &match=1
    )
  )
  else if ("gcc_pcnoc_bus_timeout3_ahb_clk"=="&clk")
  (
    &match=1
  )
  
  if (&match==1)
  (
    &clk_test=&CLK_TEST_GCC_PCNOC_BUS_TIMEOUT3_AHB_CLK
    &clk_reg=&HWIO_GCC_PCNOC_BUS_TIMEOUT3_AHB_CBCR_ADDR
    &clk_reg_name="GCC_PCNOC_BUS_TIMEOUT3_AHB_CBCR"
    &clk_name="gcc_pcnoc_bus_timeout3_ahb_clk"
    &clk_reg_cbcr_type="sm_cbc"
    &clk_vote_bit=-1.
    &clk_multiplier=4.
    &clk_access_mode="&GCC_access_mode"

    gosub Print_Clk_Info_Line
  )

  &match=0
  &wild_head=0
  &wild_tail=0
  &clk_input_length=STRING.LENGTH("&clk")
  &clk_itr_length=STRING.LENGTH("gcc_pcnoc_bus_timeout4_ahb_clk")

  if (STRING.SCAN("&clk", "*", 0)==0)
  (
    &wild_head=1
  )
  if (STRING.SCAN("&clk", "*", 1)==(STRING.LENGTH("&clk")-1))
  (
    &wild_tail=1
  )

  if ((&wild_head==1)&&(&wild_tail==1))
  (
    if (STRING.SCAN("gcc_pcnoc_bus_timeout4_ahb_clk", STRING.MID("&clk", 1, &clk_input_length-2), 0)!=-1)
    ( 
      &match=1
    )
  )
  else if (&wild_head==1)
  (
    if (STRING.MID("gcc_pcnoc_bus_timeout4_ahb_clk", &clk_itr_length-&clk_input_length+1, &clk_input_length-1)==STRING.CUT("&clk", 1))
    ( 
      &match=1
    )
  )
  else if (&wild_tail==1)
  (
    if (STRING.MID("gcc_pcnoc_bus_timeout4_ahb_clk", 0, &clk_input_length-1)==STRING.CUT("&clk", -1))
    ( 
      &match=1
    )
  )
  else if ("gcc_pcnoc_bus_timeout4_ahb_clk"=="&clk")
  (
    &match=1
  )
  
  if (&match==1)
  (
    &clk_test=&CLK_TEST_GCC_PCNOC_BUS_TIMEOUT4_AHB_CLK
    &clk_reg=&HWIO_GCC_PCNOC_BUS_TIMEOUT4_AHB_CBCR_ADDR
    &clk_reg_name="GCC_PCNOC_BUS_TIMEOUT4_AHB_CBCR"
    &clk_name="gcc_pcnoc_bus_timeout4_ahb_clk"
    &clk_reg_cbcr_type="sm_cbc"
    &clk_vote_bit=-1.
    &clk_multiplier=4.
    &clk_access_mode="&GCC_access_mode"

    gosub Print_Clk_Info_Line
  )

  &match=0
  &wild_head=0
  &wild_tail=0
  &clk_input_length=STRING.LENGTH("&clk")
  &clk_itr_length=STRING.LENGTH("gcc_pcnoc_bus_timeout6_ahb_clk")

  if (STRING.SCAN("&clk", "*", 0)==0)
  (
    &wild_head=1
  )
  if (STRING.SCAN("&clk", "*", 1)==(STRING.LENGTH("&clk")-1))
  (
    &wild_tail=1
  )

  if ((&wild_head==1)&&(&wild_tail==1))
  (
    if (STRING.SCAN("gcc_pcnoc_bus_timeout6_ahb_clk", STRING.MID("&clk", 1, &clk_input_length-2), 0)!=-1)
    ( 
      &match=1
    )
  )
  else if (&wild_head==1)
  (
    if (STRING.MID("gcc_pcnoc_bus_timeout6_ahb_clk", &clk_itr_length-&clk_input_length+1, &clk_input_length-1)==STRING.CUT("&clk", 1))
    ( 
      &match=1
    )
  )
  else if (&wild_tail==1)
  (
    if (STRING.MID("gcc_pcnoc_bus_timeout6_ahb_clk", 0, &clk_input_length-1)==STRING.CUT("&clk", -1))
    ( 
      &match=1
    )
  )
  else if ("gcc_pcnoc_bus_timeout6_ahb_clk"=="&clk")
  (
    &match=1
  )
  
  if (&match==1)
  (
    &clk_test=&CLK_TEST_GCC_PCNOC_BUS_TIMEOUT6_AHB_CLK
    &clk_reg=&HWIO_GCC_PCNOC_BUS_TIMEOUT6_AHB_CBCR_ADDR
    &clk_reg_name="GCC_PCNOC_BUS_TIMEOUT6_AHB_CBCR"
    &clk_name="gcc_pcnoc_bus_timeout6_ahb_clk"
    &clk_reg_cbcr_type="sm_cbc"
    &clk_vote_bit=-1.
    &clk_multiplier=4.
    &clk_access_mode="&GCC_access_mode"

    gosub Print_Clk_Info_Line
  )

  &match=0
  &wild_head=0
  &wild_tail=0
  &clk_input_length=STRING.LENGTH("&clk")
  &clk_itr_length=STRING.LENGTH("gcc_pcnoc_bus_timeout7_ahb_clk")

  if (STRING.SCAN("&clk", "*", 0)==0)
  (
    &wild_head=1
  )
  if (STRING.SCAN("&clk", "*", 1)==(STRING.LENGTH("&clk")-1))
  (
    &wild_tail=1
  )

  if ((&wild_head==1)&&(&wild_tail==1))
  (
    if (STRING.SCAN("gcc_pcnoc_bus_timeout7_ahb_clk", STRING.MID("&clk", 1, &clk_input_length-2), 0)!=-1)
    ( 
      &match=1
    )
  )
  else if (&wild_head==1)
  (
    if (STRING.MID("gcc_pcnoc_bus_timeout7_ahb_clk", &clk_itr_length-&clk_input_length+1, &clk_input_length-1)==STRING.CUT("&clk", 1))
    ( 
      &match=1
    )
  )
  else if (&wild_tail==1)
  (
    if (STRING.MID("gcc_pcnoc_bus_timeout7_ahb_clk", 0, &clk_input_length-1)==STRING.CUT("&clk", -1))
    ( 
      &match=1
    )
  )
  else if ("gcc_pcnoc_bus_timeout7_ahb_clk"=="&clk")
  (
    &match=1
  )
  
  if (&match==1)
  (
    &clk_test=&CLK_TEST_GCC_PCNOC_BUS_TIMEOUT7_AHB_CLK
    &clk_reg=&HWIO_GCC_PCNOC_BUS_TIMEOUT7_AHB_CBCR_ADDR
    &clk_reg_name="GCC_PCNOC_BUS_TIMEOUT7_AHB_CBCR"
    &clk_name="gcc_pcnoc_bus_timeout7_ahb_clk"
    &clk_reg_cbcr_type="sm_cbc"
    &clk_vote_bit=-1.
    &clk_multiplier=4.
    &clk_access_mode="&GCC_access_mode"

    gosub Print_Clk_Info_Line
  )

  &match=0
  &wild_head=0
  &wild_tail=0
  &clk_input_length=STRING.LENGTH("&clk")
  &clk_itr_length=STRING.LENGTH("gcc_pcnoc_bus_timeout8_ahb_clk")

  if (STRING.SCAN("&clk", "*", 0)==0)
  (
    &wild_head=1
  )
  if (STRING.SCAN("&clk", "*", 1)==(STRING.LENGTH("&clk")-1))
  (
    &wild_tail=1
  )

  if ((&wild_head==1)&&(&wild_tail==1))
  (
    if (STRING.SCAN("gcc_pcnoc_bus_timeout8_ahb_clk", STRING.MID("&clk", 1, &clk_input_length-2), 0)!=-1)
    ( 
      &match=1
    )
  )
  else if (&wild_head==1)
  (
    if (STRING.MID("gcc_pcnoc_bus_timeout8_ahb_clk", &clk_itr_length-&clk_input_length+1, &clk_input_length-1)==STRING.CUT("&clk", 1))
    ( 
      &match=1
    )
  )
  else if (&wild_tail==1)
  (
    if (STRING.MID("gcc_pcnoc_bus_timeout8_ahb_clk", 0, &clk_input_length-1)==STRING.CUT("&clk", -1))
    ( 
      &match=1
    )
  )
  else if ("gcc_pcnoc_bus_timeout8_ahb_clk"=="&clk")
  (
    &match=1
  )
  
  if (&match==1)
  (
    &clk_test=&CLK_TEST_GCC_PCNOC_BUS_TIMEOUT8_AHB_CLK
    &clk_reg=&HWIO_GCC_PCNOC_BUS_TIMEOUT8_AHB_CBCR_ADDR
    &clk_reg_name="GCC_PCNOC_BUS_TIMEOUT8_AHB_CBCR"
    &clk_name="gcc_pcnoc_bus_timeout8_ahb_clk"
    &clk_reg_cbcr_type="sm_cbc"
    &clk_vote_bit=-1.
    &clk_multiplier=4.
    &clk_access_mode="&GCC_access_mode"

    gosub Print_Clk_Info_Line
  )

  &match=0
  &wild_head=0
  &wild_tail=0
  &clk_input_length=STRING.LENGTH("&clk")
  &clk_itr_length=STRING.LENGTH("gcc_pcnoc_bus_timeout9_ahb_clk")

  if (STRING.SCAN("&clk", "*", 0)==0)
  (
    &wild_head=1
  )
  if (STRING.SCAN("&clk", "*", 1)==(STRING.LENGTH("&clk")-1))
  (
    &wild_tail=1
  )

  if ((&wild_head==1)&&(&wild_tail==1))
  (
    if (STRING.SCAN("gcc_pcnoc_bus_timeout9_ahb_clk", STRING.MID("&clk", 1, &clk_input_length-2), 0)!=-1)
    ( 
      &match=1
    )
  )
  else if (&wild_head==1)
  (
    if (STRING.MID("gcc_pcnoc_bus_timeout9_ahb_clk", &clk_itr_length-&clk_input_length+1, &clk_input_length-1)==STRING.CUT("&clk", 1))
    ( 
      &match=1
    )
  )
  else if (&wild_tail==1)
  (
    if (STRING.MID("gcc_pcnoc_bus_timeout9_ahb_clk", 0, &clk_input_length-1)==STRING.CUT("&clk", -1))
    ( 
      &match=1
    )
  )
  else if ("gcc_pcnoc_bus_timeout9_ahb_clk"=="&clk")
  (
    &match=1
  )
  
  if (&match==1)
  (
    &clk_test=&CLK_TEST_GCC_PCNOC_BUS_TIMEOUT9_AHB_CLK
    &clk_reg=&HWIO_GCC_PCNOC_BUS_TIMEOUT9_AHB_CBCR_ADDR
    &clk_reg_name="GCC_PCNOC_BUS_TIMEOUT9_AHB_CBCR"
    &clk_name="gcc_pcnoc_bus_timeout9_ahb_clk"
    &clk_reg_cbcr_type="sm_cbc"
    &clk_vote_bit=-1.
    &clk_multiplier=4.
    &clk_access_mode="&GCC_access_mode"

    gosub Print_Clk_Info_Line
  )

  &match=0
  &wild_head=0
  &wild_tail=0
  &clk_input_length=STRING.LENGTH("&clk")
  &clk_itr_length=STRING.LENGTH("gcc_pcnoc_ddr_cfg_clk")

  if (STRING.SCAN("&clk", "*", 0)==0)
  (
    &wild_head=1
  )
  if (STRING.SCAN("&clk", "*", 1)==(STRING.LENGTH("&clk")-1))
  (
    &wild_tail=1
  )

  if ((&wild_head==1)&&(&wild_tail==1))
  (
    if (STRING.SCAN("gcc_pcnoc_ddr_cfg_clk", STRING.MID("&clk", 1, &clk_input_length-2), 0)!=-1)
    ( 
      &match=1
    )
  )
  else if (&wild_head==1)
  (
    if (STRING.MID("gcc_pcnoc_ddr_cfg_clk", &clk_itr_length-&clk_input_length+1, &clk_input_length-1)==STRING.CUT("&clk", 1))
    ( 
      &match=1
    )
  )
  else if (&wild_tail==1)
  (
    if (STRING.MID("gcc_pcnoc_ddr_cfg_clk", 0, &clk_input_length-1)==STRING.CUT("&clk", -1))
    ( 
      &match=1
    )
  )
  else if ("gcc_pcnoc_ddr_cfg_clk"=="&clk")
  (
    &match=1
  )
  
  if (&match==1)
  (
    &clk_test=&CLK_TEST_GCC_PCNOC_DDR_CFG_CLK
    &clk_reg=&HWIO_GCC_PCNOC_DDR_CFG_CBCR_ADDR
    &clk_reg_name="GCC_PCNOC_DDR_CFG_CBCR"
    &clk_name="gcc_pcnoc_ddr_cfg_clk"
    &clk_reg_cbcr_type="sm_cbc"
    &clk_vote_bit=-1.
    &clk_multiplier=4.
    &clk_access_mode="&GCC_access_mode"

    gosub Print_Clk_Info_Line
  )

  &match=0
  &wild_head=0
  &wild_tail=0
  &clk_input_length=STRING.LENGTH("&clk")
  &clk_itr_length=STRING.LENGTH("gcc_pcnoc_east_ahb_clk")

  if (STRING.SCAN("&clk", "*", 0)==0)
  (
    &wild_head=1
  )
  if (STRING.SCAN("&clk", "*", 1)==(STRING.LENGTH("&clk")-1))
  (
    &wild_tail=1
  )

  if ((&wild_head==1)&&(&wild_tail==1))
  (
    if (STRING.SCAN("gcc_pcnoc_east_ahb_clk", STRING.MID("&clk", 1, &clk_input_length-2), 0)!=-1)
    ( 
      &match=1
    )
  )
  else if (&wild_head==1)
  (
    if (STRING.MID("gcc_pcnoc_east_ahb_clk", &clk_itr_length-&clk_input_length+1, &clk_input_length-1)==STRING.CUT("&clk", 1))
    ( 
      &match=1
    )
  )
  else if (&wild_tail==1)
  (
    if (STRING.MID("gcc_pcnoc_east_ahb_clk", 0, &clk_input_length-1)==STRING.CUT("&clk", -1))
    ( 
      &match=1
    )
  )
  else if ("gcc_pcnoc_east_ahb_clk"=="&clk")
  (
    &match=1
  )
  
  if (&match==1)
  (
    &clk_test=&CLK_TEST_GCC_PCNOC_EAST_AHB_CLK
    &clk_reg=&HWIO_GCC_PCNOC_EAST_AHB_CBCR_ADDR
    &clk_reg_name="GCC_PCNOC_EAST_AHB_CBCR"
    &clk_name="gcc_pcnoc_east_ahb_clk"
    &clk_reg_cbcr_type="sm_cbc"
    &clk_vote_bit=-1.
    &clk_multiplier=4.
    &clk_access_mode="&GCC_access_mode"

    gosub Print_Clk_Info_Line
  )

  &match=0
  &wild_head=0
  &wild_tail=0
  &clk_input_length=STRING.LENGTH("&clk")
  &clk_itr_length=STRING.LENGTH("gcc_pcnoc_mpu_cfg_ahb_clk")

  if (STRING.SCAN("&clk", "*", 0)==0)
  (
    &wild_head=1
  )
  if (STRING.SCAN("&clk", "*", 1)==(STRING.LENGTH("&clk")-1))
  (
    &wild_tail=1
  )

  if ((&wild_head==1)&&(&wild_tail==1))
  (
    if (STRING.SCAN("gcc_pcnoc_mpu_cfg_ahb_clk", STRING.MID("&clk", 1, &clk_input_length-2), 0)!=-1)
    ( 
      &match=1
    )
  )
  else if (&wild_head==1)
  (
    if (STRING.MID("gcc_pcnoc_mpu_cfg_ahb_clk", &clk_itr_length-&clk_input_length+1, &clk_input_length-1)==STRING.CUT("&clk", 1))
    ( 
      &match=1
    )
  )
  else if (&wild_tail==1)
  (
    if (STRING.MID("gcc_pcnoc_mpu_cfg_ahb_clk", 0, &clk_input_length-1)==STRING.CUT("&clk", -1))
    ( 
      &match=1
    )
  )
  else if ("gcc_pcnoc_mpu_cfg_ahb_clk"=="&clk")
  (
    &match=1
  )
  
  if (&match==1)
  (
    &clk_test=&CLK_TEST_GCC_PCNOC_MPU_CFG_AHB_CLK
    &clk_reg=&HWIO_GCC_PCNOC_MPU_CFG_AHB_CBCR_ADDR
    &clk_reg_name="GCC_PCNOC_MPU_CFG_AHB_CBCR"
    &clk_name="gcc_pcnoc_mpu_cfg_ahb_clk"
    &clk_reg_cbcr_type="sm_cbc"
    &clk_vote_bit=-1.
    &clk_multiplier=4.
    &clk_access_mode="&GCC_access_mode"

    gosub Print_Clk_Info_Line
  )

  &match=0
  &wild_head=0
  &wild_tail=0
  &clk_input_length=STRING.LENGTH("&clk")
  &clk_itr_length=STRING.LENGTH("gcc_pcnoc_mst_rpm_bridge_clk")

  if (STRING.SCAN("&clk", "*", 0)==0)
  (
    &wild_head=1
  )
  if (STRING.SCAN("&clk", "*", 1)==(STRING.LENGTH("&clk")-1))
  (
    &wild_tail=1
  )

  if ((&wild_head==1)&&(&wild_tail==1))
  (
    if (STRING.SCAN("gcc_pcnoc_mst_rpm_bridge_clk", STRING.MID("&clk", 1, &clk_input_length-2), 0)!=-1)
    ( 
      &match=1
    )
  )
  else if (&wild_head==1)
  (
    if (STRING.MID("gcc_pcnoc_mst_rpm_bridge_clk", &clk_itr_length-&clk_input_length+1, &clk_input_length-1)==STRING.CUT("&clk", 1))
    ( 
      &match=1
    )
  )
  else if (&wild_tail==1)
  (
    if (STRING.MID("gcc_pcnoc_mst_rpm_bridge_clk", 0, &clk_input_length-1)==STRING.CUT("&clk", -1))
    ( 
      &match=1
    )
  )
  else if ("gcc_pcnoc_mst_rpm_bridge_clk"=="&clk")
  (
    &match=1
  )
  
  if (&match==1)
  (
    &clk_test=&CLK_TEST_GCC_PCNOC_MST_RPM_BRIDGE_CLK
    &clk_reg=&HWIO_GCC_PCNOC_MST_RPM_BRIDGE_CBCR_ADDR
    &clk_reg_name="GCC_PCNOC_MST_RPM_BRIDGE_CBCR"
    &clk_name="gcc_pcnoc_mst_rpm_bridge_clk"
    &clk_reg_cbcr_type="sm_cbc"
    &clk_vote_bit=-1.
    &clk_multiplier=4.
    &clk_access_mode="&GCC_access_mode"

    gosub Print_Clk_Info_Line
  )

  &match=0
  &wild_head=0
  &wild_tail=0
  &clk_input_length=STRING.LENGTH("&clk")
  &clk_itr_length=STRING.LENGTH("gcc_pcnoc_north_ahb_clk")

  if (STRING.SCAN("&clk", "*", 0)==0)
  (
    &wild_head=1
  )
  if (STRING.SCAN("&clk", "*", 1)==(STRING.LENGTH("&clk")-1))
  (
    &wild_tail=1
  )

  if ((&wild_head==1)&&(&wild_tail==1))
  (
    if (STRING.SCAN("gcc_pcnoc_north_ahb_clk", STRING.MID("&clk", 1, &clk_input_length-2), 0)!=-1)
    ( 
      &match=1
    )
  )
  else if (&wild_head==1)
  (
    if (STRING.MID("gcc_pcnoc_north_ahb_clk", &clk_itr_length-&clk_input_length+1, &clk_input_length-1)==STRING.CUT("&clk", 1))
    ( 
      &match=1
    )
  )
  else if (&wild_tail==1)
  (
    if (STRING.MID("gcc_pcnoc_north_ahb_clk", 0, &clk_input_length-1)==STRING.CUT("&clk", -1))
    ( 
      &match=1
    )
  )
  else if ("gcc_pcnoc_north_ahb_clk"=="&clk")
  (
    &match=1
  )
  
  if (&match==1)
  (
    &clk_test=&CLK_TEST_GCC_PCNOC_NORTH_AHB_CLK
    &clk_reg=&HWIO_GCC_PCNOC_NORTH_AHB_CBCR_ADDR
    &clk_reg_name="GCC_PCNOC_NORTH_AHB_CBCR"
    &clk_name="gcc_pcnoc_north_ahb_clk"
    &clk_reg_cbcr_type="sm_cbc"
    &clk_vote_bit=-1.
    &clk_multiplier=4.
    &clk_access_mode="&GCC_access_mode"

    gosub Print_Clk_Info_Line
  )

  &match=0
  &wild_head=0
  &wild_tail=0
  &clk_input_length=STRING.LENGTH("&clk")
  &clk_itr_length=STRING.LENGTH("gcc_pcnoc_slv_rpm_bridge_clk")

  if (STRING.SCAN("&clk", "*", 0)==0)
  (
    &wild_head=1
  )
  if (STRING.SCAN("&clk", "*", 1)==(STRING.LENGTH("&clk")-1))
  (
    &wild_tail=1
  )

  if ((&wild_head==1)&&(&wild_tail==1))
  (
    if (STRING.SCAN("gcc_pcnoc_slv_rpm_bridge_clk", STRING.MID("&clk", 1, &clk_input_length-2), 0)!=-1)
    ( 
      &match=1
    )
  )
  else if (&wild_head==1)
  (
    if (STRING.MID("gcc_pcnoc_slv_rpm_bridge_clk", &clk_itr_length-&clk_input_length+1, &clk_input_length-1)==STRING.CUT("&clk", 1))
    ( 
      &match=1
    )
  )
  else if (&wild_tail==1)
  (
    if (STRING.MID("gcc_pcnoc_slv_rpm_bridge_clk", 0, &clk_input_length-1)==STRING.CUT("&clk", -1))
    ( 
      &match=1
    )
  )
  else if ("gcc_pcnoc_slv_rpm_bridge_clk"=="&clk")
  (
    &match=1
  )
  
  if (&match==1)
  (
    &clk_test=&CLK_TEST_GCC_PCNOC_SLV_RPM_BRIDGE_CLK
    &clk_reg=&HWIO_GCC_PCNOC_SLV_RPM_BRIDGE_CBCR_ADDR
    &clk_reg_name="GCC_PCNOC_SLV_RPM_BRIDGE_CBCR"
    &clk_name="gcc_pcnoc_slv_rpm_bridge_clk"
    &clk_reg_cbcr_type="sm_cbc"
    &clk_vote_bit=-1.
    &clk_multiplier=4.
    &clk_access_mode="&GCC_access_mode"

    gosub Print_Clk_Info_Line
  )

  &match=0
  &wild_head=0
  &wild_tail=0
  &clk_input_length=STRING.LENGTH("&clk")
  &clk_itr_length=STRING.LENGTH("gcc_pcnoc_south_ahb_clk")

  if (STRING.SCAN("&clk", "*", 0)==0)
  (
    &wild_head=1
  )
  if (STRING.SCAN("&clk", "*", 1)==(STRING.LENGTH("&clk")-1))
  (
    &wild_tail=1
  )

  if ((&wild_head==1)&&(&wild_tail==1))
  (
    if (STRING.SCAN("gcc_pcnoc_south_ahb_clk", STRING.MID("&clk", 1, &clk_input_length-2), 0)!=-1)
    ( 
      &match=1
    )
  )
  else if (&wild_head==1)
  (
    if (STRING.MID("gcc_pcnoc_south_ahb_clk", &clk_itr_length-&clk_input_length+1, &clk_input_length-1)==STRING.CUT("&clk", 1))
    ( 
      &match=1
    )
  )
  else if (&wild_tail==1)
  (
    if (STRING.MID("gcc_pcnoc_south_ahb_clk", 0, &clk_input_length-1)==STRING.CUT("&clk", -1))
    ( 
      &match=1
    )
  )
  else if ("gcc_pcnoc_south_ahb_clk"=="&clk")
  (
    &match=1
  )
  
  if (&match==1)
  (
    &clk_test=&CLK_TEST_GCC_PCNOC_SOUTH_AHB_CLK
    &clk_reg=&HWIO_GCC_PCNOC_SOUTH_AHB_CBCR_ADDR
    &clk_reg_name="GCC_PCNOC_SOUTH_AHB_CBCR"
    &clk_name="gcc_pcnoc_south_ahb_clk"
    &clk_reg_cbcr_type="sm_cbc"
    &clk_vote_bit=-1.
    &clk_multiplier=4.
    &clk_access_mode="&GCC_access_mode"

    gosub Print_Clk_Info_Line
  )

  &match=0
  &wild_head=0
  &wild_tail=0
  &clk_input_length=STRING.LENGTH("&clk")
  &clk_itr_length=STRING.LENGTH("gcc_pcnoc_tbu_clk")

  if (STRING.SCAN("&clk", "*", 0)==0)
  (
    &wild_head=1
  )
  if (STRING.SCAN("&clk", "*", 1)==(STRING.LENGTH("&clk")-1))
  (
    &wild_tail=1
  )

  if ((&wild_head==1)&&(&wild_tail==1))
  (
    if (STRING.SCAN("gcc_pcnoc_tbu_clk", STRING.MID("&clk", 1, &clk_input_length-2), 0)!=-1)
    ( 
      &match=1
    )
  )
  else if (&wild_head==1)
  (
    if (STRING.MID("gcc_pcnoc_tbu_clk", &clk_itr_length-&clk_input_length+1, &clk_input_length-1)==STRING.CUT("&clk", 1))
    ( 
      &match=1
    )
  )
  else if (&wild_tail==1)
  (
    if (STRING.MID("gcc_pcnoc_tbu_clk", 0, &clk_input_length-1)==STRING.CUT("&clk", -1))
    ( 
      &match=1
    )
  )
  else if ("gcc_pcnoc_tbu_clk"=="&clk")
  (
    &match=1
  )
  
  if (&match==1)
  (
    &clk_test=&CLK_TEST_GCC_PCNOC_TBU_CLK
    &clk_reg=&HWIO_GCC_PCNOC_TBU_CBCR_ADDR
    &clk_reg_name="GCC_PCNOC_TBU_CBCR"
    &clk_name="gcc_pcnoc_tbu_clk"
    &clk_reg_cbcr_type="sm_pscbc"
    &clk_vote_bit=11.
    &clk_multiplier=4.
    &clk_access_mode="&GCC_access_mode"

    gosub Print_Clk_Info_Line
  )

  &match=0
  &wild_head=0
  &wild_tail=0
  &clk_input_length=STRING.LENGTH("&clk")
  &clk_itr_length=STRING.LENGTH("gcc_pcnoc_west_ahb_clk")

  if (STRING.SCAN("&clk", "*", 0)==0)
  (
    &wild_head=1
  )
  if (STRING.SCAN("&clk", "*", 1)==(STRING.LENGTH("&clk")-1))
  (
    &wild_tail=1
  )

  if ((&wild_head==1)&&(&wild_tail==1))
  (
    if (STRING.SCAN("gcc_pcnoc_west_ahb_clk", STRING.MID("&clk", 1, &clk_input_length-2), 0)!=-1)
    ( 
      &match=1
    )
  )
  else if (&wild_head==1)
  (
    if (STRING.MID("gcc_pcnoc_west_ahb_clk", &clk_itr_length-&clk_input_length+1, &clk_input_length-1)==STRING.CUT("&clk", 1))
    ( 
      &match=1
    )
  )
  else if (&wild_tail==1)
  (
    if (STRING.MID("gcc_pcnoc_west_ahb_clk", 0, &clk_input_length-1)==STRING.CUT("&clk", -1))
    ( 
      &match=1
    )
  )
  else if ("gcc_pcnoc_west_ahb_clk"=="&clk")
  (
    &match=1
  )
  
  if (&match==1)
  (
    &clk_test=&CLK_TEST_GCC_PCNOC_WEST_AHB_CLK
    &clk_reg=&HWIO_GCC_PCNOC_WEST_AHB_CBCR_ADDR
    &clk_reg_name="GCC_PCNOC_WEST_AHB_CBCR"
    &clk_name="gcc_pcnoc_west_ahb_clk"
    &clk_reg_cbcr_type="sm_cbc"
    &clk_vote_bit=-1.
    &clk_multiplier=4.
    &clk_access_mode="&GCC_access_mode"

    gosub Print_Clk_Info_Line
  )

  &match=0
  &wild_head=0
  &wild_tail=0
  &clk_input_length=STRING.LENGTH("&clk")
  &clk_itr_length=STRING.LENGTH("gcc_pdm_ahb_clk")

  if (STRING.SCAN("&clk", "*", 0)==0)
  (
    &wild_head=1
  )
  if (STRING.SCAN("&clk", "*", 1)==(STRING.LENGTH("&clk")-1))
  (
    &wild_tail=1
  )

  if ((&wild_head==1)&&(&wild_tail==1))
  (
    if (STRING.SCAN("gcc_pdm_ahb_clk", STRING.MID("&clk", 1, &clk_input_length-2), 0)!=-1)
    ( 
      &match=1
    )
  )
  else if (&wild_head==1)
  (
    if (STRING.MID("gcc_pdm_ahb_clk", &clk_itr_length-&clk_input_length+1, &clk_input_length-1)==STRING.CUT("&clk", 1))
    ( 
      &match=1
    )
  )
  else if (&wild_tail==1)
  (
    if (STRING.MID("gcc_pdm_ahb_clk", 0, &clk_input_length-1)==STRING.CUT("&clk", -1))
    ( 
      &match=1
    )
  )
  else if ("gcc_pdm_ahb_clk"=="&clk")
  (
    &match=1
  )
  
  if (&match==1)
  (
    &clk_test=&CLK_TEST_GCC_PDM_AHB_CLK
    &clk_reg=&HWIO_GCC_PDM_AHB_CBCR_ADDR
    &clk_reg_name="GCC_PDM_AHB_CBCR"
    &clk_name="gcc_pdm_ahb_clk"
    &clk_reg_cbcr_type="sm_cbc"
    &clk_vote_bit=-1.
    &clk_multiplier=4.
    &clk_access_mode="&GCC_access_mode"

    gosub Print_Clk_Info_Line
  )

  &match=0
  &wild_head=0
  &wild_tail=0
  &clk_input_length=STRING.LENGTH("&clk")
  &clk_itr_length=STRING.LENGTH("gcc_prng_ahb_clk")

  if (STRING.SCAN("&clk", "*", 0)==0)
  (
    &wild_head=1
  )
  if (STRING.SCAN("&clk", "*", 1)==(STRING.LENGTH("&clk")-1))
  (
    &wild_tail=1
  )

  if ((&wild_head==1)&&(&wild_tail==1))
  (
    if (STRING.SCAN("gcc_prng_ahb_clk", STRING.MID("&clk", 1, &clk_input_length-2), 0)!=-1)
    ( 
      &match=1
    )
  )
  else if (&wild_head==1)
  (
    if (STRING.MID("gcc_prng_ahb_clk", &clk_itr_length-&clk_input_length+1, &clk_input_length-1)==STRING.CUT("&clk", 1))
    ( 
      &match=1
    )
  )
  else if (&wild_tail==1)
  (
    if (STRING.MID("gcc_prng_ahb_clk", 0, &clk_input_length-1)==STRING.CUT("&clk", -1))
    ( 
      &match=1
    )
  )
  else if ("gcc_prng_ahb_clk"=="&clk")
  (
    &match=1
  )
  
  if (&match==1)
  (
    &clk_test=&CLK_TEST_GCC_PRNG_AHB_CLK
    &clk_reg=&HWIO_GCC_PRNG_AHB_CBCR_ADDR
    &clk_reg_name="GCC_PRNG_AHB_CBCR"
    &clk_name="gcc_prng_ahb_clk"
    &clk_reg_cbcr_type="sm_cbc"
    &clk_vote_bit=8.
    &clk_multiplier=4.
    &clk_access_mode="&GCC_access_mode"

    gosub Print_Clk_Info_Line
  )

  &match=0
  &wild_head=0
  &wild_tail=0
  &clk_input_length=STRING.LENGTH("&clk")
  &clk_itr_length=STRING.LENGTH("gcc_qdss_cfg_ahb_clk")

  if (STRING.SCAN("&clk", "*", 0)==0)
  (
    &wild_head=1
  )
  if (STRING.SCAN("&clk", "*", 1)==(STRING.LENGTH("&clk")-1))
  (
    &wild_tail=1
  )

  if ((&wild_head==1)&&(&wild_tail==1))
  (
    if (STRING.SCAN("gcc_qdss_cfg_ahb_clk", STRING.MID("&clk", 1, &clk_input_length-2), 0)!=-1)
    ( 
      &match=1
    )
  )
  else if (&wild_head==1)
  (
    if (STRING.MID("gcc_qdss_cfg_ahb_clk", &clk_itr_length-&clk_input_length+1, &clk_input_length-1)==STRING.CUT("&clk", 1))
    ( 
      &match=1
    )
  )
  else if (&wild_tail==1)
  (
    if (STRING.MID("gcc_qdss_cfg_ahb_clk", 0, &clk_input_length-1)==STRING.CUT("&clk", -1))
    ( 
      &match=1
    )
  )
  else if ("gcc_qdss_cfg_ahb_clk"=="&clk")
  (
    &match=1
  )
  
  if (&match==1)
  (
    &clk_test=&CLK_TEST_GCC_QDSS_CFG_AHB_CLK
    &clk_reg=&HWIO_GCC_QDSS_CFG_AHB_CBCR_ADDR
    &clk_reg_name="GCC_QDSS_CFG_AHB_CBCR"
    &clk_name="gcc_qdss_cfg_ahb_clk"
    &clk_reg_cbcr_type="sm_cbc"
    &clk_vote_bit=-1.
    &clk_multiplier=4.
    &clk_access_mode="&GCC_access_mode"

    gosub Print_Clk_Info_Line
  )

  &match=0
  &wild_head=0
  &wild_tail=0
  &clk_input_length=STRING.LENGTH("&clk")
  &clk_itr_length=STRING.LENGTH("gcc_qdss_dap_ahb_clk")

  if (STRING.SCAN("&clk", "*", 0)==0)
  (
    &wild_head=1
  )
  if (STRING.SCAN("&clk", "*", 1)==(STRING.LENGTH("&clk")-1))
  (
    &wild_tail=1
  )

  if ((&wild_head==1)&&(&wild_tail==1))
  (
    if (STRING.SCAN("gcc_qdss_dap_ahb_clk", STRING.MID("&clk", 1, &clk_input_length-2), 0)!=-1)
    ( 
      &match=1
    )
  )
  else if (&wild_head==1)
  (
    if (STRING.MID("gcc_qdss_dap_ahb_clk", &clk_itr_length-&clk_input_length+1, &clk_input_length-1)==STRING.CUT("&clk", 1))
    ( 
      &match=1
    )
  )
  else if (&wild_tail==1)
  (
    if (STRING.MID("gcc_qdss_dap_ahb_clk", 0, &clk_input_length-1)==STRING.CUT("&clk", -1))
    ( 
      &match=1
    )
  )
  else if ("gcc_qdss_dap_ahb_clk"=="&clk")
  (
    &match=1
  )
  
  if (&match==1)
  (
    &clk_test=&CLK_TEST_GCC_QDSS_DAP_AHB_CLK
    &clk_reg=&HWIO_GCC_QDSS_DAP_AHB_CBCR_ADDR
    &clk_reg_name="GCC_QDSS_DAP_AHB_CBCR"
    &clk_name="gcc_qdss_dap_ahb_clk"
    &clk_reg_cbcr_type="sm_cbc"
    &clk_vote_bit=-1.
    &clk_multiplier=4.
    &clk_access_mode="&GCC_access_mode"

    gosub Print_Clk_Info_Line
  )

  &match=0
  &wild_head=0
  &wild_tail=0
  &clk_input_length=STRING.LENGTH("&clk")
  &clk_itr_length=STRING.LENGTH("gcc_qpic_ahb_clk")

  if (STRING.SCAN("&clk", "*", 0)==0)
  (
    &wild_head=1
  )
  if (STRING.SCAN("&clk", "*", 1)==(STRING.LENGTH("&clk")-1))
  (
    &wild_tail=1
  )

  if ((&wild_head==1)&&(&wild_tail==1))
  (
    if (STRING.SCAN("gcc_qpic_ahb_clk", STRING.MID("&clk", 1, &clk_input_length-2), 0)!=-1)
    ( 
      &match=1
    )
  )
  else if (&wild_head==1)
  (
    if (STRING.MID("gcc_qpic_ahb_clk", &clk_itr_length-&clk_input_length+1, &clk_input_length-1)==STRING.CUT("&clk", 1))
    ( 
      &match=1
    )
  )
  else if (&wild_tail==1)
  (
    if (STRING.MID("gcc_qpic_ahb_clk", 0, &clk_input_length-1)==STRING.CUT("&clk", -1))
    ( 
      &match=1
    )
  )
  else if ("gcc_qpic_ahb_clk"=="&clk")
  (
    &match=1
  )
  
  if (&match==1)
  (
    &clk_test=&CLK_TEST_GCC_QPIC_AHB_CLK
    &clk_reg=&HWIO_GCC_QPIC_AHB_CBCR_ADDR
    &clk_reg_name="GCC_QPIC_AHB_CBCR"
    &clk_name="gcc_qpic_ahb_clk"
    &clk_reg_cbcr_type="sm_pscbc"
    &clk_vote_bit=-1.
    &clk_multiplier=4.
    &clk_access_mode="&GCC_access_mode"

    gosub Print_Clk_Info_Line
  )

  &match=0
  &wild_head=0
  &wild_tail=0
  &clk_input_length=STRING.LENGTH("&clk")
  &clk_itr_length=STRING.LENGTH("gcc_rbcpr_ahb_clk")

  if (STRING.SCAN("&clk", "*", 0)==0)
  (
    &wild_head=1
  )
  if (STRING.SCAN("&clk", "*", 1)==(STRING.LENGTH("&clk")-1))
  (
    &wild_tail=1
  )

  if ((&wild_head==1)&&(&wild_tail==1))
  (
    if (STRING.SCAN("gcc_rbcpr_ahb_clk", STRING.MID("&clk", 1, &clk_input_length-2), 0)!=-1)
    ( 
      &match=1
    )
  )
  else if (&wild_head==1)
  (
    if (STRING.MID("gcc_rbcpr_ahb_clk", &clk_itr_length-&clk_input_length+1, &clk_input_length-1)==STRING.CUT("&clk", 1))
    ( 
      &match=1
    )
  )
  else if (&wild_tail==1)
  (
    if (STRING.MID("gcc_rbcpr_ahb_clk", 0, &clk_input_length-1)==STRING.CUT("&clk", -1))
    ( 
      &match=1
    )
  )
  else if ("gcc_rbcpr_ahb_clk"=="&clk")
  (
    &match=1
  )
  
  if (&match==1)
  (
    &clk_test=&CLK_TEST_GCC_RBCPR_AHB_CLK
    &clk_reg=&HWIO_GCC_RBCPR_AHB_CBCR_ADDR
    &clk_reg_name="GCC_RBCPR_AHB_CBCR"
    &clk_name="gcc_rbcpr_ahb_clk"
    &clk_reg_cbcr_type="sm_cbc"
    &clk_vote_bit=-1.
    &clk_multiplier=4.
    &clk_access_mode="&GCC_access_mode"

    gosub Print_Clk_Info_Line
  )

  &match=0
  &wild_head=0
  &wild_tail=0
  &clk_input_length=STRING.LENGTH("&clk")
  &clk_itr_length=STRING.LENGTH("gcc_rpm_cfg_xpu_clk")

  if (STRING.SCAN("&clk", "*", 0)==0)
  (
    &wild_head=1
  )
  if (STRING.SCAN("&clk", "*", 1)==(STRING.LENGTH("&clk")-1))
  (
    &wild_tail=1
  )

  if ((&wild_head==1)&&(&wild_tail==1))
  (
    if (STRING.SCAN("gcc_rpm_cfg_xpu_clk", STRING.MID("&clk", 1, &clk_input_length-2), 0)!=-1)
    ( 
      &match=1
    )
  )
  else if (&wild_head==1)
  (
    if (STRING.MID("gcc_rpm_cfg_xpu_clk", &clk_itr_length-&clk_input_length+1, &clk_input_length-1)==STRING.CUT("&clk", 1))
    ( 
      &match=1
    )
  )
  else if (&wild_tail==1)
  (
    if (STRING.MID("gcc_rpm_cfg_xpu_clk", 0, &clk_input_length-1)==STRING.CUT("&clk", -1))
    ( 
      &match=1
    )
  )
  else if ("gcc_rpm_cfg_xpu_clk"=="&clk")
  (
    &match=1
  )
  
  if (&match==1)
  (
    &clk_test=&CLK_TEST_GCC_RPM_CFG_XPU_CLK
    &clk_reg=&HWIO_GCC_RPM_CFG_XPU_CBCR_ADDR
    &clk_reg_name="GCC_RPM_CFG_XPU_CBCR"
    &clk_name="gcc_rpm_cfg_xpu_clk"
    &clk_reg_cbcr_type="sm_cbc"
    &clk_vote_bit=-1.
    &clk_multiplier=4.
    &clk_access_mode="&GCC_access_mode"

    gosub Print_Clk_Info_Line
  )

  &match=0
  &wild_head=0
  &wild_tail=0
  &clk_input_length=STRING.LENGTH("&clk")
  &clk_itr_length=STRING.LENGTH("gcc_sdcc1_ahb_clk")

  if (STRING.SCAN("&clk", "*", 0)==0)
  (
    &wild_head=1
  )
  if (STRING.SCAN("&clk", "*", 1)==(STRING.LENGTH("&clk")-1))
  (
    &wild_tail=1
  )

  if ((&wild_head==1)&&(&wild_tail==1))
  (
    if (STRING.SCAN("gcc_sdcc1_ahb_clk", STRING.MID("&clk", 1, &clk_input_length-2), 0)!=-1)
    ( 
      &match=1
    )
  )
  else if (&wild_head==1)
  (
    if (STRING.MID("gcc_sdcc1_ahb_clk", &clk_itr_length-&clk_input_length+1, &clk_input_length-1)==STRING.CUT("&clk", 1))
    ( 
      &match=1
    )
  )
  else if (&wild_tail==1)
  (
    if (STRING.MID("gcc_sdcc1_ahb_clk", 0, &clk_input_length-1)==STRING.CUT("&clk", -1))
    ( 
      &match=1
    )
  )
  else if ("gcc_sdcc1_ahb_clk"=="&clk")
  (
    &match=1
  )
  
  if (&match==1)
  (
    &clk_test=&CLK_TEST_GCC_SDCC1_AHB_CLK
    &clk_reg=&HWIO_GCC_SDCC1_AHB_CBCR_ADDR
    &clk_reg_name="GCC_SDCC1_AHB_CBCR"
    &clk_name="gcc_sdcc1_ahb_clk"
    &clk_reg_cbcr_type="sm_pscbc"
    &clk_vote_bit=-1.
    &clk_multiplier=4.
    &clk_access_mode="&GCC_access_mode"

    gosub Print_Clk_Info_Line
  )

  &match=0
  &wild_head=0
  &wild_tail=0
  &clk_input_length=STRING.LENGTH("&clk")
  &clk_itr_length=STRING.LENGTH("gcc_sdcc2_ahb_clk")

  if (STRING.SCAN("&clk", "*", 0)==0)
  (
    &wild_head=1
  )
  if (STRING.SCAN("&clk", "*", 1)==(STRING.LENGTH("&clk")-1))
  (
    &wild_tail=1
  )

  if ((&wild_head==1)&&(&wild_tail==1))
  (
    if (STRING.SCAN("gcc_sdcc2_ahb_clk", STRING.MID("&clk", 1, &clk_input_length-2), 0)!=-1)
    ( 
      &match=1
    )
  )
  else if (&wild_head==1)
  (
    if (STRING.MID("gcc_sdcc2_ahb_clk", &clk_itr_length-&clk_input_length+1, &clk_input_length-1)==STRING.CUT("&clk", 1))
    ( 
      &match=1
    )
  )
  else if (&wild_tail==1)
  (
    if (STRING.MID("gcc_sdcc2_ahb_clk", 0, &clk_input_length-1)==STRING.CUT("&clk", -1))
    ( 
      &match=1
    )
  )
  else if ("gcc_sdcc2_ahb_clk"=="&clk")
  (
    &match=1
  )
  
  if (&match==1)
  (
    &clk_test=&CLK_TEST_GCC_SDCC2_AHB_CLK
    &clk_reg=&HWIO_GCC_SDCC2_AHB_CBCR_ADDR
    &clk_reg_name="GCC_SDCC2_AHB_CBCR"
    &clk_name="gcc_sdcc2_ahb_clk"
    &clk_reg_cbcr_type="sm_pscbc"
    &clk_vote_bit=-1.
    &clk_multiplier=4.
    &clk_access_mode="&GCC_access_mode"

    gosub Print_Clk_Info_Line
  )

  &match=0
  &wild_head=0
  &wild_tail=0
  &clk_input_length=STRING.LENGTH("&clk")
  &clk_itr_length=STRING.LENGTH("gcc_sec_ctrl_ahb_clk")

  if (STRING.SCAN("&clk", "*", 0)==0)
  (
    &wild_head=1
  )
  if (STRING.SCAN("&clk", "*", 1)==(STRING.LENGTH("&clk")-1))
  (
    &wild_tail=1
  )

  if ((&wild_head==1)&&(&wild_tail==1))
  (
    if (STRING.SCAN("gcc_sec_ctrl_ahb_clk", STRING.MID("&clk", 1, &clk_input_length-2), 0)!=-1)
    ( 
      &match=1
    )
  )
  else if (&wild_head==1)
  (
    if (STRING.MID("gcc_sec_ctrl_ahb_clk", &clk_itr_length-&clk_input_length+1, &clk_input_length-1)==STRING.CUT("&clk", 1))
    ( 
      &match=1
    )
  )
  else if (&wild_tail==1)
  (
    if (STRING.MID("gcc_sec_ctrl_ahb_clk", 0, &clk_input_length-1)==STRING.CUT("&clk", -1))
    ( 
      &match=1
    )
  )
  else if ("gcc_sec_ctrl_ahb_clk"=="&clk")
  (
    &match=1
  )
  
  if (&match==1)
  (
    &clk_test=&CLK_TEST_GCC_SEC_CTRL_AHB_CLK
    &clk_reg=&HWIO_GCC_SEC_CTRL_AHB_CBCR_ADDR
    &clk_reg_name="GCC_SEC_CTRL_AHB_CBCR"
    &clk_name="gcc_sec_ctrl_ahb_clk"
    &clk_reg_cbcr_type="sm_cbc"
    &clk_vote_bit=-1.
    &clk_multiplier=4.
    &clk_access_mode="&GCC_access_mode"

    gosub Print_Clk_Info_Line
  )

  &match=0
  &wild_head=0
  &wild_tail=0
  &clk_input_length=STRING.LENGTH("&clk")
  &clk_itr_length=STRING.LENGTH("gcc_sec_ctrl_boot_rom_patch_clk")

  if (STRING.SCAN("&clk", "*", 0)==0)
  (
    &wild_head=1
  )
  if (STRING.SCAN("&clk", "*", 1)==(STRING.LENGTH("&clk")-1))
  (
    &wild_tail=1
  )

  if ((&wild_head==1)&&(&wild_tail==1))
  (
    if (STRING.SCAN("gcc_sec_ctrl_boot_rom_patch_clk", STRING.MID("&clk", 1, &clk_input_length-2), 0)!=-1)
    ( 
      &match=1
    )
  )
  else if (&wild_head==1)
  (
    if (STRING.MID("gcc_sec_ctrl_boot_rom_patch_clk", &clk_itr_length-&clk_input_length+1, &clk_input_length-1)==STRING.CUT("&clk", 1))
    ( 
      &match=1
    )
  )
  else if (&wild_tail==1)
  (
    if (STRING.MID("gcc_sec_ctrl_boot_rom_patch_clk", 0, &clk_input_length-1)==STRING.CUT("&clk", -1))
    ( 
      &match=1
    )
  )
  else if ("gcc_sec_ctrl_boot_rom_patch_clk"=="&clk")
  (
    &match=1
  )
  
  if (&match==1)
  (
    &clk_test=&CLK_TEST_GCC_SEC_CTRL_BOOT_ROM_PATCH_CLK
    &clk_reg=&HWIO_GCC_SEC_CTRL_BOOT_ROM_PATCH_CBCR_ADDR
    &clk_reg_name="GCC_SEC_CTRL_BOOT_ROM_PATCH_CBCR"
    &clk_name="gcc_sec_ctrl_boot_rom_patch_clk"
    &clk_reg_cbcr_type="sm_cbc"
    &clk_vote_bit=-1.
    &clk_multiplier=4.
    &clk_access_mode="&GCC_access_mode"

    gosub Print_Clk_Info_Line
  )

  &match=0
  &wild_head=0
  &wild_tail=0
  &clk_input_length=STRING.LENGTH("&clk")
  &clk_itr_length=STRING.LENGTH("gcc_smmu_cfg_clk")

  if (STRING.SCAN("&clk", "*", 0)==0)
  (
    &wild_head=1
  )
  if (STRING.SCAN("&clk", "*", 1)==(STRING.LENGTH("&clk")-1))
  (
    &wild_tail=1
  )

  if ((&wild_head==1)&&(&wild_tail==1))
  (
    if (STRING.SCAN("gcc_smmu_cfg_clk", STRING.MID("&clk", 1, &clk_input_length-2), 0)!=-1)
    ( 
      &match=1
    )
  )
  else if (&wild_head==1)
  (
    if (STRING.MID("gcc_smmu_cfg_clk", &clk_itr_length-&clk_input_length+1, &clk_input_length-1)==STRING.CUT("&clk", 1))
    ( 
      &match=1
    )
  )
  else if (&wild_tail==1)
  (
    if (STRING.MID("gcc_smmu_cfg_clk", 0, &clk_input_length-1)==STRING.CUT("&clk", -1))
    ( 
      &match=1
    )
  )
  else if ("gcc_smmu_cfg_clk"=="&clk")
  (
    &match=1
  )
  
  if (&match==1)
  (
    &clk_test=&CLK_TEST_GCC_SMMU_CFG_CLK
    &clk_reg=&HWIO_GCC_SMMU_CFG_CBCR_ADDR
    &clk_reg_name="GCC_SMMU_CFG_CBCR"
    &clk_name="gcc_smmu_cfg_clk"
    &clk_reg_cbcr_type="sm_cbc"
    &clk_vote_bit=12.
    &clk_multiplier=4.
    &clk_access_mode="&GCC_access_mode"

    gosub Print_Clk_Info_Line
  )

  &match=0
  &wild_head=0
  &wild_tail=0
  &clk_input_length=STRING.LENGTH("&clk")
  &clk_itr_length=STRING.LENGTH("gcc_smmu_xpu_clk")

  if (STRING.SCAN("&clk", "*", 0)==0)
  (
    &wild_head=1
  )
  if (STRING.SCAN("&clk", "*", 1)==(STRING.LENGTH("&clk")-1))
  (
    &wild_tail=1
  )

  if ((&wild_head==1)&&(&wild_tail==1))
  (
    if (STRING.SCAN("gcc_smmu_xpu_clk", STRING.MID("&clk", 1, &clk_input_length-2), 0)!=-1)
    ( 
      &match=1
    )
  )
  else if (&wild_head==1)
  (
    if (STRING.MID("gcc_smmu_xpu_clk", &clk_itr_length-&clk_input_length+1, &clk_input_length-1)==STRING.CUT("&clk", 1))
    ( 
      &match=1
    )
  )
  else if (&wild_tail==1)
  (
    if (STRING.MID("gcc_smmu_xpu_clk", 0, &clk_input_length-1)==STRING.CUT("&clk", -1))
    ( 
      &match=1
    )
  )
  else if ("gcc_smmu_xpu_clk"=="&clk")
  (
    &match=1
  )
  
  if (&match==1)
  (
    &clk_test=&CLK_TEST_GCC_SMMU_XPU_CLK
    &clk_reg=&HWIO_GCC_SMMU_XPU_CBCR_ADDR
    &clk_reg_name="GCC_SMMU_XPU_CBCR"
    &clk_name="gcc_smmu_xpu_clk"
    &clk_reg_cbcr_type="sm_cbc"
    &clk_vote_bit=-1.
    &clk_multiplier=4.
    &clk_access_mode="&GCC_access_mode"

    gosub Print_Clk_Info_Line
  )

  &match=0
  &wild_head=0
  &wild_tail=0
  &clk_input_length=STRING.LENGTH("&clk")
  &clk_itr_length=STRING.LENGTH("gcc_snoc_pcnoc_ahb_clk")

  if (STRING.SCAN("&clk", "*", 0)==0)
  (
    &wild_head=1
  )
  if (STRING.SCAN("&clk", "*", 1)==(STRING.LENGTH("&clk")-1))
  (
    &wild_tail=1
  )

  if ((&wild_head==1)&&(&wild_tail==1))
  (
    if (STRING.SCAN("gcc_snoc_pcnoc_ahb_clk", STRING.MID("&clk", 1, &clk_input_length-2), 0)!=-1)
    ( 
      &match=1
    )
  )
  else if (&wild_head==1)
  (
    if (STRING.MID("gcc_snoc_pcnoc_ahb_clk", &clk_itr_length-&clk_input_length+1, &clk_input_length-1)==STRING.CUT("&clk", 1))
    ( 
      &match=1
    )
  )
  else if (&wild_tail==1)
  (
    if (STRING.MID("gcc_snoc_pcnoc_ahb_clk", 0, &clk_input_length-1)==STRING.CUT("&clk", -1))
    ( 
      &match=1
    )
  )
  else if ("gcc_snoc_pcnoc_ahb_clk"=="&clk")
  (
    &match=1
  )
  
  if (&match==1)
  (
    &clk_test=&CLK_TEST_GCC_SNOC_PCNOC_AHB_CLK
    &clk_reg=&HWIO_GCC_SNOC_PCNOC_AHB_CBCR_ADDR
    &clk_reg_name="GCC_SNOC_PCNOC_AHB_CBCR"
    &clk_name="gcc_snoc_pcnoc_ahb_clk"
    &clk_reg_cbcr_type="sm_cbc"
    &clk_vote_bit=-1.
    &clk_multiplier=4.
    &clk_access_mode="&GCC_access_mode"

    gosub Print_Clk_Info_Line
  )

  &match=0
  &wild_head=0
  &wild_tail=0
  &clk_input_length=STRING.LENGTH("&clk")
  &clk_itr_length=STRING.LENGTH("gcc_spdm_cfg_ahb_clk")

  if (STRING.SCAN("&clk", "*", 0)==0)
  (
    &wild_head=1
  )
  if (STRING.SCAN("&clk", "*", 1)==(STRING.LENGTH("&clk")-1))
  (
    &wild_tail=1
  )

  if ((&wild_head==1)&&(&wild_tail==1))
  (
    if (STRING.SCAN("gcc_spdm_cfg_ahb_clk", STRING.MID("&clk", 1, &clk_input_length-2), 0)!=-1)
    ( 
      &match=1
    )
  )
  else if (&wild_head==1)
  (
    if (STRING.MID("gcc_spdm_cfg_ahb_clk", &clk_itr_length-&clk_input_length+1, &clk_input_length-1)==STRING.CUT("&clk", 1))
    ( 
      &match=1
    )
  )
  else if (&wild_tail==1)
  (
    if (STRING.MID("gcc_spdm_cfg_ahb_clk", 0, &clk_input_length-1)==STRING.CUT("&clk", -1))
    ( 
      &match=1
    )
  )
  else if ("gcc_spdm_cfg_ahb_clk"=="&clk")
  (
    &match=1
  )
  
  if (&match==1)
  (
    &clk_test=&CLK_TEST_GCC_SPDM_CFG_AHB_CLK
    &clk_reg=&HWIO_GCC_SPDM_CFG_AHB_CBCR_ADDR
    &clk_reg_name="GCC_SPDM_CFG_AHB_CBCR"
    &clk_name="gcc_spdm_cfg_ahb_clk"
    &clk_reg_cbcr_type="sm_cbc"
    &clk_vote_bit=-1.
    &clk_multiplier=4.
    &clk_access_mode="&GCC_access_mode"

    gosub Print_Clk_Info_Line
  )

  &match=0
  &wild_head=0
  &wild_tail=0
  &clk_input_length=STRING.LENGTH("&clk")
  &clk_itr_length=STRING.LENGTH("gcc_spdm_mstr_ahb_clk")

  if (STRING.SCAN("&clk", "*", 0)==0)
  (
    &wild_head=1
  )
  if (STRING.SCAN("&clk", "*", 1)==(STRING.LENGTH("&clk")-1))
  (
    &wild_tail=1
  )

  if ((&wild_head==1)&&(&wild_tail==1))
  (
    if (STRING.SCAN("gcc_spdm_mstr_ahb_clk", STRING.MID("&clk", 1, &clk_input_length-2), 0)!=-1)
    ( 
      &match=1
    )
  )
  else if (&wild_head==1)
  (
    if (STRING.MID("gcc_spdm_mstr_ahb_clk", &clk_itr_length-&clk_input_length+1, &clk_input_length-1)==STRING.CUT("&clk", 1))
    ( 
      &match=1
    )
  )
  else if (&wild_tail==1)
  (
    if (STRING.MID("gcc_spdm_mstr_ahb_clk", 0, &clk_input_length-1)==STRING.CUT("&clk", -1))
    ( 
      &match=1
    )
  )
  else if ("gcc_spdm_mstr_ahb_clk"=="&clk")
  (
    &match=1
  )
  
  if (&match==1)
  (
    &clk_test=&CLK_TEST_GCC_SPDM_MSTR_AHB_CLK
    &clk_reg=&HWIO_GCC_SPDM_MSTR_AHB_CBCR_ADDR
    &clk_reg_name="GCC_SPDM_MSTR_AHB_CBCR"
    &clk_name="gcc_spdm_mstr_ahb_clk"
    &clk_reg_cbcr_type="sm_cbc"
    &clk_vote_bit=-1.
    &clk_multiplier=4.
    &clk_access_mode="&GCC_access_mode"

    gosub Print_Clk_Info_Line
  )

  &match=0
  &wild_head=0
  &wild_tail=0
  &clk_input_length=STRING.LENGTH("&clk")
  &clk_itr_length=STRING.LENGTH("gcc_spdm_pcnoc_cy_clk")

  if (STRING.SCAN("&clk", "*", 0)==0)
  (
    &wild_head=1
  )
  if (STRING.SCAN("&clk", "*", 1)==(STRING.LENGTH("&clk")-1))
  (
    &wild_tail=1
  )

  if ((&wild_head==1)&&(&wild_tail==1))
  (
    if (STRING.SCAN("gcc_spdm_pcnoc_cy_clk", STRING.MID("&clk", 1, &clk_input_length-2), 0)!=-1)
    ( 
      &match=1
    )
  )
  else if (&wild_head==1)
  (
    if (STRING.MID("gcc_spdm_pcnoc_cy_clk", &clk_itr_length-&clk_input_length+1, &clk_input_length-1)==STRING.CUT("&clk", 1))
    ( 
      &match=1
    )
  )
  else if (&wild_tail==1)
  (
    if (STRING.MID("gcc_spdm_pcnoc_cy_clk", 0, &clk_input_length-1)==STRING.CUT("&clk", -1))
    ( 
      &match=1
    )
  )
  else if ("gcc_spdm_pcnoc_cy_clk"=="&clk")
  (
    &match=1
  )
  
  if (&match==1)
  (
    &clk_test=&CLK_TEST_GCC_SPDM_PCNOC_CY_CLK
    &clk_reg=&HWIO_GCC_SPDM_PCNOC_CY_CBCR_ADDR
    &clk_reg_name="GCC_SPDM_PCNOC_CY_CBCR"
    &clk_name="gcc_spdm_pcnoc_cy_clk"
    &clk_reg_cbcr_type="sm_cbc"
    &clk_vote_bit=-1.
    &clk_multiplier=4.
    &clk_access_mode="&GCC_access_mode"

    gosub Print_Clk_Info_Line
  )

  &match=0
  &wild_head=0
  &wild_tail=0
  &clk_input_length=STRING.LENGTH("&clk")
  &clk_itr_length=STRING.LENGTH("gcc_spmi_pcnoc_ahb_clk")

  if (STRING.SCAN("&clk", "*", 0)==0)
  (
    &wild_head=1
  )
  if (STRING.SCAN("&clk", "*", 1)==(STRING.LENGTH("&clk")-1))
  (
    &wild_tail=1
  )

  if ((&wild_head==1)&&(&wild_tail==1))
  (
    if (STRING.SCAN("gcc_spmi_pcnoc_ahb_clk", STRING.MID("&clk", 1, &clk_input_length-2), 0)!=-1)
    ( 
      &match=1
    )
  )
  else if (&wild_head==1)
  (
    if (STRING.MID("gcc_spmi_pcnoc_ahb_clk", &clk_itr_length-&clk_input_length+1, &clk_input_length-1)==STRING.CUT("&clk", 1))
    ( 
      &match=1
    )
  )
  else if (&wild_tail==1)
  (
    if (STRING.MID("gcc_spmi_pcnoc_ahb_clk", 0, &clk_input_length-1)==STRING.CUT("&clk", -1))
    ( 
      &match=1
    )
  )
  else if ("gcc_spmi_pcnoc_ahb_clk"=="&clk")
  (
    &match=1
  )
  
  if (&match==1)
  (
    &clk_test=&CLK_TEST_GCC_SPMI_PCNOC_AHB_CLK
    &clk_reg=&HWIO_GCC_SPMI_PCNOC_AHB_CBCR_ADDR
    &clk_reg_name="GCC_SPMI_PCNOC_AHB_CBCR"
    &clk_name="gcc_spmi_pcnoc_ahb_clk"
    &clk_reg_cbcr_type="sm_cbc"
    &clk_vote_bit=3.
    &clk_multiplier=4.
    &clk_access_mode="&GCC_access_mode"

    gosub Print_Clk_Info_Line
  )

  &match=0
  &wild_head=0
  &wild_tail=0
  &clk_input_length=STRING.LENGTH("&clk")
  &clk_itr_length=STRING.LENGTH("gcc_tcsr_ahb_clk")

  if (STRING.SCAN("&clk", "*", 0)==0)
  (
    &wild_head=1
  )
  if (STRING.SCAN("&clk", "*", 1)==(STRING.LENGTH("&clk")-1))
  (
    &wild_tail=1
  )

  if ((&wild_head==1)&&(&wild_tail==1))
  (
    if (STRING.SCAN("gcc_tcsr_ahb_clk", STRING.MID("&clk", 1, &clk_input_length-2), 0)!=-1)
    ( 
      &match=1
    )
  )
  else if (&wild_head==1)
  (
    if (STRING.MID("gcc_tcsr_ahb_clk", &clk_itr_length-&clk_input_length+1, &clk_input_length-1)==STRING.CUT("&clk", 1))
    ( 
      &match=1
    )
  )
  else if (&wild_tail==1)
  (
    if (STRING.MID("gcc_tcsr_ahb_clk", 0, &clk_input_length-1)==STRING.CUT("&clk", -1))
    ( 
      &match=1
    )
  )
  else if ("gcc_tcsr_ahb_clk"=="&clk")
  (
    &match=1
  )
  
  if (&match==1)
  (
    &clk_test=&CLK_TEST_GCC_TCSR_AHB_CLK
    &clk_reg=&HWIO_GCC_TCSR_AHB_CBCR_ADDR
    &clk_reg_name="GCC_TCSR_AHB_CBCR"
    &clk_name="gcc_tcsr_ahb_clk"
    &clk_reg_cbcr_type="sm_cbc"
    &clk_vote_bit=-1.
    &clk_multiplier=4.
    &clk_access_mode="&GCC_access_mode"

    gosub Print_Clk_Info_Line
  )

  &match=0
  &wild_head=0
  &wild_tail=0
  &clk_input_length=STRING.LENGTH("&clk")
  &clk_itr_length=STRING.LENGTH("gcc_tic_cfg_ahb_clk")

  if (STRING.SCAN("&clk", "*", 0)==0)
  (
    &wild_head=1
  )
  if (STRING.SCAN("&clk", "*", 1)==(STRING.LENGTH("&clk")-1))
  (
    &wild_tail=1
  )

  if ((&wild_head==1)&&(&wild_tail==1))
  (
    if (STRING.SCAN("gcc_tic_cfg_ahb_clk", STRING.MID("&clk", 1, &clk_input_length-2), 0)!=-1)
    ( 
      &match=1
    )
  )
  else if (&wild_head==1)
  (
    if (STRING.MID("gcc_tic_cfg_ahb_clk", &clk_itr_length-&clk_input_length+1, &clk_input_length-1)==STRING.CUT("&clk", 1))
    ( 
      &match=1
    )
  )
  else if (&wild_tail==1)
  (
    if (STRING.MID("gcc_tic_cfg_ahb_clk", 0, &clk_input_length-1)==STRING.CUT("&clk", -1))
    ( 
      &match=1
    )
  )
  else if ("gcc_tic_cfg_ahb_clk"=="&clk")
  (
    &match=1
  )
  
  if (&match==1)
  (
    &clk_test=&CLK_TEST_GCC_TIC_CFG_AHB_CLK
    &clk_reg=&HWIO_GCC_TIC_CFG_AHB_CBCR_ADDR
    &clk_reg_name="GCC_TIC_CFG_AHB_CBCR"
    &clk_name="gcc_tic_cfg_ahb_clk"
    &clk_reg_cbcr_type="sm_pscbc"
    &clk_vote_bit=-1.
    &clk_multiplier=4.
    &clk_access_mode="&GCC_access_mode"

    gosub Print_Clk_Info_Line
  )

  &match=0
  &wild_head=0
  &wild_tail=0
  &clk_input_length=STRING.LENGTH("&clk")
  &clk_itr_length=STRING.LENGTH("gcc_tlmm_clk")

  if (STRING.SCAN("&clk", "*", 0)==0)
  (
    &wild_head=1
  )
  if (STRING.SCAN("&clk", "*", 1)==(STRING.LENGTH("&clk")-1))
  (
    &wild_tail=1
  )

  if ((&wild_head==1)&&(&wild_tail==1))
  (
    if (STRING.SCAN("gcc_tlmm_clk", STRING.MID("&clk", 1, &clk_input_length-2), 0)!=-1)
    ( 
      &match=1
    )
  )
  else if (&wild_head==1)
  (
    if (STRING.MID("gcc_tlmm_clk", &clk_itr_length-&clk_input_length+1, &clk_input_length-1)==STRING.CUT("&clk", 1))
    ( 
      &match=1
    )
  )
  else if (&wild_tail==1)
  (
    if (STRING.MID("gcc_tlmm_clk", 0, &clk_input_length-1)==STRING.CUT("&clk", -1))
    ( 
      &match=1
    )
  )
  else if ("gcc_tlmm_clk"=="&clk")
  (
    &match=1
  )
  
  if (&match==1)
  (
    &clk_test=&CLK_TEST_GCC_TLMM_CLK
    &clk_reg=&HWIO_GCC_TLMM_CBCR_ADDR
    &clk_reg_name="GCC_TLMM_CBCR"
    &clk_name="gcc_tlmm_clk"
    &clk_reg_cbcr_type="sm_cbc"
    &clk_vote_bit=4.
    &clk_multiplier=4.
    &clk_access_mode="&GCC_access_mode"

    gosub Print_Clk_Info_Line
  )

  &match=0
  &wild_head=0
  &wild_tail=0
  &clk_input_length=STRING.LENGTH("&clk")
  &clk_itr_length=STRING.LENGTH("gcc_tlmm_east_ahb_clk")

  if (STRING.SCAN("&clk", "*", 0)==0)
  (
    &wild_head=1
  )
  if (STRING.SCAN("&clk", "*", 1)==(STRING.LENGTH("&clk")-1))
  (
    &wild_tail=1
  )

  if ((&wild_head==1)&&(&wild_tail==1))
  (
    if (STRING.SCAN("gcc_tlmm_east_ahb_clk", STRING.MID("&clk", 1, &clk_input_length-2), 0)!=-1)
    ( 
      &match=1
    )
  )
  else if (&wild_head==1)
  (
    if (STRING.MID("gcc_tlmm_east_ahb_clk", &clk_itr_length-&clk_input_length+1, &clk_input_length-1)==STRING.CUT("&clk", 1))
    ( 
      &match=1
    )
  )
  else if (&wild_tail==1)
  (
    if (STRING.MID("gcc_tlmm_east_ahb_clk", 0, &clk_input_length-1)==STRING.CUT("&clk", -1))
    ( 
      &match=1
    )
  )
  else if ("gcc_tlmm_east_ahb_clk"=="&clk")
  (
    &match=1
  )
  
  if (&match==1)
  (
    &clk_test=&CLK_TEST_GCC_TLMM_EAST_AHB_CLK
    &clk_reg=&HWIO_GCC_TLMM_EAST_AHB_CBCR_ADDR
    &clk_reg_name="GCC_TLMM_EAST_AHB_CBCR"
    &clk_name="gcc_tlmm_east_ahb_clk"
    &clk_reg_cbcr_type="sm_cbc"
    &clk_vote_bit=5.
    &clk_multiplier=4.
    &clk_access_mode="&GCC_access_mode"

    gosub Print_Clk_Info_Line
  )

  &match=0
  &wild_head=0
  &wild_tail=0
  &clk_input_length=STRING.LENGTH("&clk")
  &clk_itr_length=STRING.LENGTH("gcc_tlmm_east_clk")

  if (STRING.SCAN("&clk", "*", 0)==0)
  (
    &wild_head=1
  )
  if (STRING.SCAN("&clk", "*", 1)==(STRING.LENGTH("&clk")-1))
  (
    &wild_tail=1
  )

  if ((&wild_head==1)&&(&wild_tail==1))
  (
    if (STRING.SCAN("gcc_tlmm_east_clk", STRING.MID("&clk", 1, &clk_input_length-2), 0)!=-1)
    ( 
      &match=1
    )
  )
  else if (&wild_head==1)
  (
    if (STRING.MID("gcc_tlmm_east_clk", &clk_itr_length-&clk_input_length+1, &clk_input_length-1)==STRING.CUT("&clk", 1))
    ( 
      &match=1
    )
  )
  else if (&wild_tail==1)
  (
    if (STRING.MID("gcc_tlmm_east_clk", 0, &clk_input_length-1)==STRING.CUT("&clk", -1))
    ( 
      &match=1
    )
  )
  else if ("gcc_tlmm_east_clk"=="&clk")
  (
    &match=1
  )
  
  if (&match==1)
  (
    &clk_test=&CLK_TEST_GCC_TLMM_EAST_CLK
    &clk_reg=&HWIO_GCC_TLMM_EAST_CBCR_ADDR
    &clk_reg_name="GCC_TLMM_EAST_CBCR"
    &clk_name="gcc_tlmm_east_clk"
    &clk_reg_cbcr_type="sm_cbc"
    &clk_vote_bit=4.
    &clk_multiplier=4.
    &clk_access_mode="&GCC_access_mode"

    gosub Print_Clk_Info_Line
  )

  &match=0
  &wild_head=0
  &wild_tail=0
  &clk_input_length=STRING.LENGTH("&clk")
  &clk_itr_length=STRING.LENGTH("gcc_tlmm_north_ahb_clk")

  if (STRING.SCAN("&clk", "*", 0)==0)
  (
    &wild_head=1
  )
  if (STRING.SCAN("&clk", "*", 1)==(STRING.LENGTH("&clk")-1))
  (
    &wild_tail=1
  )

  if ((&wild_head==1)&&(&wild_tail==1))
  (
    if (STRING.SCAN("gcc_tlmm_north_ahb_clk", STRING.MID("&clk", 1, &clk_input_length-2), 0)!=-1)
    ( 
      &match=1
    )
  )
  else if (&wild_head==1)
  (
    if (STRING.MID("gcc_tlmm_north_ahb_clk", &clk_itr_length-&clk_input_length+1, &clk_input_length-1)==STRING.CUT("&clk", 1))
    ( 
      &match=1
    )
  )
  else if (&wild_tail==1)
  (
    if (STRING.MID("gcc_tlmm_north_ahb_clk", 0, &clk_input_length-1)==STRING.CUT("&clk", -1))
    ( 
      &match=1
    )
  )
  else if ("gcc_tlmm_north_ahb_clk"=="&clk")
  (
    &match=1
  )
  
  if (&match==1)
  (
    &clk_test=&CLK_TEST_GCC_TLMM_NORTH_AHB_CLK
    &clk_reg=&HWIO_GCC_TLMM_NORTH_AHB_CBCR_ADDR
    &clk_reg_name="GCC_TLMM_NORTH_AHB_CBCR"
    &clk_name="gcc_tlmm_north_ahb_clk"
    &clk_reg_cbcr_type="sm_cbc"
    &clk_vote_bit=30.
    &clk_multiplier=4.
    &clk_access_mode="&GCC_access_mode"

    gosub Print_Clk_Info_Line
  )

  &match=0
  &wild_head=0
  &wild_tail=0
  &clk_input_length=STRING.LENGTH("&clk")
  &clk_itr_length=STRING.LENGTH("gcc_tlmm_north_clk")

  if (STRING.SCAN("&clk", "*", 0)==0)
  (
    &wild_head=1
  )
  if (STRING.SCAN("&clk", "*", 1)==(STRING.LENGTH("&clk")-1))
  (
    &wild_tail=1
  )

  if ((&wild_head==1)&&(&wild_tail==1))
  (
    if (STRING.SCAN("gcc_tlmm_north_clk", STRING.MID("&clk", 1, &clk_input_length-2), 0)!=-1)
    ( 
      &match=1
    )
  )
  else if (&wild_head==1)
  (
    if (STRING.MID("gcc_tlmm_north_clk", &clk_itr_length-&clk_input_length+1, &clk_input_length-1)==STRING.CUT("&clk", 1))
    ( 
      &match=1
    )
  )
  else if (&wild_tail==1)
  (
    if (STRING.MID("gcc_tlmm_north_clk", 0, &clk_input_length-1)==STRING.CUT("&clk", -1))
    ( 
      &match=1
    )
  )
  else if ("gcc_tlmm_north_clk"=="&clk")
  (
    &match=1
  )
  
  if (&match==1)
  (
    &clk_test=&CLK_TEST_GCC_TLMM_NORTH_CLK
    &clk_reg=&HWIO_GCC_TLMM_NORTH_CBCR_ADDR
    &clk_reg_name="GCC_TLMM_NORTH_CBCR"
    &clk_name="gcc_tlmm_north_clk"
    &clk_reg_cbcr_type="sm_cbc"
    &clk_vote_bit=4.
    &clk_multiplier=4.
    &clk_access_mode="&GCC_access_mode"

    gosub Print_Clk_Info_Line
  )

  &match=0
  &wild_head=0
  &wild_tail=0
  &clk_input_length=STRING.LENGTH("&clk")
  &clk_itr_length=STRING.LENGTH("gcc_tlmm_south_ahb_clk")

  if (STRING.SCAN("&clk", "*", 0)==0)
  (
    &wild_head=1
  )
  if (STRING.SCAN("&clk", "*", 1)==(STRING.LENGTH("&clk")-1))
  (
    &wild_tail=1
  )

  if ((&wild_head==1)&&(&wild_tail==1))
  (
    if (STRING.SCAN("gcc_tlmm_south_ahb_clk", STRING.MID("&clk", 1, &clk_input_length-2), 0)!=-1)
    ( 
      &match=1
    )
  )
  else if (&wild_head==1)
  (
    if (STRING.MID("gcc_tlmm_south_ahb_clk", &clk_itr_length-&clk_input_length+1, &clk_input_length-1)==STRING.CUT("&clk", 1))
    ( 
      &match=1
    )
  )
  else if (&wild_tail==1)
  (
    if (STRING.MID("gcc_tlmm_south_ahb_clk", 0, &clk_input_length-1)==STRING.CUT("&clk", -1))
    ( 
      &match=1
    )
  )
  else if ("gcc_tlmm_south_ahb_clk"=="&clk")
  (
    &match=1
  )
  
  if (&match==1)
  (
    &clk_test=&CLK_TEST_GCC_TLMM_SOUTH_AHB_CLK
    &clk_reg=&HWIO_GCC_TLMM_SOUTH_AHB_CBCR_ADDR
    &clk_reg_name="GCC_TLMM_SOUTH_AHB_CBCR"
    &clk_name="gcc_tlmm_south_ahb_clk"
    &clk_reg_cbcr_type="sm_cbc"
    &clk_vote_bit=29.
    &clk_multiplier=4.
    &clk_access_mode="&GCC_access_mode"

    gosub Print_Clk_Info_Line
  )

  &match=0
  &wild_head=0
  &wild_tail=0
  &clk_input_length=STRING.LENGTH("&clk")
  &clk_itr_length=STRING.LENGTH("gcc_tlmm_south_clk")

  if (STRING.SCAN("&clk", "*", 0)==0)
  (
    &wild_head=1
  )
  if (STRING.SCAN("&clk", "*", 1)==(STRING.LENGTH("&clk")-1))
  (
    &wild_tail=1
  )

  if ((&wild_head==1)&&(&wild_tail==1))
  (
    if (STRING.SCAN("gcc_tlmm_south_clk", STRING.MID("&clk", 1, &clk_input_length-2), 0)!=-1)
    ( 
      &match=1
    )
  )
  else if (&wild_head==1)
  (
    if (STRING.MID("gcc_tlmm_south_clk", &clk_itr_length-&clk_input_length+1, &clk_input_length-1)==STRING.CUT("&clk", 1))
    ( 
      &match=1
    )
  )
  else if (&wild_tail==1)
  (
    if (STRING.MID("gcc_tlmm_south_clk", 0, &clk_input_length-1)==STRING.CUT("&clk", -1))
    ( 
      &match=1
    )
  )
  else if ("gcc_tlmm_south_clk"=="&clk")
  (
    &match=1
  )
  
  if (&match==1)
  (
    &clk_test=&CLK_TEST_GCC_TLMM_SOUTH_CLK
    &clk_reg=&HWIO_GCC_TLMM_SOUTH_CBCR_ADDR
    &clk_reg_name="GCC_TLMM_SOUTH_CBCR"
    &clk_name="gcc_tlmm_south_clk"
    &clk_reg_cbcr_type="sm_cbc"
    &clk_vote_bit=4.
    &clk_multiplier=4.
    &clk_access_mode="&GCC_access_mode"

    gosub Print_Clk_Info_Line
  )

  &match=0
  &wild_head=0
  &wild_tail=0
  &clk_input_length=STRING.LENGTH("&clk")
  &clk_itr_length=STRING.LENGTH("gcc_usb_hs_phy_cfg_ahb_clk")

  if (STRING.SCAN("&clk", "*", 0)==0)
  (
    &wild_head=1
  )
  if (STRING.SCAN("&clk", "*", 1)==(STRING.LENGTH("&clk")-1))
  (
    &wild_tail=1
  )

  if ((&wild_head==1)&&(&wild_tail==1))
  (
    if (STRING.SCAN("gcc_usb_hs_phy_cfg_ahb_clk", STRING.MID("&clk", 1, &clk_input_length-2), 0)!=-1)
    ( 
      &match=1
    )
  )
  else if (&wild_head==1)
  (
    if (STRING.MID("gcc_usb_hs_phy_cfg_ahb_clk", &clk_itr_length-&clk_input_length+1, &clk_input_length-1)==STRING.CUT("&clk", 1))
    ( 
      &match=1
    )
  )
  else if (&wild_tail==1)
  (
    if (STRING.MID("gcc_usb_hs_phy_cfg_ahb_clk", 0, &clk_input_length-1)==STRING.CUT("&clk", -1))
    ( 
      &match=1
    )
  )
  else if ("gcc_usb_hs_phy_cfg_ahb_clk"=="&clk")
  (
    &match=1
  )
  
  if (&match==1)
  (
    &clk_test=&CLK_TEST_GCC_USB_HS_PHY_CFG_AHB_CLK
    &clk_reg=&HWIO_GCC_USB_HS_PHY_CFG_AHB_CBCR_ADDR
    &clk_reg_name="GCC_USB_HS_PHY_CFG_AHB_CBCR"
    &clk_name="gcc_usb_hs_phy_cfg_ahb_clk"
    &clk_reg_cbcr_type="sm_cbc"
    &clk_vote_bit=-1.
    &clk_multiplier=4.
    &clk_access_mode="&GCC_access_mode"

    gosub Print_Clk_Info_Line
  )

  &match=0
  &wild_head=0
  &wild_tail=0
  &clk_input_length=STRING.LENGTH("&clk")
  &clk_itr_length=STRING.LENGTH("gcc_wdsp_q6ss_ahbs_clk")

  if (STRING.SCAN("&clk", "*", 0)==0)
  (
    &wild_head=1
  )
  if (STRING.SCAN("&clk", "*", 1)==(STRING.LENGTH("&clk")-1))
  (
    &wild_tail=1
  )

  if ((&wild_head==1)&&(&wild_tail==1))
  (
    if (STRING.SCAN("gcc_wdsp_q6ss_ahbs_clk", STRING.MID("&clk", 1, &clk_input_length-2), 0)!=-1)
    ( 
      &match=1
    )
  )
  else if (&wild_head==1)
  (
    if (STRING.MID("gcc_wdsp_q6ss_ahbs_clk", &clk_itr_length-&clk_input_length+1, &clk_input_length-1)==STRING.CUT("&clk", 1))
    ( 
      &match=1
    )
  )
  else if (&wild_tail==1)
  (
    if (STRING.MID("gcc_wdsp_q6ss_ahbs_clk", 0, &clk_input_length-1)==STRING.CUT("&clk", -1))
    ( 
      &match=1
    )
  )
  else if ("gcc_wdsp_q6ss_ahbs_clk"=="&clk")
  (
    &match=1
  )
  
  if (&match==1)
  (
    &clk_test=&CLK_TEST_GCC_WDSP_Q6SS_AHBS_CLK
    &clk_reg=&HWIO_GCC_WDSP_Q6SS_AHBS_CBCR_ADDR
    &clk_reg_name="GCC_WDSP_Q6SS_AHBS_CBCR"
    &clk_name="gcc_wdsp_q6ss_ahbs_clk"
    &clk_reg_cbcr_type="sm_cbc"
    &clk_vote_bit=-1.
    &clk_multiplier=4.
    &clk_access_mode="&GCC_access_mode"

    gosub Print_Clk_Info_Line
  )

  &match=0
  &wild_head=0
  &wild_tail=0
  &clk_input_length=STRING.LENGTH("&clk")
  &clk_itr_length=STRING.LENGTH("gcc_pdm_xo4_clk")

  if (STRING.SCAN("&clk", "*", 0)==0)
  (
    &wild_head=1
  )
  if (STRING.SCAN("&clk", "*", 1)==(STRING.LENGTH("&clk")-1))
  (
    &wild_tail=1
  )

  if ((&wild_head==1)&&(&wild_tail==1))
  (
    if (STRING.SCAN("gcc_pdm_xo4_clk", STRING.MID("&clk", 1, &clk_input_length-2), 0)!=-1)
    ( 
      &match=1
    )
  )
  else if (&wild_head==1)
  (
    if (STRING.MID("gcc_pdm_xo4_clk", &clk_itr_length-&clk_input_length+1, &clk_input_length-1)==STRING.CUT("&clk", 1))
    ( 
      &match=1
    )
  )
  else if (&wild_tail==1)
  (
    if (STRING.MID("gcc_pdm_xo4_clk", 0, &clk_input_length-1)==STRING.CUT("&clk", -1))
    ( 
      &match=1
    )
  )
  else if ("gcc_pdm_xo4_clk"=="&clk")
  (
    &match=1
  )
  
  if (&match==1)
  (
    &clk_test=&CLK_TEST_GCC_PDM_XO4_CLK
    &clk_reg=&HWIO_GCC_PDM_XO4_CBCR_ADDR
    &clk_reg_name="GCC_PDM_XO4_CBCR"
    &clk_name="gcc_pdm_xo4_clk"
    &clk_reg_cbcr_type="sm_cbc"
    &clk_vote_bit=-1.
    &clk_multiplier=4.
    &clk_access_mode="&GCC_access_mode"

    gosub Print_Clk_Info_Line
  )

  &match=0
  &wild_head=0
  &wild_tail=0
  &clk_input_length=STRING.LENGTH("&clk")
  &clk_itr_length=STRING.LENGTH("gcc_pdm2_clk")

  if (STRING.SCAN("&clk", "*", 0)==0)
  (
    &wild_head=1
  )
  if (STRING.SCAN("&clk", "*", 1)==(STRING.LENGTH("&clk")-1))
  (
    &wild_tail=1
  )

  if ((&wild_head==1)&&(&wild_tail==1))
  (
    if (STRING.SCAN("gcc_pdm2_clk", STRING.MID("&clk", 1, &clk_input_length-2), 0)!=-1)
    ( 
      &match=1
    )
  )
  else if (&wild_head==1)
  (
    if (STRING.MID("gcc_pdm2_clk", &clk_itr_length-&clk_input_length+1, &clk_input_length-1)==STRING.CUT("&clk", 1))
    ( 
      &match=1
    )
  )
  else if (&wild_tail==1)
  (
    if (STRING.MID("gcc_pdm2_clk", 0, &clk_input_length-1)==STRING.CUT("&clk", -1))
    ( 
      &match=1
    )
  )
  else if ("gcc_pdm2_clk"=="&clk")
  (
    &match=1
  )
  
  if (&match==1)
  (
    &clk_test=&CLK_TEST_GCC_PDM2_CLK
    &clk_reg=&HWIO_GCC_PDM2_CBCR_ADDR
    &clk_reg_name="GCC_PDM2_CBCR"
    &clk_name="gcc_pdm2_clk"
    &clk_reg_cbcr_type="sm_cbc"
    &clk_vote_bit=-1.
    &clk_multiplier=4.
    &clk_access_mode="&GCC_access_mode"

    gosub Print_Clk_Info_Line
  )

  &match=0
  &wild_head=0
  &wild_tail=0
  &clk_input_length=STRING.LENGTH("&clk")
  &clk_itr_length=STRING.LENGTH("gcc_pwm0_xo512_clk")

  if (STRING.SCAN("&clk", "*", 0)==0)
  (
    &wild_head=1
  )
  if (STRING.SCAN("&clk", "*", 1)==(STRING.LENGTH("&clk")-1))
  (
    &wild_tail=1
  )

  if ((&wild_head==1)&&(&wild_tail==1))
  (
    if (STRING.SCAN("gcc_pwm0_xo512_clk", STRING.MID("&clk", 1, &clk_input_length-2), 0)!=-1)
    ( 
      &match=1
    )
  )
  else if (&wild_head==1)
  (
    if (STRING.MID("gcc_pwm0_xo512_clk", &clk_itr_length-&clk_input_length+1, &clk_input_length-1)==STRING.CUT("&clk", 1))
    ( 
      &match=1
    )
  )
  else if (&wild_tail==1)
  (
    if (STRING.MID("gcc_pwm0_xo512_clk", 0, &clk_input_length-1)==STRING.CUT("&clk", -1))
    ( 
      &match=1
    )
  )
  else if ("gcc_pwm0_xo512_clk"=="&clk")
  (
    &match=1
  )
  
  if (&match==1)
  (
    &clk_test=&CLK_TEST_GCC_PWM0_XO512_CLK
    &clk_reg=&HWIO_GCC_PWM0_XO512_CBCR_ADDR
    &clk_reg_name="GCC_PWM0_XO512_CBCR"
    &clk_name="gcc_pwm0_xo512_clk"
    &clk_reg_cbcr_type="sm_cbc"
    &clk_vote_bit=-1.
    &clk_multiplier=4.
    &clk_access_mode="&GCC_access_mode"

    gosub Print_Clk_Info_Line
  )

  &match=0
  &wild_head=0
  &wild_tail=0
  &clk_input_length=STRING.LENGTH("&clk")
  &clk_itr_length=STRING.LENGTH("gcc_pwm1_xo512_clk")

  if (STRING.SCAN("&clk", "*", 0)==0)
  (
    &wild_head=1
  )
  if (STRING.SCAN("&clk", "*", 1)==(STRING.LENGTH("&clk")-1))
  (
    &wild_tail=1
  )

  if ((&wild_head==1)&&(&wild_tail==1))
  (
    if (STRING.SCAN("gcc_pwm1_xo512_clk", STRING.MID("&clk", 1, &clk_input_length-2), 0)!=-1)
    ( 
      &match=1
    )
  )
  else if (&wild_head==1)
  (
    if (STRING.MID("gcc_pwm1_xo512_clk", &clk_itr_length-&clk_input_length+1, &clk_input_length-1)==STRING.CUT("&clk", 1))
    ( 
      &match=1
    )
  )
  else if (&wild_tail==1)
  (
    if (STRING.MID("gcc_pwm1_xo512_clk", 0, &clk_input_length-1)==STRING.CUT("&clk", -1))
    ( 
      &match=1
    )
  )
  else if ("gcc_pwm1_xo512_clk"=="&clk")
  (
    &match=1
  )
  
  if (&match==1)
  (
    &clk_test=&CLK_TEST_GCC_PWM1_XO512_CLK
    &clk_reg=&HWIO_GCC_PWM1_XO512_CBCR_ADDR
    &clk_reg_name="GCC_PWM1_XO512_CBCR"
    &clk_name="gcc_pwm1_xo512_clk"
    &clk_reg_cbcr_type="sm_cbc"
    &clk_vote_bit=-1.
    &clk_multiplier=4.
    &clk_access_mode="&GCC_access_mode"

    gosub Print_Clk_Info_Line
  )

  &match=0
  &wild_head=0
  &wild_tail=0
  &clk_input_length=STRING.LENGTH("&clk")
  &clk_itr_length=STRING.LENGTH("gcc_pwm2_xo512_clk")

  if (STRING.SCAN("&clk", "*", 0)==0)
  (
    &wild_head=1
  )
  if (STRING.SCAN("&clk", "*", 1)==(STRING.LENGTH("&clk")-1))
  (
    &wild_tail=1
  )

  if ((&wild_head==1)&&(&wild_tail==1))
  (
    if (STRING.SCAN("gcc_pwm2_xo512_clk", STRING.MID("&clk", 1, &clk_input_length-2), 0)!=-1)
    ( 
      &match=1
    )
  )
  else if (&wild_head==1)
  (
    if (STRING.MID("gcc_pwm2_xo512_clk", &clk_itr_length-&clk_input_length+1, &clk_input_length-1)==STRING.CUT("&clk", 1))
    ( 
      &match=1
    )
  )
  else if (&wild_tail==1)
  (
    if (STRING.MID("gcc_pwm2_xo512_clk", 0, &clk_input_length-1)==STRING.CUT("&clk", -1))
    ( 
      &match=1
    )
  )
  else if ("gcc_pwm2_xo512_clk"=="&clk")
  (
    &match=1
  )
  
  if (&match==1)
  (
    &clk_test=&CLK_TEST_GCC_PWM2_XO512_CLK
    &clk_reg=&HWIO_GCC_PWM2_XO512_CBCR_ADDR
    &clk_reg_name="GCC_PWM2_XO512_CBCR"
    &clk_name="gcc_pwm2_xo512_clk"
    &clk_reg_cbcr_type="sm_cbc"
    &clk_vote_bit=-1.
    &clk_multiplier=4.
    &clk_access_mode="&GCC_access_mode"

    gosub Print_Clk_Info_Line
  )

  &match=0
  &wild_head=0
  &wild_tail=0
  &clk_input_length=STRING.LENGTH("&clk")
  &clk_itr_length=STRING.LENGTH("gcc_qdss_apb2jtag_clk")

  if (STRING.SCAN("&clk", "*", 0)==0)
  (
    &wild_head=1
  )
  if (STRING.SCAN("&clk", "*", 1)==(STRING.LENGTH("&clk")-1))
  (
    &wild_tail=1
  )

  if ((&wild_head==1)&&(&wild_tail==1))
  (
    if (STRING.SCAN("gcc_qdss_apb2jtag_clk", STRING.MID("&clk", 1, &clk_input_length-2), 0)!=-1)
    ( 
      &match=1
    )
  )
  else if (&wild_head==1)
  (
    if (STRING.MID("gcc_qdss_apb2jtag_clk", &clk_itr_length-&clk_input_length+1, &clk_input_length-1)==STRING.CUT("&clk", 1))
    ( 
      &match=1
    )
  )
  else if (&wild_tail==1)
  (
    if (STRING.MID("gcc_qdss_apb2jtag_clk", 0, &clk_input_length-1)==STRING.CUT("&clk", -1))
    ( 
      &match=1
    )
  )
  else if ("gcc_qdss_apb2jtag_clk"=="&clk")
  (
    &match=1
  )
  
  if (&match==1)
  (
    &clk_test=&CLK_TEST_GCC_QDSS_APB2JTAG_CLK
    &clk_reg=&HWIO_GCC_QDSS_APB2JTAG_CBCR_ADDR
    &clk_reg_name="GCC_QDSS_APB2JTAG_CBCR"
    &clk_name="gcc_qdss_apb2jtag_clk"
    &clk_reg_cbcr_type="sm_cbc"
    &clk_vote_bit=-1.
    &clk_multiplier=4.
    &clk_access_mode="&GCC_access_mode"

    gosub Print_Clk_Info_Line
  )

  &match=0
  &wild_head=0
  &wild_tail=0
  &clk_input_length=STRING.LENGTH("&clk")
  &clk_itr_length=STRING.LENGTH("gcc_qdss_dap_clk")

  if (STRING.SCAN("&clk", "*", 0)==0)
  (
    &wild_head=1
  )
  if (STRING.SCAN("&clk", "*", 1)==(STRING.LENGTH("&clk")-1))
  (
    &wild_tail=1
  )

  if ((&wild_head==1)&&(&wild_tail==1))
  (
    if (STRING.SCAN("gcc_qdss_dap_clk", STRING.MID("&clk", 1, &clk_input_length-2), 0)!=-1)
    ( 
      &match=1
    )
  )
  else if (&wild_head==1)
  (
    if (STRING.MID("gcc_qdss_dap_clk", &clk_itr_length-&clk_input_length+1, &clk_input_length-1)==STRING.CUT("&clk", 1))
    ( 
      &match=1
    )
  )
  else if (&wild_tail==1)
  (
    if (STRING.MID("gcc_qdss_dap_clk", 0, &clk_input_length-1)==STRING.CUT("&clk", -1))
    ( 
      &match=1
    )
  )
  else if ("gcc_qdss_dap_clk"=="&clk")
  (
    &match=1
  )
  
  if (&match==1)
  (
    &clk_test=&CLK_TEST_GCC_QDSS_DAP_CLK
    &clk_reg=&HWIO_GCC_QDSS_DAP_CBCR_ADDR
    &clk_reg_name="GCC_QDSS_DAP_CBCR"
    &clk_name="gcc_qdss_dap_clk"
    &clk_reg_cbcr_type="sm_cbc"
    &clk_vote_bit=21.
    &clk_multiplier=4.
    &clk_access_mode="&GCC_access_mode"

    gosub Print_Clk_Info_Line
  )

  &match=0
  &wild_head=0
  &wild_tail=0
  &clk_input_length=STRING.LENGTH("&clk")
  &clk_itr_length=STRING.LENGTH("gcc_qdss_tsctr_clk")

  if (STRING.SCAN("&clk", "*", 0)==0)
  (
    &wild_head=1
  )
  if (STRING.SCAN("&clk", "*", 1)==(STRING.LENGTH("&clk")-1))
  (
    &wild_tail=1
  )

  if ((&wild_head==1)&&(&wild_tail==1))
  (
    if (STRING.SCAN("gcc_qdss_tsctr_clk", STRING.MID("&clk", 1, &clk_input_length-2), 0)!=-1)
    ( 
      &match=1
    )
  )
  else if (&wild_head==1)
  (
    if (STRING.MID("gcc_qdss_tsctr_clk", &clk_itr_length-&clk_input_length+1, &clk_input_length-1)==STRING.CUT("&clk", 1))
    ( 
      &match=1
    )
  )
  else if (&wild_tail==1)
  (
    if (STRING.MID("gcc_qdss_tsctr_clk", 0, &clk_input_length-1)==STRING.CUT("&clk", -1))
    ( 
      &match=1
    )
  )
  else if ("gcc_qdss_tsctr_clk"=="&clk")
  (
    &match=1
  )
  
  if (&match==1)
  (
    &clk_test=&CLK_TEST_GCC_QDSS_TSCTR_CLK
    &clk_reg=&HWIO_GCC_QDSS_TSCTR_CBCR_ADDR
    &clk_reg_name="GCC_QDSS_TSCTR_CBCR"
    &clk_name="gcc_qdss_tsctr_clk"
    &clk_reg_cbcr_type="sm_cbc"
    &clk_vote_bit=-1.
    &clk_multiplier=4.
    &clk_access_mode="&GCC_access_mode"

    gosub Print_Clk_Info_Line
  )

  &match=0
  &wild_head=0
  &wild_tail=0
  &clk_input_length=STRING.LENGTH("&clk")
  &clk_itr_length=STRING.LENGTH("gcc_wcss_apb_clk")

  if (STRING.SCAN("&clk", "*", 0)==0)
  (
    &wild_head=1
  )
  if (STRING.SCAN("&clk", "*", 1)==(STRING.LENGTH("&clk")-1))
  (
    &wild_tail=1
  )

  if ((&wild_head==1)&&(&wild_tail==1))
  (
    if (STRING.SCAN("gcc_wcss_apb_clk", STRING.MID("&clk", 1, &clk_input_length-2), 0)!=-1)
    ( 
      &match=1
    )
  )
  else if (&wild_head==1)
  (
    if (STRING.MID("gcc_wcss_apb_clk", &clk_itr_length-&clk_input_length+1, &clk_input_length-1)==STRING.CUT("&clk", 1))
    ( 
      &match=1
    )
  )
  else if (&wild_tail==1)
  (
    if (STRING.MID("gcc_wcss_apb_clk", 0, &clk_input_length-1)==STRING.CUT("&clk", -1))
    ( 
      &match=1
    )
  )
  else if ("gcc_wcss_apb_clk"=="&clk")
  (
    &match=1
  )
  
  if (&match==1)
  (
    &clk_test=&CLK_TEST_GCC_WCSS_APB_CLK
    &clk_reg=&HWIO_GCC_WCSS_APB_CBCR_ADDR
    &clk_reg_name="GCC_WCSS_APB_CBCR"
    &clk_name="gcc_wcss_apb_clk"
    &clk_reg_cbcr_type="sm_cbc"
    &clk_vote_bit=-1.
    &clk_multiplier=4.
    &clk_access_mode="&GCC_access_mode"

    gosub Print_Clk_Info_Line
  )

  &match=0
  &wild_head=0
  &wild_tail=0
  &clk_input_length=STRING.LENGTH("&clk")
  &clk_itr_length=STRING.LENGTH("gcc_wcss_tsctr_clk")

  if (STRING.SCAN("&clk", "*", 0)==0)
  (
    &wild_head=1
  )
  if (STRING.SCAN("&clk", "*", 1)==(STRING.LENGTH("&clk")-1))
  (
    &wild_tail=1
  )

  if ((&wild_head==1)&&(&wild_tail==1))
  (
    if (STRING.SCAN("gcc_wcss_tsctr_clk", STRING.MID("&clk", 1, &clk_input_length-2), 0)!=-1)
    ( 
      &match=1
    )
  )
  else if (&wild_head==1)
  (
    if (STRING.MID("gcc_wcss_tsctr_clk", &clk_itr_length-&clk_input_length+1, &clk_input_length-1)==STRING.CUT("&clk", 1))
    ( 
      &match=1
    )
  )
  else if (&wild_tail==1)
  (
    if (STRING.MID("gcc_wcss_tsctr_clk", 0, &clk_input_length-1)==STRING.CUT("&clk", -1))
    ( 
      &match=1
    )
  )
  else if ("gcc_wcss_tsctr_clk"=="&clk")
  (
    &match=1
  )
  
  if (&match==1)
  (
    &clk_test=&CLK_TEST_GCC_WCSS_TSCTR_CLK
    &clk_reg=&HWIO_GCC_WCSS_TSCTR_CBCR_ADDR
    &clk_reg_name="GCC_WCSS_TSCTR_CBCR"
    &clk_name="gcc_wcss_tsctr_clk"
    &clk_reg_cbcr_type="sm_cbc"
    &clk_vote_bit=-1.
    &clk_multiplier=4.
    &clk_access_mode="&GCC_access_mode"

    gosub Print_Clk_Info_Line
  )

  &match=0
  &wild_head=0
  &wild_tail=0
  &clk_input_length=STRING.LENGTH("&clk")
  &clk_itr_length=STRING.LENGTH("gcc_lpass_at_clk")

  if (STRING.SCAN("&clk", "*", 0)==0)
  (
    &wild_head=1
  )
  if (STRING.SCAN("&clk", "*", 1)==(STRING.LENGTH("&clk")-1))
  (
    &wild_tail=1
  )

  if ((&wild_head==1)&&(&wild_tail==1))
  (
    if (STRING.SCAN("gcc_lpass_at_clk", STRING.MID("&clk", 1, &clk_input_length-2), 0)!=-1)
    ( 
      &match=1
    )
  )
  else if (&wild_head==1)
  (
    if (STRING.MID("gcc_lpass_at_clk", &clk_itr_length-&clk_input_length+1, &clk_input_length-1)==STRING.CUT("&clk", 1))
    ( 
      &match=1
    )
  )
  else if (&wild_tail==1)
  (
    if (STRING.MID("gcc_lpass_at_clk", 0, &clk_input_length-1)==STRING.CUT("&clk", -1))
    ( 
      &match=1
    )
  )
  else if ("gcc_lpass_at_clk"=="&clk")
  (
    &match=1
  )
  
  if (&match==1)
  (
    &clk_test=&CLK_TEST_GCC_LPASS_AT_CLK
    &clk_reg=&HWIO_GCC_LPASS_AT_CBCR_ADDR
    &clk_reg_name="GCC_LPASS_AT_CBCR"
    &clk_name="gcc_lpass_at_clk"
    &clk_reg_cbcr_type="sm_cbc"
    &clk_vote_bit=-1.
    &clk_multiplier=4.
    &clk_access_mode="&GCC_access_mode"

    gosub Print_Clk_Info_Line
  )

  &match=0
  &wild_head=0
  &wild_tail=0
  &clk_input_length=STRING.LENGTH("&clk")
  &clk_itr_length=STRING.LENGTH("gcc_pcnoc_at_clk")

  if (STRING.SCAN("&clk", "*", 0)==0)
  (
    &wild_head=1
  )
  if (STRING.SCAN("&clk", "*", 1)==(STRING.LENGTH("&clk")-1))
  (
    &wild_tail=1
  )

  if ((&wild_head==1)&&(&wild_tail==1))
  (
    if (STRING.SCAN("gcc_pcnoc_at_clk", STRING.MID("&clk", 1, &clk_input_length-2), 0)!=-1)
    ( 
      &match=1
    )
  )
  else if (&wild_head==1)
  (
    if (STRING.MID("gcc_pcnoc_at_clk", &clk_itr_length-&clk_input_length+1, &clk_input_length-1)==STRING.CUT("&clk", 1))
    ( 
      &match=1
    )
  )
  else if (&wild_tail==1)
  (
    if (STRING.MID("gcc_pcnoc_at_clk", 0, &clk_input_length-1)==STRING.CUT("&clk", -1))
    ( 
      &match=1
    )
  )
  else if ("gcc_pcnoc_at_clk"=="&clk")
  (
    &match=1
  )
  
  if (&match==1)
  (
    &clk_test=&CLK_TEST_GCC_PCNOC_AT_CLK
    &clk_reg=&HWIO_GCC_PCNOC_AT_CBCR_ADDR
    &clk_reg_name="GCC_PCNOC_AT_CBCR"
    &clk_name="gcc_pcnoc_at_clk"
    &clk_reg_cbcr_type="sm_cbc"
    &clk_vote_bit=-1.
    &clk_multiplier=4.
    &clk_access_mode="&GCC_access_mode"

    gosub Print_Clk_Info_Line
  )

  &match=0
  &wild_head=0
  &wild_tail=0
  &clk_input_length=STRING.LENGTH("&clk")
  &clk_itr_length=STRING.LENGTH("gcc_qdss_at_clk")

  if (STRING.SCAN("&clk", "*", 0)==0)
  (
    &wild_head=1
  )
  if (STRING.SCAN("&clk", "*", 1)==(STRING.LENGTH("&clk")-1))
  (
    &wild_tail=1
  )

  if ((&wild_head==1)&&(&wild_tail==1))
  (
    if (STRING.SCAN("gcc_qdss_at_clk", STRING.MID("&clk", 1, &clk_input_length-2), 0)!=-1)
    ( 
      &match=1
    )
  )
  else if (&wild_head==1)
  (
    if (STRING.MID("gcc_qdss_at_clk", &clk_itr_length-&clk_input_length+1, &clk_input_length-1)==STRING.CUT("&clk", 1))
    ( 
      &match=1
    )
  )
  else if (&wild_tail==1)
  (
    if (STRING.MID("gcc_qdss_at_clk", 0, &clk_input_length-1)==STRING.CUT("&clk", -1))
    ( 
      &match=1
    )
  )
  else if ("gcc_qdss_at_clk"=="&clk")
  (
    &match=1
  )
  
  if (&match==1)
  (
    &clk_test=&CLK_TEST_GCC_QDSS_AT_CLK
    &clk_reg=&HWIO_GCC_QDSS_AT_CBCR_ADDR
    &clk_reg_name="GCC_QDSS_AT_CBCR"
    &clk_name="gcc_qdss_at_clk"
    &clk_reg_cbcr_type="sm_pscbc"
    &clk_vote_bit=-1.
    &clk_multiplier=4.
    &clk_access_mode="&GCC_access_mode"

    gosub Print_Clk_Info_Line
  )

  &match=0
  &wild_head=0
  &wild_tail=0
  &clk_input_length=STRING.LENGTH("&clk")
  &clk_itr_length=STRING.LENGTH("gcc_sys_noc_at_clk")

  if (STRING.SCAN("&clk", "*", 0)==0)
  (
    &wild_head=1
  )
  if (STRING.SCAN("&clk", "*", 1)==(STRING.LENGTH("&clk")-1))
  (
    &wild_tail=1
  )

  if ((&wild_head==1)&&(&wild_tail==1))
  (
    if (STRING.SCAN("gcc_sys_noc_at_clk", STRING.MID("&clk", 1, &clk_input_length-2), 0)!=-1)
    ( 
      &match=1
    )
  )
  else if (&wild_head==1)
  (
    if (STRING.MID("gcc_sys_noc_at_clk", &clk_itr_length-&clk_input_length+1, &clk_input_length-1)==STRING.CUT("&clk", 1))
    ( 
      &match=1
    )
  )
  else if (&wild_tail==1)
  (
    if (STRING.MID("gcc_sys_noc_at_clk", 0, &clk_input_length-1)==STRING.CUT("&clk", -1))
    ( 
      &match=1
    )
  )
  else if ("gcc_sys_noc_at_clk"=="&clk")
  (
    &match=1
  )
  
  if (&match==1)
  (
    &clk_test=&CLK_TEST_GCC_SYS_NOC_AT_CLK
    &clk_reg=&HWIO_GCC_SYS_NOC_AT_CBCR_ADDR
    &clk_reg_name="GCC_SYS_NOC_AT_CBCR"
    &clk_name="gcc_sys_noc_at_clk"
    &clk_reg_cbcr_type="sm_cbc"
    &clk_vote_bit=-1.
    &clk_multiplier=4.
    &clk_access_mode="&GCC_access_mode"

    gosub Print_Clk_Info_Line
  )

  &match=0
  &wild_head=0
  &wild_tail=0
  &clk_input_length=STRING.LENGTH("&clk")
  &clk_itr_length=STRING.LENGTH("gcc_wcss_at_clk")

  if (STRING.SCAN("&clk", "*", 0)==0)
  (
    &wild_head=1
  )
  if (STRING.SCAN("&clk", "*", 1)==(STRING.LENGTH("&clk")-1))
  (
    &wild_tail=1
  )

  if ((&wild_head==1)&&(&wild_tail==1))
  (
    if (STRING.SCAN("gcc_wcss_at_clk", STRING.MID("&clk", 1, &clk_input_length-2), 0)!=-1)
    ( 
      &match=1
    )
  )
  else if (&wild_head==1)
  (
    if (STRING.MID("gcc_wcss_at_clk", &clk_itr_length-&clk_input_length+1, &clk_input_length-1)==STRING.CUT("&clk", 1))
    ( 
      &match=1
    )
  )
  else if (&wild_tail==1)
  (
    if (STRING.MID("gcc_wcss_at_clk", 0, &clk_input_length-1)==STRING.CUT("&clk", -1))
    ( 
      &match=1
    )
  )
  else if ("gcc_wcss_at_clk"=="&clk")
  (
    &match=1
  )
  
  if (&match==1)
  (
    &clk_test=&CLK_TEST_GCC_WCSS_AT_CLK
    &clk_reg=&HWIO_GCC_WCSS_AT_CBCR_ADDR
    &clk_reg_name="GCC_WCSS_AT_CBCR"
    &clk_name="gcc_wcss_at_clk"
    &clk_reg_cbcr_type="sm_cbc"
    &clk_vote_bit=-1.
    &clk_multiplier=4.
    &clk_access_mode="&GCC_access_mode"

    gosub Print_Clk_Info_Line
  )

  &match=0
  &wild_head=0
  &wild_tail=0
  &clk_input_length=STRING.LENGTH("&clk")
  &clk_itr_length=STRING.LENGTH("gcc_qdss_stm_clk")

  if (STRING.SCAN("&clk", "*", 0)==0)
  (
    &wild_head=1
  )
  if (STRING.SCAN("&clk", "*", 1)==(STRING.LENGTH("&clk")-1))
  (
    &wild_tail=1
  )

  if ((&wild_head==1)&&(&wild_tail==1))
  (
    if (STRING.SCAN("gcc_qdss_stm_clk", STRING.MID("&clk", 1, &clk_input_length-2), 0)!=-1)
    ( 
      &match=1
    )
  )
  else if (&wild_head==1)
  (
    if (STRING.MID("gcc_qdss_stm_clk", &clk_itr_length-&clk_input_length+1, &clk_input_length-1)==STRING.CUT("&clk", 1))
    ( 
      &match=1
    )
  )
  else if (&wild_tail==1)
  (
    if (STRING.MID("gcc_qdss_stm_clk", 0, &clk_input_length-1)==STRING.CUT("&clk", -1))
    ( 
      &match=1
    )
  )
  else if ("gcc_qdss_stm_clk"=="&clk")
  (
    &match=1
  )
  
  if (&match==1)
  (
    &clk_test=&CLK_TEST_GCC_QDSS_STM_CLK
    &clk_reg=&HWIO_GCC_QDSS_STM_CBCR_ADDR
    &clk_reg_name="GCC_QDSS_STM_CBCR"
    &clk_name="gcc_qdss_stm_clk"
    &clk_reg_cbcr_type="sm_cbc"
    &clk_vote_bit=-1.
    &clk_multiplier=4.
    &clk_access_mode="&GCC_access_mode"

    gosub Print_Clk_Info_Line
  )

  &match=0
  &wild_head=0
  &wild_tail=0
  &clk_input_length=STRING.LENGTH("&clk")
  &clk_itr_length=STRING.LENGTH("gcc_sys_noc_qdss_stm_axi_clk")

  if (STRING.SCAN("&clk", "*", 0)==0)
  (
    &wild_head=1
  )
  if (STRING.SCAN("&clk", "*", 1)==(STRING.LENGTH("&clk")-1))
  (
    &wild_tail=1
  )

  if ((&wild_head==1)&&(&wild_tail==1))
  (
    if (STRING.SCAN("gcc_sys_noc_qdss_stm_axi_clk", STRING.MID("&clk", 1, &clk_input_length-2), 0)!=-1)
    ( 
      &match=1
    )
  )
  else if (&wild_head==1)
  (
    if (STRING.MID("gcc_sys_noc_qdss_stm_axi_clk", &clk_itr_length-&clk_input_length+1, &clk_input_length-1)==STRING.CUT("&clk", 1))
    ( 
      &match=1
    )
  )
  else if (&wild_tail==1)
  (
    if (STRING.MID("gcc_sys_noc_qdss_stm_axi_clk", 0, &clk_input_length-1)==STRING.CUT("&clk", -1))
    ( 
      &match=1
    )
  )
  else if ("gcc_sys_noc_qdss_stm_axi_clk"=="&clk")
  (
    &match=1
  )
  
  if (&match==1)
  (
    &clk_test=&CLK_TEST_GCC_SYS_NOC_QDSS_STM_AXI_CLK
    &clk_reg=&HWIO_GCC_SYS_NOC_QDSS_STM_AXI_CBCR_ADDR
    &clk_reg_name="GCC_SYS_NOC_QDSS_STM_AXI_CBCR"
    &clk_name="gcc_sys_noc_qdss_stm_axi_clk"
    &clk_reg_cbcr_type="sm_cbc"
    &clk_vote_bit=-1.
    &clk_multiplier=4.
    &clk_access_mode="&GCC_access_mode"

    gosub Print_Clk_Info_Line
  )

  &match=0
  &wild_head=0
  &wild_tail=0
  &clk_input_length=STRING.LENGTH("&clk")
  &clk_itr_length=STRING.LENGTH("gcc_qdss_traceclkin_clk")

  if (STRING.SCAN("&clk", "*", 0)==0)
  (
    &wild_head=1
  )
  if (STRING.SCAN("&clk", "*", 1)==(STRING.LENGTH("&clk")-1))
  (
    &wild_tail=1
  )

  if ((&wild_head==1)&&(&wild_tail==1))
  (
    if (STRING.SCAN("gcc_qdss_traceclkin_clk", STRING.MID("&clk", 1, &clk_input_length-2), 0)!=-1)
    ( 
      &match=1
    )
  )
  else if (&wild_head==1)
  (
    if (STRING.MID("gcc_qdss_traceclkin_clk", &clk_itr_length-&clk_input_length+1, &clk_input_length-1)==STRING.CUT("&clk", 1))
    ( 
      &match=1
    )
  )
  else if (&wild_tail==1)
  (
    if (STRING.MID("gcc_qdss_traceclkin_clk", 0, &clk_input_length-1)==STRING.CUT("&clk", -1))
    ( 
      &match=1
    )
  )
  else if ("gcc_qdss_traceclkin_clk"=="&clk")
  (
    &match=1
  )
  
  if (&match==1)
  (
    &clk_test=&CLK_TEST_GCC_QDSS_TRACECLKIN_CLK
    &clk_reg=&HWIO_GCC_QDSS_TRACECLKIN_CBCR_ADDR
    &clk_reg_name="GCC_QDSS_TRACECLKIN_CBCR"
    &clk_name="gcc_qdss_traceclkin_clk"
    &clk_reg_cbcr_type="sm_cbc"
    &clk_vote_bit=-1.
    &clk_multiplier=4.
    &clk_access_mode="&GCC_access_mode"

    gosub Print_Clk_Info_Line
  )

  &match=0
  &wild_head=0
  &wild_tail=0
  &clk_input_length=STRING.LENGTH("&clk")
  &clk_itr_length=STRING.LENGTH("gcc_qdss_trig_clk")

  if (STRING.SCAN("&clk", "*", 0)==0)
  (
    &wild_head=1
  )
  if (STRING.SCAN("&clk", "*", 1)==(STRING.LENGTH("&clk")-1))
  (
    &wild_tail=1
  )

  if ((&wild_head==1)&&(&wild_tail==1))
  (
    if (STRING.SCAN("gcc_qdss_trig_clk", STRING.MID("&clk", 1, &clk_input_length-2), 0)!=-1)
    ( 
      &match=1
    )
  )
  else if (&wild_head==1)
  (
    if (STRING.MID("gcc_qdss_trig_clk", &clk_itr_length-&clk_input_length+1, &clk_input_length-1)==STRING.CUT("&clk", 1))
    ( 
      &match=1
    )
  )
  else if (&wild_tail==1)
  (
    if (STRING.MID("gcc_qdss_trig_clk", 0, &clk_input_length-1)==STRING.CUT("&clk", -1))
    ( 
      &match=1
    )
  )
  else if ("gcc_qdss_trig_clk"=="&clk")
  (
    &match=1
  )
  
  if (&match==1)
  (
    &clk_test=&CLK_TEST_GCC_QDSS_TRIG_CLK
    &clk_reg=&HWIO_GCC_QDSS_TRIG_CBCR_ADDR
    &clk_reg_name="GCC_QDSS_TRIG_CBCR"
    &clk_name="gcc_qdss_trig_clk"
    &clk_reg_cbcr_type="sm_cbc"
    &clk_vote_bit=-1.
    &clk_multiplier=4.
    &clk_access_mode="&GCC_access_mode"

    gosub Print_Clk_Info_Line
  )

  &match=0
  &wild_head=0
  &wild_tail=0
  &clk_input_length=STRING.LENGTH("&clk")
  &clk_itr_length=STRING.LENGTH("gcc_qpic_clk")

  if (STRING.SCAN("&clk", "*", 0)==0)
  (
    &wild_head=1
  )
  if (STRING.SCAN("&clk", "*", 1)==(STRING.LENGTH("&clk")-1))
  (
    &wild_tail=1
  )

  if ((&wild_head==1)&&(&wild_tail==1))
  (
    if (STRING.SCAN("gcc_qpic_clk", STRING.MID("&clk", 1, &clk_input_length-2), 0)!=-1)
    ( 
      &match=1
    )
  )
  else if (&wild_head==1)
  (
    if (STRING.MID("gcc_qpic_clk", &clk_itr_length-&clk_input_length+1, &clk_input_length-1)==STRING.CUT("&clk", 1))
    ( 
      &match=1
    )
  )
  else if (&wild_tail==1)
  (
    if (STRING.MID("gcc_qpic_clk", 0, &clk_input_length-1)==STRING.CUT("&clk", -1))
    ( 
      &match=1
    )
  )
  else if ("gcc_qpic_clk"=="&clk")
  (
    &match=1
  )
  
  if (&match==1)
  (
    &clk_test=&CLK_TEST_GCC_QPIC_CLK
    &clk_reg=&HWIO_GCC_QPIC_CBCR_ADDR
    &clk_reg_name="GCC_QPIC_CBCR"
    &clk_name="gcc_qpic_clk"
    &clk_reg_cbcr_type="sm_pscbc"
    &clk_vote_bit=-1.
    &clk_multiplier=4.
    &clk_access_mode="&GCC_access_mode"

    gosub Print_Clk_Info_Line
  )

  &match=0
  &wild_head=0
  &wild_tail=0
  &clk_input_length=STRING.LENGTH("&clk")
  &clk_itr_length=STRING.LENGTH("gcc_rbcpr_clk")

  if (STRING.SCAN("&clk", "*", 0)==0)
  (
    &wild_head=1
  )
  if (STRING.SCAN("&clk", "*", 1)==(STRING.LENGTH("&clk")-1))
  (
    &wild_tail=1
  )

  if ((&wild_head==1)&&(&wild_tail==1))
  (
    if (STRING.SCAN("gcc_rbcpr_clk", STRING.MID("&clk", 1, &clk_input_length-2), 0)!=-1)
    ( 
      &match=1
    )
  )
  else if (&wild_head==1)
  (
    if (STRING.MID("gcc_rbcpr_clk", &clk_itr_length-&clk_input_length+1, &clk_input_length-1)==STRING.CUT("&clk", 1))
    ( 
      &match=1
    )
  )
  else if (&wild_tail==1)
  (
    if (STRING.MID("gcc_rbcpr_clk", 0, &clk_input_length-1)==STRING.CUT("&clk", -1))
    ( 
      &match=1
    )
  )
  else if ("gcc_rbcpr_clk"=="&clk")
  (
    &match=1
  )
  
  if (&match==1)
  (
    &clk_test=&CLK_TEST_GCC_RBCPR_CLK
    &clk_reg=&HWIO_GCC_RBCPR_CBCR_ADDR
    &clk_reg_name="GCC_RBCPR_CBCR"
    &clk_name="gcc_rbcpr_clk"
    &clk_reg_cbcr_type="sm_cbc"
    &clk_vote_bit=-1.
    &clk_multiplier=4.
    &clk_access_mode="&GCC_access_mode"

    gosub Print_Clk_Info_Line
  )

  &match=0
  &wild_head=0
  &wild_tail=0
  &clk_input_length=STRING.LENGTH("&clk")
  &clk_itr_length=STRING.LENGTH("gcc_rpm_bus_ahb_clk")

  if (STRING.SCAN("&clk", "*", 0)==0)
  (
    &wild_head=1
  )
  if (STRING.SCAN("&clk", "*", 1)==(STRING.LENGTH("&clk")-1))
  (
    &wild_tail=1
  )

  if ((&wild_head==1)&&(&wild_tail==1))
  (
    if (STRING.SCAN("gcc_rpm_bus_ahb_clk", STRING.MID("&clk", 1, &clk_input_length-2), 0)!=-1)
    ( 
      &match=1
    )
  )
  else if (&wild_head==1)
  (
    if (STRING.MID("gcc_rpm_bus_ahb_clk", &clk_itr_length-&clk_input_length+1, &clk_input_length-1)==STRING.CUT("&clk", 1))
    ( 
      &match=1
    )
  )
  else if (&wild_tail==1)
  (
    if (STRING.MID("gcc_rpm_bus_ahb_clk", 0, &clk_input_length-1)==STRING.CUT("&clk", -1))
    ( 
      &match=1
    )
  )
  else if ("gcc_rpm_bus_ahb_clk"=="&clk")
  (
    &match=1
  )
  
  if (&match==1)
  (
    &clk_test=&CLK_TEST_GCC_RPM_BUS_AHB_CLK
    &clk_reg=&HWIO_GCC_RPM_BUS_AHB_CBCR_ADDR
    &clk_reg_name="GCC_RPM_BUS_AHB_CBCR"
    &clk_name="gcc_rpm_bus_ahb_clk"
    &clk_reg_cbcr_type="sm_pscbc"
    &clk_vote_bit=-1.
    &clk_multiplier=4.
    &clk_access_mode="&GCC_access_mode"

    gosub Print_Clk_Info_Line
  )

  &match=0
  &wild_head=0
  &wild_tail=0
  &clk_input_length=STRING.LENGTH("&clk")
  &clk_itr_length=STRING.LENGTH("gcc_rpm_proc_fclk")

  if (STRING.SCAN("&clk", "*", 0)==0)
  (
    &wild_head=1
  )
  if (STRING.SCAN("&clk", "*", 1)==(STRING.LENGTH("&clk")-1))
  (
    &wild_tail=1
  )

  if ((&wild_head==1)&&(&wild_tail==1))
  (
    if (STRING.SCAN("gcc_rpm_proc_fclk", STRING.MID("&clk", 1, &clk_input_length-2), 0)!=-1)
    ( 
      &match=1
    )
  )
  else if (&wild_head==1)
  (
    if (STRING.MID("gcc_rpm_proc_fclk", &clk_itr_length-&clk_input_length+1, &clk_input_length-1)==STRING.CUT("&clk", 1))
    ( 
      &match=1
    )
  )
  else if (&wild_tail==1)
  (
    if (STRING.MID("gcc_rpm_proc_fclk", 0, &clk_input_length-1)==STRING.CUT("&clk", -1))
    ( 
      &match=1
    )
  )
  else if ("gcc_rpm_proc_fclk"=="&clk")||("cpus"=="&clk")
  (
    &match=1
  )
  
  if (&match==1)
  (
    &clk_test=&CLK_TEST_GCC_RPM_PROC_FCLK
    &clk_reg=0
    &clk_reg_name="No CBCR"
    &clk_name="gcc_rpm_proc_fclk"
    &clk_reg_cbcr_type=""
    &clk_vote_bit=-1.
    &clk_multiplier=4.
    &clk_access_mode="&GCC_access_mode"

    gosub Print_Clk_Info_Line
  )

  &match=0
  &wild_head=0
  &wild_tail=0
  &clk_input_length=STRING.LENGTH("&clk")
  &clk_itr_length=STRING.LENGTH("gcc_rpm_proc_hclk")

  if (STRING.SCAN("&clk", "*", 0)==0)
  (
    &wild_head=1
  )
  if (STRING.SCAN("&clk", "*", 1)==(STRING.LENGTH("&clk")-1))
  (
    &wild_tail=1
  )

  if ((&wild_head==1)&&(&wild_tail==1))
  (
    if (STRING.SCAN("gcc_rpm_proc_hclk", STRING.MID("&clk", 1, &clk_input_length-2), 0)!=-1)
    ( 
      &match=1
    )
  )
  else if (&wild_head==1)
  (
    if (STRING.MID("gcc_rpm_proc_hclk", &clk_itr_length-&clk_input_length+1, &clk_input_length-1)==STRING.CUT("&clk", 1))
    ( 
      &match=1
    )
  )
  else if (&wild_tail==1)
  (
    if (STRING.MID("gcc_rpm_proc_hclk", 0, &clk_input_length-1)==STRING.CUT("&clk", -1))
    ( 
      &match=1
    )
  )
  else if ("gcc_rpm_proc_hclk"=="&clk")
  (
    &match=1
  )
  
  if (&match==1)
  (
    &clk_test=&CLK_TEST_GCC_RPM_PROC_HCLK
    &clk_reg=&HWIO_GCC_RPM_PROC_HCLK_CBCR_ADDR
    &clk_reg_name="GCC_RPM_PROC_HCLK_CBCR"
    &clk_name="gcc_rpm_proc_hclk"
    &clk_reg_cbcr_type="sm_cbc"
    &clk_vote_bit=-1.
    &clk_multiplier=4.
    &clk_access_mode="&GCC_access_mode"

    gosub Print_Clk_Info_Line
  )

  &match=0
  &wild_head=0
  &wild_tail=0
  &clk_input_length=STRING.LENGTH("&clk")
  &clk_itr_length=STRING.LENGTH("gcc_rpm_timer_clk")

  if (STRING.SCAN("&clk", "*", 0)==0)
  (
    &wild_head=1
  )
  if (STRING.SCAN("&clk", "*", 1)==(STRING.LENGTH("&clk")-1))
  (
    &wild_tail=1
  )

  if ((&wild_head==1)&&(&wild_tail==1))
  (
    if (STRING.SCAN("gcc_rpm_timer_clk", STRING.MID("&clk", 1, &clk_input_length-2), 0)!=-1)
    ( 
      &match=1
    )
  )
  else if (&wild_head==1)
  (
    if (STRING.MID("gcc_rpm_timer_clk", &clk_itr_length-&clk_input_length+1, &clk_input_length-1)==STRING.CUT("&clk", 1))
    ( 
      &match=1
    )
  )
  else if (&wild_tail==1)
  (
    if (STRING.MID("gcc_rpm_timer_clk", 0, &clk_input_length-1)==STRING.CUT("&clk", -1))
    ( 
      &match=1
    )
  )
  else if ("gcc_rpm_timer_clk"=="&clk")
  (
    &match=1
  )
  
  if (&match==1)
  (
    &clk_test=&CLK_TEST_GCC_RPM_TIMER_CLK
    &clk_reg=&HWIO_GCC_RPM_TIMER_CBCR_ADDR
    &clk_reg_name="GCC_RPM_TIMER_CBCR"
    &clk_name="gcc_rpm_timer_clk"
    &clk_reg_cbcr_type="sm_cbc"
    &clk_vote_bit=-1.
    &clk_multiplier=4.
    &clk_access_mode="&GCC_access_mode"

    gosub Print_Clk_Info_Line
  )

  &match=0
  &wild_head=0
  &wild_tail=0
  &clk_input_length=STRING.LENGTH("&clk")
  &clk_itr_length=STRING.LENGTH("gcc_sdcc1_apps_clk")

  if (STRING.SCAN("&clk", "*", 0)==0)
  (
    &wild_head=1
  )
  if (STRING.SCAN("&clk", "*", 1)==(STRING.LENGTH("&clk")-1))
  (
    &wild_tail=1
  )

  if ((&wild_head==1)&&(&wild_tail==1))
  (
    if (STRING.SCAN("gcc_sdcc1_apps_clk", STRING.MID("&clk", 1, &clk_input_length-2), 0)!=-1)
    ( 
      &match=1
    )
  )
  else if (&wild_head==1)
  (
    if (STRING.MID("gcc_sdcc1_apps_clk", &clk_itr_length-&clk_input_length+1, &clk_input_length-1)==STRING.CUT("&clk", 1))
    ( 
      &match=1
    )
  )
  else if (&wild_tail==1)
  (
    if (STRING.MID("gcc_sdcc1_apps_clk", 0, &clk_input_length-1)==STRING.CUT("&clk", -1))
    ( 
      &match=1
    )
  )
  else if ("gcc_sdcc1_apps_clk"=="&clk")
  (
    &match=1
  )
  
  if (&match==1)
  (
    &clk_test=&CLK_TEST_GCC_SDCC1_APPS_CLK
    &clk_reg=&HWIO_GCC_SDCC1_APPS_CBCR_ADDR
    &clk_reg_name="GCC_SDCC1_APPS_CBCR"
    &clk_name="gcc_sdcc1_apps_clk"
    &clk_reg_cbcr_type="sm_pscbc"
    &clk_vote_bit=-1.
    &clk_multiplier=4.
    &clk_access_mode="&GCC_access_mode"

    gosub Print_Clk_Info_Line
  )

  &match=0
  &wild_head=0
  &wild_tail=0
  &clk_input_length=STRING.LENGTH("&clk")
  &clk_itr_length=STRING.LENGTH("gcc_sdcc1_ice_core_clk")

  if (STRING.SCAN("&clk", "*", 0)==0)
  (
    &wild_head=1
  )
  if (STRING.SCAN("&clk", "*", 1)==(STRING.LENGTH("&clk")-1))
  (
    &wild_tail=1
  )

  if ((&wild_head==1)&&(&wild_tail==1))
  (
    if (STRING.SCAN("gcc_sdcc1_ice_core_clk", STRING.MID("&clk", 1, &clk_input_length-2), 0)!=-1)
    ( 
      &match=1
    )
  )
  else if (&wild_head==1)
  (
    if (STRING.MID("gcc_sdcc1_ice_core_clk", &clk_itr_length-&clk_input_length+1, &clk_input_length-1)==STRING.CUT("&clk", 1))
    ( 
      &match=1
    )
  )
  else if (&wild_tail==1)
  (
    if (STRING.MID("gcc_sdcc1_ice_core_clk", 0, &clk_input_length-1)==STRING.CUT("&clk", -1))
    ( 
      &match=1
    )
  )
  else if ("gcc_sdcc1_ice_core_clk"=="&clk")
  (
    &match=1
  )
  
  if (&match==1)
  (
    &clk_test=&CLK_TEST_GCC_SDCC1_ICE_CORE_CLK
    &clk_reg=&HWIO_GCC_SDCC1_ICE_CORE_CBCR_ADDR
    &clk_reg_name="GCC_SDCC1_ICE_CORE_CBCR"
    &clk_name="gcc_sdcc1_ice_core_clk"
    &clk_reg_cbcr_type="sm_pscbc"
    &clk_vote_bit=-1.
    &clk_multiplier=4.
    &clk_access_mode="&GCC_access_mode"

    gosub Print_Clk_Info_Line
  )

  &match=0
  &wild_head=0
  &wild_tail=0
  &clk_input_length=STRING.LENGTH("&clk")
  &clk_itr_length=STRING.LENGTH("gcc_sdcc2_apps_clk")

  if (STRING.SCAN("&clk", "*", 0)==0)
  (
    &wild_head=1
  )
  if (STRING.SCAN("&clk", "*", 1)==(STRING.LENGTH("&clk")-1))
  (
    &wild_tail=1
  )

  if ((&wild_head==1)&&(&wild_tail==1))
  (
    if (STRING.SCAN("gcc_sdcc2_apps_clk", STRING.MID("&clk", 1, &clk_input_length-2), 0)!=-1)
    ( 
      &match=1
    )
  )
  else if (&wild_head==1)
  (
    if (STRING.MID("gcc_sdcc2_apps_clk", &clk_itr_length-&clk_input_length+1, &clk_input_length-1)==STRING.CUT("&clk", 1))
    ( 
      &match=1
    )
  )
  else if (&wild_tail==1)
  (
    if (STRING.MID("gcc_sdcc2_apps_clk", 0, &clk_input_length-1)==STRING.CUT("&clk", -1))
    ( 
      &match=1
    )
  )
  else if ("gcc_sdcc2_apps_clk"=="&clk")
  (
    &match=1
  )
  
  if (&match==1)
  (
    &clk_test=&CLK_TEST_GCC_SDCC2_APPS_CLK
    &clk_reg=&HWIO_GCC_SDCC2_APPS_CBCR_ADDR
    &clk_reg_name="GCC_SDCC2_APPS_CBCR"
    &clk_name="gcc_sdcc2_apps_clk"
    &clk_reg_cbcr_type="sm_pscbc"
    &clk_vote_bit=-1.
    &clk_multiplier=4.
    &clk_access_mode="&GCC_access_mode"

    gosub Print_Clk_Info_Line
  )

  &match=0
  &wild_head=0
  &wild_tail=0
  &clk_input_length=STRING.LENGTH("&clk")
  &clk_itr_length=STRING.LENGTH("gcc_sec_ctrl_clk")

  if (STRING.SCAN("&clk", "*", 0)==0)
  (
    &wild_head=1
  )
  if (STRING.SCAN("&clk", "*", 1)==(STRING.LENGTH("&clk")-1))
  (
    &wild_tail=1
  )

  if ((&wild_head==1)&&(&wild_tail==1))
  (
    if (STRING.SCAN("gcc_sec_ctrl_clk", STRING.MID("&clk", 1, &clk_input_length-2), 0)!=-1)
    ( 
      &match=1
    )
  )
  else if (&wild_head==1)
  (
    if (STRING.MID("gcc_sec_ctrl_clk", &clk_itr_length-&clk_input_length+1, &clk_input_length-1)==STRING.CUT("&clk", 1))
    ( 
      &match=1
    )
  )
  else if (&wild_tail==1)
  (
    if (STRING.MID("gcc_sec_ctrl_clk", 0, &clk_input_length-1)==STRING.CUT("&clk", -1))
    ( 
      &match=1
    )
  )
  else if ("gcc_sec_ctrl_clk"=="&clk")
  (
    &match=1
  )
  
  if (&match==1)
  (
    &clk_test=&CLK_TEST_GCC_SEC_CTRL_CLK
    &clk_reg=&HWIO_GCC_SEC_CTRL_CBCR_ADDR
    &clk_reg_name="GCC_SEC_CTRL_CBCR"
    &clk_name="gcc_sec_ctrl_clk"
    &clk_reg_cbcr_type="sm_pscbc"
    &clk_vote_bit=-1.
    &clk_multiplier=4.
    &clk_access_mode="&GCC_access_mode"

    gosub Print_Clk_Info_Line
  )

  &match=0
  &wild_head=0
  &wild_tail=0
  &clk_input_length=STRING.LENGTH("&clk")
  &clk_itr_length=STRING.LENGTH("gcc_sec_ctrl_sense_clk")

  if (STRING.SCAN("&clk", "*", 0)==0)
  (
    &wild_head=1
  )
  if (STRING.SCAN("&clk", "*", 1)==(STRING.LENGTH("&clk")-1))
  (
    &wild_tail=1
  )

  if ((&wild_head==1)&&(&wild_tail==1))
  (
    if (STRING.SCAN("gcc_sec_ctrl_sense_clk", STRING.MID("&clk", 1, &clk_input_length-2), 0)!=-1)
    ( 
      &match=1
    )
  )
  else if (&wild_head==1)
  (
    if (STRING.MID("gcc_sec_ctrl_sense_clk", &clk_itr_length-&clk_input_length+1, &clk_input_length-1)==STRING.CUT("&clk", 1))
    ( 
      &match=1
    )
  )
  else if (&wild_tail==1)
  (
    if (STRING.MID("gcc_sec_ctrl_sense_clk", 0, &clk_input_length-1)==STRING.CUT("&clk", -1))
    ( 
      &match=1
    )
  )
  else if ("gcc_sec_ctrl_sense_clk"=="&clk")
  (
    &match=1
  )
  
  if (&match==1)
  (
    &clk_test=&CLK_TEST_GCC_SEC_CTRL_SENSE_CLK
    &clk_reg=&HWIO_GCC_SEC_CTRL_SENSE_CBCR_ADDR
    &clk_reg_name="GCC_SEC_CTRL_SENSE_CBCR"
    &clk_name="gcc_sec_ctrl_sense_clk"
    &clk_reg_cbcr_type="sm_cbc"
    &clk_vote_bit=-1.
    &clk_multiplier=4.
    &clk_access_mode="&GCC_access_mode"

    gosub Print_Clk_Info_Line
  )

  &match=0
  &wild_head=0
  &wild_tail=0
  &clk_input_length=STRING.LENGTH("&clk")
  &clk_itr_length=STRING.LENGTH("gcc_smmu_cats_clk")

  if (STRING.SCAN("&clk", "*", 0)==0)
  (
    &wild_head=1
  )
  if (STRING.SCAN("&clk", "*", 1)==(STRING.LENGTH("&clk")-1))
  (
    &wild_tail=1
  )

  if ((&wild_head==1)&&(&wild_tail==1))
  (
    if (STRING.SCAN("gcc_smmu_cats_clk", STRING.MID("&clk", 1, &clk_input_length-2), 0)!=-1)
    ( 
      &match=1
    )
  )
  else if (&wild_head==1)
  (
    if (STRING.MID("gcc_smmu_cats_clk", &clk_itr_length-&clk_input_length+1, &clk_input_length-1)==STRING.CUT("&clk", 1))
    ( 
      &match=1
    )
  )
  else if (&wild_tail==1)
  (
    if (STRING.MID("gcc_smmu_cats_clk", 0, &clk_input_length-1)==STRING.CUT("&clk", -1))
    ( 
      &match=1
    )
  )
  else if ("gcc_smmu_cats_clk"=="&clk")
  (
    &match=1
  )
  
  if (&match==1)
  (
    &clk_test=&CLK_TEST_GCC_SMMU_CATS_CLK
    &clk_reg=&HWIO_GCC_SMMU_CATS_CBCR_ADDR
    &clk_reg_name="GCC_SMMU_CATS_CBCR"
    &clk_name="gcc_smmu_cats_clk"
    &clk_reg_cbcr_type="sm_cbc"
    &clk_vote_bit=-1.
    &clk_multiplier=4.
    &clk_access_mode="&GCC_access_mode"

    gosub Print_Clk_Info_Line
  )

  &match=0
  &wild_head=0
  &wild_tail=0
  &clk_input_length=STRING.LENGTH("&clk")
  &clk_itr_length=STRING.LENGTH("gcc_spdm_ff_clk")

  if (STRING.SCAN("&clk", "*", 0)==0)
  (
    &wild_head=1
  )
  if (STRING.SCAN("&clk", "*", 1)==(STRING.LENGTH("&clk")-1))
  (
    &wild_tail=1
  )

  if ((&wild_head==1)&&(&wild_tail==1))
  (
    if (STRING.SCAN("gcc_spdm_ff_clk", STRING.MID("&clk", 1, &clk_input_length-2), 0)!=-1)
    ( 
      &match=1
    )
  )
  else if (&wild_head==1)
  (
    if (STRING.MID("gcc_spdm_ff_clk", &clk_itr_length-&clk_input_length+1, &clk_input_length-1)==STRING.CUT("&clk", 1))
    ( 
      &match=1
    )
  )
  else if (&wild_tail==1)
  (
    if (STRING.MID("gcc_spdm_ff_clk", 0, &clk_input_length-1)==STRING.CUT("&clk", -1))
    ( 
      &match=1
    )
  )
  else if ("gcc_spdm_ff_clk"=="&clk")
  (
    &match=1
  )
  
  if (&match==1)
  (
    &clk_test=&CLK_TEST_GCC_SPDM_FF_CLK
    &clk_reg=&HWIO_GCC_SPDM_FF_CBCR_ADDR
    &clk_reg_name="GCC_SPDM_FF_CBCR"
    &clk_name="gcc_spdm_ff_clk"
    &clk_reg_cbcr_type="sm_cbc"
    &clk_vote_bit=-1.
    &clk_multiplier=4.
    &clk_access_mode="&GCC_access_mode"

    gosub Print_Clk_Info_Line
  )

  &match=0
  &wild_head=0
  &wild_tail=0
  &clk_input_length=STRING.LENGTH("&clk")
  &clk_itr_length=STRING.LENGTH("gcc_spdm_gfx3d_clk")

  if (STRING.SCAN("&clk", "*", 0)==0)
  (
    &wild_head=1
  )
  if (STRING.SCAN("&clk", "*", 1)==(STRING.LENGTH("&clk")-1))
  (
    &wild_tail=1
  )

  if ((&wild_head==1)&&(&wild_tail==1))
  (
    if (STRING.SCAN("gcc_spdm_gfx3d_clk", STRING.MID("&clk", 1, &clk_input_length-2), 0)!=-1)
    ( 
      &match=1
    )
  )
  else if (&wild_head==1)
  (
    if (STRING.MID("gcc_spdm_gfx3d_clk", &clk_itr_length-&clk_input_length+1, &clk_input_length-1)==STRING.CUT("&clk", 1))
    ( 
      &match=1
    )
  )
  else if (&wild_tail==1)
  (
    if (STRING.MID("gcc_spdm_gfx3d_clk", 0, &clk_input_length-1)==STRING.CUT("&clk", -1))
    ( 
      &match=1
    )
  )
  else if ("gcc_spdm_gfx3d_clk"=="&clk")
  (
    &match=1
  )
  
  if (&match==1)
  (
    &clk_test=&CLK_TEST_GCC_SPDM_GFX3D_CLK
    &clk_reg=&HWIO_GCC_SPDM_GFX3D_CBCR_ADDR
    &clk_reg_name="GCC_SPDM_GFX3D_CBCR"
    &clk_name="gcc_spdm_gfx3d_clk"
    &clk_reg_cbcr_type="sm_cbc"
    &clk_vote_bit=-1.
    &clk_multiplier=4.
    &clk_access_mode="&GCC_access_mode"

    gosub Print_Clk_Info_Line
  )

  &match=0
  &wild_head=0
  &wild_tail=0
  &clk_input_length=STRING.LENGTH("&clk")
  &clk_itr_length=STRING.LENGTH("gcc_spdm_mdp_clk")

  if (STRING.SCAN("&clk", "*", 0)==0)
  (
    &wild_head=1
  )
  if (STRING.SCAN("&clk", "*", 1)==(STRING.LENGTH("&clk")-1))
  (
    &wild_tail=1
  )

  if ((&wild_head==1)&&(&wild_tail==1))
  (
    if (STRING.SCAN("gcc_spdm_mdp_clk", STRING.MID("&clk", 1, &clk_input_length-2), 0)!=-1)
    ( 
      &match=1
    )
  )
  else if (&wild_head==1)
  (
    if (STRING.MID("gcc_spdm_mdp_clk", &clk_itr_length-&clk_input_length+1, &clk_input_length-1)==STRING.CUT("&clk", 1))
    ( 
      &match=1
    )
  )
  else if (&wild_tail==1)
  (
    if (STRING.MID("gcc_spdm_mdp_clk", 0, &clk_input_length-1)==STRING.CUT("&clk", -1))
    ( 
      &match=1
    )
  )
  else if ("gcc_spdm_mdp_clk"=="&clk")
  (
    &match=1
  )
  
  if (&match==1)
  (
    &clk_test=&CLK_TEST_GCC_SPDM_MDP_CLK
    &clk_reg=&HWIO_GCC_SPDM_MDP_CBCR_ADDR
    &clk_reg_name="GCC_SPDM_MDP_CBCR"
    &clk_name="gcc_spdm_mdp_clk"
    &clk_reg_cbcr_type="sm_cbc"
    &clk_vote_bit=-1.
    &clk_multiplier=4.
    &clk_access_mode="&GCC_access_mode"

    gosub Print_Clk_Info_Line
  )

  &match=0
  &wild_head=0
  &wild_tail=0
  &clk_input_length=STRING.LENGTH("&clk")
  &clk_itr_length=STRING.LENGTH("gcc_spdm_pclk0_clk")

  if (STRING.SCAN("&clk", "*", 0)==0)
  (
    &wild_head=1
  )
  if (STRING.SCAN("&clk", "*", 1)==(STRING.LENGTH("&clk")-1))
  (
    &wild_tail=1
  )

  if ((&wild_head==1)&&(&wild_tail==1))
  (
    if (STRING.SCAN("gcc_spdm_pclk0_clk", STRING.MID("&clk", 1, &clk_input_length-2), 0)!=-1)
    ( 
      &match=1
    )
  )
  else if (&wild_head==1)
  (
    if (STRING.MID("gcc_spdm_pclk0_clk", &clk_itr_length-&clk_input_length+1, &clk_input_length-1)==STRING.CUT("&clk", 1))
    ( 
      &match=1
    )
  )
  else if (&wild_tail==1)
  (
    if (STRING.MID("gcc_spdm_pclk0_clk", 0, &clk_input_length-1)==STRING.CUT("&clk", -1))
    ( 
      &match=1
    )
  )
  else if ("gcc_spdm_pclk0_clk"=="&clk")
  (
    &match=1
  )
  
  if (&match==1)
  (
    &clk_test=&CLK_TEST_GCC_SPDM_PCLK0_CLK
    &clk_reg=&HWIO_GCC_SPDM_PCLK0_CBCR_ADDR
    &clk_reg_name="GCC_SPDM_PCLK0_CBCR"
    &clk_name="gcc_spdm_pclk0_clk"
    &clk_reg_cbcr_type="sm_cbc"
    &clk_vote_bit=-1.
    &clk_multiplier=4.
    &clk_access_mode="&GCC_access_mode"

    gosub Print_Clk_Info_Line
  )

  &match=0
  &wild_head=0
  &wild_tail=0
  &clk_input_length=STRING.LENGTH("&clk")
  &clk_itr_length=STRING.LENGTH("gcc_spdm_rpm_cy_clk")

  if (STRING.SCAN("&clk", "*", 0)==0)
  (
    &wild_head=1
  )
  if (STRING.SCAN("&clk", "*", 1)==(STRING.LENGTH("&clk")-1))
  (
    &wild_tail=1
  )

  if ((&wild_head==1)&&(&wild_tail==1))
  (
    if (STRING.SCAN("gcc_spdm_rpm_cy_clk", STRING.MID("&clk", 1, &clk_input_length-2), 0)!=-1)
    ( 
      &match=1
    )
  )
  else if (&wild_head==1)
  (
    if (STRING.MID("gcc_spdm_rpm_cy_clk", &clk_itr_length-&clk_input_length+1, &clk_input_length-1)==STRING.CUT("&clk", 1))
    ( 
      &match=1
    )
  )
  else if (&wild_tail==1)
  (
    if (STRING.MID("gcc_spdm_rpm_cy_clk", 0, &clk_input_length-1)==STRING.CUT("&clk", -1))
    ( 
      &match=1
    )
  )
  else if ("gcc_spdm_rpm_cy_clk"=="&clk")
  (
    &match=1
  )
  
  if (&match==1)
  (
    &clk_test=&CLK_TEST_GCC_SPDM_RPM_CY_CLK
    &clk_reg=&HWIO_GCC_SPDM_RPM_CY_CBCR_ADDR
    &clk_reg_name="GCC_SPDM_RPM_CY_CBCR"
    &clk_name="gcc_spdm_rpm_cy_clk"
    &clk_reg_cbcr_type="sm_cbc"
    &clk_vote_bit=-1.
    &clk_multiplier=4.
    &clk_access_mode="&GCC_access_mode"

    gosub Print_Clk_Info_Line
  )

  &match=0
  &wild_head=0
  &wild_tail=0
  &clk_input_length=STRING.LENGTH("&clk")
  &clk_itr_length=STRING.LENGTH("gcc_spmi_ahb_clk")

  if (STRING.SCAN("&clk", "*", 0)==0)
  (
    &wild_head=1
  )
  if (STRING.SCAN("&clk", "*", 1)==(STRING.LENGTH("&clk")-1))
  (
    &wild_tail=1
  )

  if ((&wild_head==1)&&(&wild_tail==1))
  (
    if (STRING.SCAN("gcc_spmi_ahb_clk", STRING.MID("&clk", 1, &clk_input_length-2), 0)!=-1)
    ( 
      &match=1
    )
  )
  else if (&wild_head==1)
  (
    if (STRING.MID("gcc_spmi_ahb_clk", &clk_itr_length-&clk_input_length+1, &clk_input_length-1)==STRING.CUT("&clk", 1))
    ( 
      &match=1
    )
  )
  else if (&wild_tail==1)
  (
    if (STRING.MID("gcc_spmi_ahb_clk", 0, &clk_input_length-1)==STRING.CUT("&clk", -1))
    ( 
      &match=1
    )
  )
  else if ("gcc_spmi_ahb_clk"=="&clk")
  (
    &match=1
  )
  
  if (&match==1)
  (
    &clk_test=&CLK_TEST_GCC_SPMI_AHB_CLK
    &clk_reg=&HWIO_GCC_SPMI_AHB_CBCR_ADDR
    &clk_reg_name="GCC_SPMI_AHB_CBCR"
    &clk_name="gcc_spmi_ahb_clk"
    &clk_reg_cbcr_type="sm_pscbc"
    &clk_vote_bit=-1.
    &clk_multiplier=4.
    &clk_access_mode="&GCC_access_mode"

    gosub Print_Clk_Info_Line
  )

  &match=0
  &wild_head=0
  &wild_tail=0
  &clk_input_length=STRING.LENGTH("&clk")
  &clk_itr_length=STRING.LENGTH("gcc_spmi_ser_clk")

  if (STRING.SCAN("&clk", "*", 0)==0)
  (
    &wild_head=1
  )
  if (STRING.SCAN("&clk", "*", 1)==(STRING.LENGTH("&clk")-1))
  (
    &wild_tail=1
  )

  if ((&wild_head==1)&&(&wild_tail==1))
  (
    if (STRING.SCAN("gcc_spmi_ser_clk", STRING.MID("&clk", 1, &clk_input_length-2), 0)!=-1)
    ( 
      &match=1
    )
  )
  else if (&wild_head==1)
  (
    if (STRING.MID("gcc_spmi_ser_clk", &clk_itr_length-&clk_input_length+1, &clk_input_length-1)==STRING.CUT("&clk", 1))
    ( 
      &match=1
    )
  )
  else if (&wild_tail==1)
  (
    if (STRING.MID("gcc_spmi_ser_clk", 0, &clk_input_length-1)==STRING.CUT("&clk", -1))
    ( 
      &match=1
    )
  )
  else if ("gcc_spmi_ser_clk"=="&clk")
  (
    &match=1
  )
  
  if (&match==1)
  (
    &clk_test=&CLK_TEST_GCC_SPMI_SER_CLK
    &clk_reg=&HWIO_GCC_SPMI_SER_CBCR_ADDR
    &clk_reg_name="GCC_SPMI_SER_CBCR"
    &clk_name="gcc_spmi_ser_clk"
    &clk_reg_cbcr_type="sm_pscbc"
    &clk_vote_bit=-1.
    &clk_multiplier=4.
    &clk_access_mode="&GCC_access_mode"

    gosub Print_Clk_Info_Line
  )

  &match=0
  &wild_head=0
  &wild_tail=0
  &clk_input_length=STRING.LENGTH("&clk")
  &clk_itr_length=STRING.LENGTH("gcc_bimc_sysnoc_axi_clk")

  if (STRING.SCAN("&clk", "*", 0)==0)
  (
    &wild_head=1
  )
  if (STRING.SCAN("&clk", "*", 1)==(STRING.LENGTH("&clk")-1))
  (
    &wild_tail=1
  )

  if ((&wild_head==1)&&(&wild_tail==1))
  (
    if (STRING.SCAN("gcc_bimc_sysnoc_axi_clk", STRING.MID("&clk", 1, &clk_input_length-2), 0)!=-1)
    ( 
      &match=1
    )
  )
  else if (&wild_head==1)
  (
    if (STRING.MID("gcc_bimc_sysnoc_axi_clk", &clk_itr_length-&clk_input_length+1, &clk_input_length-1)==STRING.CUT("&clk", 1))
    ( 
      &match=1
    )
  )
  else if (&wild_tail==1)
  (
    if (STRING.MID("gcc_bimc_sysnoc_axi_clk", 0, &clk_input_length-1)==STRING.CUT("&clk", -1))
    ( 
      &match=1
    )
  )
  else if ("gcc_bimc_sysnoc_axi_clk"=="&clk")
  (
    &match=1
  )
  
  if (&match==1)
  (
    &clk_test=&CLK_TEST_GCC_BIMC_SYSNOC_AXI_CLK
    &clk_reg=&HWIO_GCC_BIMC_SYSNOC_AXI_CBCR_ADDR
    &clk_reg_name="GCC_BIMC_SYSNOC_AXI_CBCR"
    &clk_name="gcc_bimc_sysnoc_axi_clk"
    &clk_reg_cbcr_type="sm_cbc"
    &clk_vote_bit=-1.
    &clk_multiplier=4.
    &clk_access_mode="&GCC_access_mode"

    gosub Print_Clk_Info_Line
  )

  &match=0
  &wild_head=0
  &wild_tail=0
  &clk_input_length=STRING.LENGTH("&clk")
  &clk_itr_length=STRING.LENGTH("gcc_emac_tbu_axi_clk")

  if (STRING.SCAN("&clk", "*", 0)==0)
  (
    &wild_head=1
  )
  if (STRING.SCAN("&clk", "*", 1)==(STRING.LENGTH("&clk")-1))
  (
    &wild_tail=1
  )

  if ((&wild_head==1)&&(&wild_tail==1))
  (
    if (STRING.SCAN("gcc_emac_tbu_axi_clk", STRING.MID("&clk", 1, &clk_input_length-2), 0)!=-1)
    ( 
      &match=1
    )
  )
  else if (&wild_head==1)
  (
    if (STRING.MID("gcc_emac_tbu_axi_clk", &clk_itr_length-&clk_input_length+1, &clk_input_length-1)==STRING.CUT("&clk", 1))
    ( 
      &match=1
    )
  )
  else if (&wild_tail==1)
  (
    if (STRING.MID("gcc_emac_tbu_axi_clk", 0, &clk_input_length-1)==STRING.CUT("&clk", -1))
    ( 
      &match=1
    )
  )
  else if ("gcc_emac_tbu_axi_clk"=="&clk")
  (
    &match=1
  )
  
  if (&match==1)
  (
    &clk_test=&CLK_TEST_GCC_EMAC_TBU_AXI_CLK
    &clk_reg=&HWIO_GCC_EMAC_TBU_AXI_CBCR_ADDR
    &clk_reg_name="GCC_EMAC_TBU_AXI_CBCR"
    &clk_name="gcc_emac_tbu_axi_clk"
    &clk_reg_cbcr_type="sm_cbc"
    &clk_vote_bit=6.
    &clk_multiplier=4.
    &clk_access_mode="&GCC_access_mode"

    gosub Print_Clk_Info_Line
  )

  &match=0
  &wild_head=0
  &wild_tail=0
  &clk_input_length=STRING.LENGTH("&clk")
  &clk_itr_length=STRING.LENGTH("gcc_eth_axi_clk")

  if (STRING.SCAN("&clk", "*", 0)==0)
  (
    &wild_head=1
  )
  if (STRING.SCAN("&clk", "*", 1)==(STRING.LENGTH("&clk")-1))
  (
    &wild_tail=1
  )

  if ((&wild_head==1)&&(&wild_tail==1))
  (
    if (STRING.SCAN("gcc_eth_axi_clk", STRING.MID("&clk", 1, &clk_input_length-2), 0)!=-1)
    ( 
      &match=1
    )
  )
  else if (&wild_head==1)
  (
    if (STRING.MID("gcc_eth_axi_clk", &clk_itr_length-&clk_input_length+1, &clk_input_length-1)==STRING.CUT("&clk", 1))
    ( 
      &match=1
    )
  )
  else if (&wild_tail==1)
  (
    if (STRING.MID("gcc_eth_axi_clk", 0, &clk_input_length-1)==STRING.CUT("&clk", -1))
    ( 
      &match=1
    )
  )
  else if ("gcc_eth_axi_clk"=="&clk")
  (
    &match=1
  )
  
  if (&match==1)
  (
    &clk_test=&CLK_TEST_GCC_ETH_AXI_CLK
    &clk_reg=&HWIO_GCC_ETH_AXI_CBCR_ADDR
    &clk_reg_name="GCC_ETH_AXI_CBCR"
    &clk_name="gcc_eth_axi_clk"
    &clk_reg_cbcr_type="sm_pscbc"
    &clk_vote_bit=-1.
    &clk_multiplier=4.
    &clk_access_mode="&GCC_access_mode"

    gosub Print_Clk_Info_Line
  )

  &match=0
  &wild_head=0
  &wild_tail=0
  &clk_input_length=STRING.LENGTH("&clk")
  &clk_itr_length=STRING.LENGTH("gcc_imem_axi_clk")

  if (STRING.SCAN("&clk", "*", 0)==0)
  (
    &wild_head=1
  )
  if (STRING.SCAN("&clk", "*", 1)==(STRING.LENGTH("&clk")-1))
  (
    &wild_tail=1
  )

  if ((&wild_head==1)&&(&wild_tail==1))
  (
    if (STRING.SCAN("gcc_imem_axi_clk", STRING.MID("&clk", 1, &clk_input_length-2), 0)!=-1)
    ( 
      &match=1
    )
  )
  else if (&wild_head==1)
  (
    if (STRING.MID("gcc_imem_axi_clk", &clk_itr_length-&clk_input_length+1, &clk_input_length-1)==STRING.CUT("&clk", 1))
    ( 
      &match=1
    )
  )
  else if (&wild_tail==1)
  (
    if (STRING.MID("gcc_imem_axi_clk", 0, &clk_input_length-1)==STRING.CUT("&clk", -1))
    ( 
      &match=1
    )
  )
  else if ("gcc_imem_axi_clk"=="&clk")
  (
    &match=1
  )
  
  if (&match==1)
  (
    &clk_test=&CLK_TEST_GCC_IMEM_AXI_CLK
    &clk_reg=&HWIO_GCC_IMEM_AXI_CBCR_ADDR
    &clk_reg_name="GCC_IMEM_AXI_CBCR"
    &clk_name="gcc_imem_axi_clk"
    &clk_reg_cbcr_type="sm_pscbc"
    &clk_vote_bit=17.
    &clk_multiplier=4.
    &clk_access_mode="&GCC_access_mode"

    gosub Print_Clk_Info_Line
  )

  &match=0
  &wild_head=0
  &wild_tail=0
  &clk_input_length=STRING.LENGTH("&clk")
  &clk_itr_length=STRING.LENGTH("gcc_lpass_q6_axis_clk")

  if (STRING.SCAN("&clk", "*", 0)==0)
  (
    &wild_head=1
  )
  if (STRING.SCAN("&clk", "*", 1)==(STRING.LENGTH("&clk")-1))
  (
    &wild_tail=1
  )

  if ((&wild_head==1)&&(&wild_tail==1))
  (
    if (STRING.SCAN("gcc_lpass_q6_axis_clk", STRING.MID("&clk", 1, &clk_input_length-2), 0)!=-1)
    ( 
      &match=1
    )
  )
  else if (&wild_head==1)
  (
    if (STRING.MID("gcc_lpass_q6_axis_clk", &clk_itr_length-&clk_input_length+1, &clk_input_length-1)==STRING.CUT("&clk", 1))
    ( 
      &match=1
    )
  )
  else if (&wild_tail==1)
  (
    if (STRING.MID("gcc_lpass_q6_axis_clk", 0, &clk_input_length-1)==STRING.CUT("&clk", -1))
    ( 
      &match=1
    )
  )
  else if ("gcc_lpass_q6_axis_clk"=="&clk")
  (
    &match=1
  )
  
  if (&match==1)
  (
    &clk_test=&CLK_TEST_GCC_LPASS_Q6_AXIS_CLK
    &clk_reg=&HWIO_GCC_LPASS_Q6_AXIS_CBCR_ADDR
    &clk_reg_name="GCC_LPASS_Q6_AXIS_CBCR"
    &clk_name="gcc_lpass_q6_axis_clk"
    &clk_reg_cbcr_type="sm_cbc"
    &clk_vote_bit=-1.
    &clk_multiplier=4.
    &clk_access_mode="&GCC_access_mode"

    gosub Print_Clk_Info_Line
  )

  &match=0
  &wild_head=0
  &wild_tail=0
  &clk_input_length=STRING.LENGTH("&clk")
  &clk_itr_length=STRING.LENGTH("gcc_lpass_sway_clk")

  if (STRING.SCAN("&clk", "*", 0)==0)
  (
    &wild_head=1
  )
  if (STRING.SCAN("&clk", "*", 1)==(STRING.LENGTH("&clk")-1))
  (
    &wild_tail=1
  )

  if ((&wild_head==1)&&(&wild_tail==1))
  (
    if (STRING.SCAN("gcc_lpass_sway_clk", STRING.MID("&clk", 1, &clk_input_length-2), 0)!=-1)
    ( 
      &match=1
    )
  )
  else if (&wild_head==1)
  (
    if (STRING.MID("gcc_lpass_sway_clk", &clk_itr_length-&clk_input_length+1, &clk_input_length-1)==STRING.CUT("&clk", 1))
    ( 
      &match=1
    )
  )
  else if (&wild_tail==1)
  (
    if (STRING.MID("gcc_lpass_sway_clk", 0, &clk_input_length-1)==STRING.CUT("&clk", -1))
    ( 
      &match=1
    )
  )
  else if ("gcc_lpass_sway_clk"=="&clk")
  (
    &match=1
  )
  
  if (&match==1)
  (
    &clk_test=&CLK_TEST_GCC_LPASS_SWAY_CLK
    &clk_reg=&HWIO_GCC_LPASS_SWAY_CBCR_ADDR
    &clk_reg_name="GCC_LPASS_SWAY_CBCR"
    &clk_name="gcc_lpass_sway_clk"
    &clk_reg_cbcr_type="sm_cbc"
    &clk_vote_bit=-1.
    &clk_multiplier=4.
    &clk_access_mode="&GCC_access_mode"

    gosub Print_Clk_Info_Line
  )

  &match=0
  &wild_head=0
  &wild_tail=0
  &clk_input_length=STRING.LENGTH("&clk")
  &clk_itr_length=STRING.LENGTH("gcc_pcie_0_mstr_axi_clk")

  if (STRING.SCAN("&clk", "*", 0)==0)
  (
    &wild_head=1
  )
  if (STRING.SCAN("&clk", "*", 1)==(STRING.LENGTH("&clk")-1))
  (
    &wild_tail=1
  )

  if ((&wild_head==1)&&(&wild_tail==1))
  (
    if (STRING.SCAN("gcc_pcie_0_mstr_axi_clk", STRING.MID("&clk", 1, &clk_input_length-2), 0)!=-1)
    ( 
      &match=1
    )
  )
  else if (&wild_head==1)
  (
    if (STRING.MID("gcc_pcie_0_mstr_axi_clk", &clk_itr_length-&clk_input_length+1, &clk_input_length-1)==STRING.CUT("&clk", 1))
    ( 
      &match=1
    )
  )
  else if (&wild_tail==1)
  (
    if (STRING.MID("gcc_pcie_0_mstr_axi_clk", 0, &clk_input_length-1)==STRING.CUT("&clk", -1))
    ( 
      &match=1
    )
  )
  else if ("gcc_pcie_0_mstr_axi_clk"=="&clk")
  (
    &match=1
  )
  
  if (&match==1)
  (
    &clk_test=&CLK_TEST_GCC_PCIE_0_MSTR_AXI_CLK
    &clk_reg=&HWIO_GCC_PCIE_0_MSTR_AXI_CBCR_ADDR
    &clk_reg_name="GCC_PCIE_0_MSTR_AXI_CBCR"
    &clk_name="gcc_pcie_0_mstr_axi_clk"
    &clk_reg_cbcr_type="sm_pscbc"
    &clk_vote_bit=18.
    &clk_multiplier=4.
    &clk_access_mode="&GCC_access_mode"

    gosub Print_Clk_Info_Line
  )

  &match=0
  &wild_head=0
  &wild_tail=0
  &clk_input_length=STRING.LENGTH("&clk")
  &clk_itr_length=STRING.LENGTH("gcc_pcie_0_slv_axi_clk")

  if (STRING.SCAN("&clk", "*", 0)==0)
  (
    &wild_head=1
  )
  if (STRING.SCAN("&clk", "*", 1)==(STRING.LENGTH("&clk")-1))
  (
    &wild_tail=1
  )

  if ((&wild_head==1)&&(&wild_tail==1))
  (
    if (STRING.SCAN("gcc_pcie_0_slv_axi_clk", STRING.MID("&clk", 1, &clk_input_length-2), 0)!=-1)
    ( 
      &match=1
    )
  )
  else if (&wild_head==1)
  (
    if (STRING.MID("gcc_pcie_0_slv_axi_clk", &clk_itr_length-&clk_input_length+1, &clk_input_length-1)==STRING.CUT("&clk", 1))
    ( 
      &match=1
    )
  )
  else if (&wild_tail==1)
  (
    if (STRING.MID("gcc_pcie_0_slv_axi_clk", 0, &clk_input_length-1)==STRING.CUT("&clk", -1))
    ( 
      &match=1
    )
  )
  else if ("gcc_pcie_0_slv_axi_clk"=="&clk")
  (
    &match=1
  )
  
  if (&match==1)
  (
    &clk_test=&CLK_TEST_GCC_PCIE_0_SLV_AXI_CLK
    &clk_reg=&HWIO_GCC_PCIE_0_SLV_AXI_CBCR_ADDR
    &clk_reg_name="GCC_PCIE_0_SLV_AXI_CBCR"
    &clk_name="gcc_pcie_0_slv_axi_clk"
    &clk_reg_cbcr_type="sm_pscbc"
    &clk_vote_bit=22.
    &clk_multiplier=4.
    &clk_access_mode="&GCC_access_mode"

    gosub Print_Clk_Info_Line
  )

  &match=0
  &wild_head=0
  &wild_tail=0
  &clk_input_length=STRING.LENGTH("&clk")
  &clk_itr_length=STRING.LENGTH("gcc_pcie_tbu_clk")

  if (STRING.SCAN("&clk", "*", 0)==0)
  (
    &wild_head=1
  )
  if (STRING.SCAN("&clk", "*", 1)==(STRING.LENGTH("&clk")-1))
  (
    &wild_tail=1
  )

  if ((&wild_head==1)&&(&wild_tail==1))
  (
    if (STRING.SCAN("gcc_pcie_tbu_clk", STRING.MID("&clk", 1, &clk_input_length-2), 0)!=-1)
    ( 
      &match=1
    )
  )
  else if (&wild_head==1)
  (
    if (STRING.MID("gcc_pcie_tbu_clk", &clk_itr_length-&clk_input_length+1, &clk_input_length-1)==STRING.CUT("&clk", 1))
    ( 
      &match=1
    )
  )
  else if (&wild_tail==1)
  (
    if (STRING.MID("gcc_pcie_tbu_clk", 0, &clk_input_length-1)==STRING.CUT("&clk", -1))
    ( 
      &match=1
    )
  )
  else if ("gcc_pcie_tbu_clk"=="&clk")
  (
    &match=1
  )
  
  if (&match==1)
  (
    &clk_test=&CLK_TEST_GCC_PCIE_TBU_CLK
    &clk_reg=&HWIO_GCC_PCIE_TBU_CBCR_ADDR
    &clk_reg_name="GCC_PCIE_TBU_CBCR"
    &clk_name="gcc_pcie_tbu_clk"
    &clk_reg_cbcr_type="sm_cbc"
    &clk_vote_bit=5.
    &clk_multiplier=4.
    &clk_access_mode="&GCC_access_mode"

    gosub Print_Clk_Info_Line
  )

  &match=0
  &wild_head=0
  &wild_tail=0
  &clk_input_length=STRING.LENGTH("&clk")
  &clk_itr_length=STRING.LENGTH("gcc_qdss_etr_usb_clk")

  if (STRING.SCAN("&clk", "*", 0)==0)
  (
    &wild_head=1
  )
  if (STRING.SCAN("&clk", "*", 1)==(STRING.LENGTH("&clk")-1))
  (
    &wild_tail=1
  )

  if ((&wild_head==1)&&(&wild_tail==1))
  (
    if (STRING.SCAN("gcc_qdss_etr_usb_clk", STRING.MID("&clk", 1, &clk_input_length-2), 0)!=-1)
    ( 
      &match=1
    )
  )
  else if (&wild_head==1)
  (
    if (STRING.MID("gcc_qdss_etr_usb_clk", &clk_itr_length-&clk_input_length+1, &clk_input_length-1)==STRING.CUT("&clk", 1))
    ( 
      &match=1
    )
  )
  else if (&wild_tail==1)
  (
    if (STRING.MID("gcc_qdss_etr_usb_clk", 0, &clk_input_length-1)==STRING.CUT("&clk", -1))
    ( 
      &match=1
    )
  )
  else if ("gcc_qdss_etr_usb_clk"=="&clk")
  (
    &match=1
  )
  
  if (&match==1)
  (
    &clk_test=&CLK_TEST_GCC_QDSS_ETR_USB_CLK
    &clk_reg=&HWIO_GCC_QDSS_ETR_USB_CBCR_ADDR
    &clk_reg_name="GCC_QDSS_ETR_USB_CBCR"
    &clk_name="gcc_qdss_etr_usb_clk"
    &clk_reg_cbcr_type="sm_cbc"
    &clk_vote_bit=-1.
    &clk_multiplier=4.
    &clk_access_mode="&GCC_access_mode"

    gosub Print_Clk_Info_Line
  )

  &match=0
  &wild_head=0
  &wild_tail=0
  &clk_input_length=STRING.LENGTH("&clk")
  &clk_itr_length=STRING.LENGTH("gcc_snoc_bus_timeout1_ahb_clk")

  if (STRING.SCAN("&clk", "*", 0)==0)
  (
    &wild_head=1
  )
  if (STRING.SCAN("&clk", "*", 1)==(STRING.LENGTH("&clk")-1))
  (
    &wild_tail=1
  )

  if ((&wild_head==1)&&(&wild_tail==1))
  (
    if (STRING.SCAN("gcc_snoc_bus_timeout1_ahb_clk", STRING.MID("&clk", 1, &clk_input_length-2), 0)!=-1)
    ( 
      &match=1
    )
  )
  else if (&wild_head==1)
  (
    if (STRING.MID("gcc_snoc_bus_timeout1_ahb_clk", &clk_itr_length-&clk_input_length+1, &clk_input_length-1)==STRING.CUT("&clk", 1))
    ( 
      &match=1
    )
  )
  else if (&wild_tail==1)
  (
    if (STRING.MID("gcc_snoc_bus_timeout1_ahb_clk", 0, &clk_input_length-1)==STRING.CUT("&clk", -1))
    ( 
      &match=1
    )
  )
  else if ("gcc_snoc_bus_timeout1_ahb_clk"=="&clk")
  (
    &match=1
  )
  
  if (&match==1)
  (
    &clk_test=&CLK_TEST_GCC_SNOC_BUS_TIMEOUT1_AHB_CLK
    &clk_reg=&HWIO_GCC_SNOC_BUS_TIMEOUT1_AHB_CBCR_ADDR
    &clk_reg_name="GCC_SNOC_BUS_TIMEOUT1_AHB_CBCR"
    &clk_name="gcc_snoc_bus_timeout1_ahb_clk"
    &clk_reg_cbcr_type="sm_cbc"
    &clk_vote_bit=-1.
    &clk_multiplier=4.
    &clk_access_mode="&GCC_access_mode"

    gosub Print_Clk_Info_Line
  )

  &match=0
  &wild_head=0
  &wild_tail=0
  &clk_input_length=STRING.LENGTH("&clk")
  &clk_itr_length=STRING.LENGTH("gcc_snoc_bus_timeout2_ahb_clk")

  if (STRING.SCAN("&clk", "*", 0)==0)
  (
    &wild_head=1
  )
  if (STRING.SCAN("&clk", "*", 1)==(STRING.LENGTH("&clk")-1))
  (
    &wild_tail=1
  )

  if ((&wild_head==1)&&(&wild_tail==1))
  (
    if (STRING.SCAN("gcc_snoc_bus_timeout2_ahb_clk", STRING.MID("&clk", 1, &clk_input_length-2), 0)!=-1)
    ( 
      &match=1
    )
  )
  else if (&wild_head==1)
  (
    if (STRING.MID("gcc_snoc_bus_timeout2_ahb_clk", &clk_itr_length-&clk_input_length+1, &clk_input_length-1)==STRING.CUT("&clk", 1))
    ( 
      &match=1
    )
  )
  else if (&wild_tail==1)
  (
    if (STRING.MID("gcc_snoc_bus_timeout2_ahb_clk", 0, &clk_input_length-1)==STRING.CUT("&clk", -1))
    ( 
      &match=1
    )
  )
  else if ("gcc_snoc_bus_timeout2_ahb_clk"=="&clk")
  (
    &match=1
  )
  
  if (&match==1)
  (
    &clk_test=&CLK_TEST_GCC_SNOC_BUS_TIMEOUT2_AHB_CLK
    &clk_reg=&HWIO_GCC_SNOC_BUS_TIMEOUT2_AHB_CBCR_ADDR
    &clk_reg_name="GCC_SNOC_BUS_TIMEOUT2_AHB_CBCR"
    &clk_name="gcc_snoc_bus_timeout2_ahb_clk"
    &clk_reg_cbcr_type="sm_cbc"
    &clk_vote_bit=-1.
    &clk_multiplier=4.
    &clk_access_mode="&GCC_access_mode"

    gosub Print_Clk_Info_Line
  )

  &match=0
  &wild_head=0
  &wild_tail=0
  &clk_input_length=STRING.LENGTH("&clk")
  &clk_itr_length=STRING.LENGTH("gcc_spdm_snoc_cy_clk")

  if (STRING.SCAN("&clk", "*", 0)==0)
  (
    &wild_head=1
  )
  if (STRING.SCAN("&clk", "*", 1)==(STRING.LENGTH("&clk")-1))
  (
    &wild_tail=1
  )

  if ((&wild_head==1)&&(&wild_tail==1))
  (
    if (STRING.SCAN("gcc_spdm_snoc_cy_clk", STRING.MID("&clk", 1, &clk_input_length-2), 0)!=-1)
    ( 
      &match=1
    )
  )
  else if (&wild_head==1)
  (
    if (STRING.MID("gcc_spdm_snoc_cy_clk", &clk_itr_length-&clk_input_length+1, &clk_input_length-1)==STRING.CUT("&clk", 1))
    ( 
      &match=1
    )
  )
  else if (&wild_tail==1)
  (
    if (STRING.MID("gcc_spdm_snoc_cy_clk", 0, &clk_input_length-1)==STRING.CUT("&clk", -1))
    ( 
      &match=1
    )
  )
  else if ("gcc_spdm_snoc_cy_clk"=="&clk")
  (
    &match=1
  )
  
  if (&match==1)
  (
    &clk_test=&CLK_TEST_GCC_SPDM_SNOC_CY_CLK
    &clk_reg=&HWIO_GCC_SPDM_SNOC_CY_CBCR_ADDR
    &clk_reg_name="GCC_SPDM_SNOC_CY_CBCR"
    &clk_name="gcc_spdm_snoc_cy_clk"
    &clk_reg_cbcr_type="sm_cbc"
    &clk_vote_bit=-1.
    &clk_multiplier=4.
    &clk_access_mode="&GCC_access_mode"

    gosub Print_Clk_Info_Line
  )

  &match=0
  &wild_head=0
  &wild_tail=0
  &clk_input_length=STRING.LENGTH("&clk")
  &clk_itr_length=STRING.LENGTH("gcc_sys_noc_axi_clk")

  if (STRING.SCAN("&clk", "*", 0)==0)
  (
    &wild_head=1
  )
  if (STRING.SCAN("&clk", "*", 1)==(STRING.LENGTH("&clk")-1))
  (
    &wild_tail=1
  )

  if ((&wild_head==1)&&(&wild_tail==1))
  (
    if (STRING.SCAN("gcc_sys_noc_axi_clk", STRING.MID("&clk", 1, &clk_input_length-2), 0)!=-1)
    ( 
      &match=1
    )
  )
  else if (&wild_head==1)
  (
    if (STRING.MID("gcc_sys_noc_axi_clk", &clk_itr_length-&clk_input_length+1, &clk_input_length-1)==STRING.CUT("&clk", 1))
    ( 
      &match=1
    )
  )
  else if (&wild_tail==1)
  (
    if (STRING.MID("gcc_sys_noc_axi_clk", 0, &clk_input_length-1)==STRING.CUT("&clk", -1))
    ( 
      &match=1
    )
  )
  else if ("gcc_sys_noc_axi_clk"=="&clk")
  (
    &match=1
  )
  
  if (&match==1)
  (
    &clk_test=&CLK_TEST_GCC_SYS_NOC_AXI_CLK
    &clk_reg=&HWIO_GCC_SYS_NOC_AXI_CBCR_ADDR
    &clk_reg_name="GCC_SYS_NOC_AXI_CBCR"
    &clk_name="gcc_sys_noc_axi_clk"
    &clk_reg_cbcr_type="sm_cbc"
    &clk_vote_bit=-1.
    &clk_multiplier=4.
    &clk_access_mode="&GCC_access_mode"

    gosub Print_Clk_Info_Line
  )

  &match=0
  &wild_head=0
  &wild_tail=0
  &clk_input_length=STRING.LENGTH("&clk")
  &clk_itr_length=STRING.LENGTH("gcc_sys_noc_lpass_clk")

  if (STRING.SCAN("&clk", "*", 0)==0)
  (
    &wild_head=1
  )
  if (STRING.SCAN("&clk", "*", 1)==(STRING.LENGTH("&clk")-1))
  (
    &wild_tail=1
  )

  if ((&wild_head==1)&&(&wild_tail==1))
  (
    if (STRING.SCAN("gcc_sys_noc_lpass_clk", STRING.MID("&clk", 1, &clk_input_length-2), 0)!=-1)
    ( 
      &match=1
    )
  )
  else if (&wild_head==1)
  (
    if (STRING.MID("gcc_sys_noc_lpass_clk", &clk_itr_length-&clk_input_length+1, &clk_input_length-1)==STRING.CUT("&clk", 1))
    ( 
      &match=1
    )
  )
  else if (&wild_tail==1)
  (
    if (STRING.MID("gcc_sys_noc_lpass_clk", 0, &clk_input_length-1)==STRING.CUT("&clk", -1))
    ( 
      &match=1
    )
  )
  else if ("gcc_sys_noc_lpass_clk"=="&clk")
  (
    &match=1
  )
  
  if (&match==1)
  (
    &clk_test=&CLK_TEST_GCC_SYS_NOC_LPASS_CLK
    &clk_reg=&HWIO_GCC_SYS_NOC_LPASS_CBCR_ADDR
    &clk_reg_name="GCC_SYS_NOC_LPASS_CBCR"
    &clk_name="gcc_sys_noc_lpass_clk"
    &clk_reg_cbcr_type="sm_cbc"
    &clk_vote_bit=-1.
    &clk_multiplier=4.
    &clk_access_mode="&GCC_access_mode"

    gosub Print_Clk_Info_Line
  )

  &match=0
  &wild_head=0
  &wild_tail=0
  &clk_input_length=STRING.LENGTH("&clk")
  &clk_itr_length=STRING.LENGTH("gcc_sys_noc_tprb_clk")

  if (STRING.SCAN("&clk", "*", 0)==0)
  (
    &wild_head=1
  )
  if (STRING.SCAN("&clk", "*", 1)==(STRING.LENGTH("&clk")-1))
  (
    &wild_tail=1
  )

  if ((&wild_head==1)&&(&wild_tail==1))
  (
    if (STRING.SCAN("gcc_sys_noc_tprb_clk", STRING.MID("&clk", 1, &clk_input_length-2), 0)!=-1)
    ( 
      &match=1
    )
  )
  else if (&wild_head==1)
  (
    if (STRING.MID("gcc_sys_noc_tprb_clk", &clk_itr_length-&clk_input_length+1, &clk_input_length-1)==STRING.CUT("&clk", 1))
    ( 
      &match=1
    )
  )
  else if (&wild_tail==1)
  (
    if (STRING.MID("gcc_sys_noc_tprb_clk", 0, &clk_input_length-1)==STRING.CUT("&clk", -1))
    ( 
      &match=1
    )
  )
  else if ("gcc_sys_noc_tprb_clk"=="&clk")
  (
    &match=1
  )
  
  if (&match==1)
  (
    &clk_test=&CLK_TEST_GCC_SYS_NOC_TPRB_CLK
    &clk_reg=&HWIO_GCC_SYS_NOC_TPRB_CBCR_ADDR
    &clk_reg_name="GCC_SYS_NOC_TPRB_CBCR"
    &clk_name="gcc_sys_noc_tprb_clk"
    &clk_reg_cbcr_type="sm_cbc"
    &clk_vote_bit=-1.
    &clk_multiplier=4.
    &clk_access_mode="&GCC_access_mode"

    gosub Print_Clk_Info_Line
  )

  &match=0
  &wild_head=0
  &wild_tail=0
  &clk_input_length=STRING.LENGTH("&clk")
  &clk_itr_length=STRING.LENGTH("gcc_sys_noc_wcss_clk")

  if (STRING.SCAN("&clk", "*", 0)==0)
  (
    &wild_head=1
  )
  if (STRING.SCAN("&clk", "*", 1)==(STRING.LENGTH("&clk")-1))
  (
    &wild_tail=1
  )

  if ((&wild_head==1)&&(&wild_tail==1))
  (
    if (STRING.SCAN("gcc_sys_noc_wcss_clk", STRING.MID("&clk", 1, &clk_input_length-2), 0)!=-1)
    ( 
      &match=1
    )
  )
  else if (&wild_head==1)
  (
    if (STRING.MID("gcc_sys_noc_wcss_clk", &clk_itr_length-&clk_input_length+1, &clk_input_length-1)==STRING.CUT("&clk", 1))
    ( 
      &match=1
    )
  )
  else if (&wild_tail==1)
  (
    if (STRING.MID("gcc_sys_noc_wcss_clk", 0, &clk_input_length-1)==STRING.CUT("&clk", -1))
    ( 
      &match=1
    )
  )
  else if ("gcc_sys_noc_wcss_clk"=="&clk")
  (
    &match=1
  )
  
  if (&match==1)
  (
    &clk_test=&CLK_TEST_GCC_SYS_NOC_WCSS_CLK
    &clk_reg=&HWIO_GCC_SYS_NOC_WCSS_CBCR_ADDR
    &clk_reg_name="GCC_SYS_NOC_WCSS_CBCR"
    &clk_name="gcc_sys_noc_wcss_clk"
    &clk_reg_cbcr_type="sm_cbc"
    &clk_vote_bit=-1.
    &clk_multiplier=4.
    &clk_access_mode="&GCC_access_mode"

    gosub Print_Clk_Info_Line
  )

  &match=0
  &wild_head=0
  &wild_tail=0
  &clk_input_length=STRING.LENGTH("&clk")
  &clk_itr_length=STRING.LENGTH("gcc_wcss_ahb_s0_clk")

  if (STRING.SCAN("&clk", "*", 0)==0)
  (
    &wild_head=1
  )
  if (STRING.SCAN("&clk", "*", 1)==(STRING.LENGTH("&clk")-1))
  (
    &wild_tail=1
  )

  if ((&wild_head==1)&&(&wild_tail==1))
  (
    if (STRING.SCAN("gcc_wcss_ahb_s0_clk", STRING.MID("&clk", 1, &clk_input_length-2), 0)!=-1)
    ( 
      &match=1
    )
  )
  else if (&wild_head==1)
  (
    if (STRING.MID("gcc_wcss_ahb_s0_clk", &clk_itr_length-&clk_input_length+1, &clk_input_length-1)==STRING.CUT("&clk", 1))
    ( 
      &match=1
    )
  )
  else if (&wild_tail==1)
  (
    if (STRING.MID("gcc_wcss_ahb_s0_clk", 0, &clk_input_length-1)==STRING.CUT("&clk", -1))
    ( 
      &match=1
    )
  )
  else if ("gcc_wcss_ahb_s0_clk"=="&clk")
  (
    &match=1
  )
  
  if (&match==1)
  (
    &clk_test=&CLK_TEST_GCC_WCSS_AHB_S0_CLK
    &clk_reg=&HWIO_GCC_WCSS_AHB_S0_CBCR_ADDR
    &clk_reg_name="GCC_WCSS_AHB_S0_CBCR"
    &clk_name="gcc_wcss_ahb_s0_clk"
    &clk_reg_cbcr_type="sm_cbc"
    &clk_vote_bit=-1.
    &clk_multiplier=4.
    &clk_access_mode="&GCC_access_mode"

    gosub Print_Clk_Info_Line
  )

  &match=0
  &wild_head=0
  &wild_tail=0
  &clk_input_length=STRING.LENGTH("&clk")
  &clk_itr_length=STRING.LENGTH("gcc_wcss_axi_m_clk")

  if (STRING.SCAN("&clk", "*", 0)==0)
  (
    &wild_head=1
  )
  if (STRING.SCAN("&clk", "*", 1)==(STRING.LENGTH("&clk")-1))
  (
    &wild_tail=1
  )

  if ((&wild_head==1)&&(&wild_tail==1))
  (
    if (STRING.SCAN("gcc_wcss_axi_m_clk", STRING.MID("&clk", 1, &clk_input_length-2), 0)!=-1)
    ( 
      &match=1
    )
  )
  else if (&wild_head==1)
  (
    if (STRING.MID("gcc_wcss_axi_m_clk", &clk_itr_length-&clk_input_length+1, &clk_input_length-1)==STRING.CUT("&clk", 1))
    ( 
      &match=1
    )
  )
  else if (&wild_tail==1)
  (
    if (STRING.MID("gcc_wcss_axi_m_clk", 0, &clk_input_length-1)==STRING.CUT("&clk", -1))
    ( 
      &match=1
    )
  )
  else if ("gcc_wcss_axi_m_clk"=="&clk")
  (
    &match=1
  )
  
  if (&match==1)
  (
    &clk_test=&CLK_TEST_GCC_WCSS_AXI_M_CLK
    &clk_reg=&HWIO_GCC_WCSS_AXI_M_CBCR_ADDR
    &clk_reg_name="GCC_WCSS_AXI_M_CBCR"
    &clk_name="gcc_wcss_axi_m_clk"
    &clk_reg_cbcr_type="sm_cbc"
    &clk_vote_bit=-1.
    &clk_multiplier=4.
    &clk_access_mode="&GCC_access_mode"

    gosub Print_Clk_Info_Line
  )

  &match=0
  &wild_head=0
  &wild_tail=0
  &clk_input_length=STRING.LENGTH("&clk")
  &clk_itr_length=STRING.LENGTH("gcc_wcss_ecahb_clk")

  if (STRING.SCAN("&clk", "*", 0)==0)
  (
    &wild_head=1
  )
  if (STRING.SCAN("&clk", "*", 1)==(STRING.LENGTH("&clk")-1))
  (
    &wild_tail=1
  )

  if ((&wild_head==1)&&(&wild_tail==1))
  (
    if (STRING.SCAN("gcc_wcss_ecahb_clk", STRING.MID("&clk", 1, &clk_input_length-2), 0)!=-1)
    ( 
      &match=1
    )
  )
  else if (&wild_head==1)
  (
    if (STRING.MID("gcc_wcss_ecahb_clk", &clk_itr_length-&clk_input_length+1, &clk_input_length-1)==STRING.CUT("&clk", 1))
    ( 
      &match=1
    )
  )
  else if (&wild_tail==1)
  (
    if (STRING.MID("gcc_wcss_ecahb_clk", 0, &clk_input_length-1)==STRING.CUT("&clk", -1))
    ( 
      &match=1
    )
  )
  else if ("gcc_wcss_ecahb_clk"=="&clk")
  (
    &match=1
  )
  
  if (&match==1)
  (
    &clk_test=&CLK_TEST_GCC_WCSS_ECAHB_CLK
    &clk_reg=&HWIO_GCC_WCSS_ECAHB_CBCR_ADDR
    &clk_reg_name="GCC_WCSS_ECAHB_CBCR"
    &clk_name="gcc_wcss_ecahb_clk"
    &clk_reg_cbcr_type="sm_cbc"
    &clk_vote_bit=-1.
    &clk_multiplier=4.
    &clk_access_mode="&GCC_access_mode"

    gosub Print_Clk_Info_Line
  )

  &match=0
  &wild_head=0
  &wild_tail=0
  &clk_input_length=STRING.LENGTH("&clk")
  &clk_itr_length=STRING.LENGTH("gcc_wcss_shdreg_ahb_clk")

  if (STRING.SCAN("&clk", "*", 0)==0)
  (
    &wild_head=1
  )
  if (STRING.SCAN("&clk", "*", 1)==(STRING.LENGTH("&clk")-1))
  (
    &wild_tail=1
  )

  if ((&wild_head==1)&&(&wild_tail==1))
  (
    if (STRING.SCAN("gcc_wcss_shdreg_ahb_clk", STRING.MID("&clk", 1, &clk_input_length-2), 0)!=-1)
    ( 
      &match=1
    )
  )
  else if (&wild_head==1)
  (
    if (STRING.MID("gcc_wcss_shdreg_ahb_clk", &clk_itr_length-&clk_input_length+1, &clk_input_length-1)==STRING.CUT("&clk", 1))
    ( 
      &match=1
    )
  )
  else if (&wild_tail==1)
  (
    if (STRING.MID("gcc_wcss_shdreg_ahb_clk", 0, &clk_input_length-1)==STRING.CUT("&clk", -1))
    ( 
      &match=1
    )
  )
  else if ("gcc_wcss_shdreg_ahb_clk"=="&clk")
  (
    &match=1
  )
  
  if (&match==1)
  (
    &clk_test=&CLK_TEST_GCC_WCSS_SHDREG_AHB_CLK
    &clk_reg=&HWIO_GCC_WCSS_SHDREG_AHB_CBCR_ADDR
    &clk_reg_name="GCC_WCSS_SHDREG_AHB_CBCR"
    &clk_name="gcc_wcss_shdreg_ahb_clk"
    &clk_reg_cbcr_type="sm_cbc"
    &clk_vote_bit=-1.
    &clk_multiplier=4.
    &clk_access_mode="&GCC_access_mode"

    gosub Print_Clk_Info_Line
  )

  &match=0
  &wild_head=0
  &wild_tail=0
  &clk_input_length=STRING.LENGTH("&clk")
  &clk_itr_length=STRING.LENGTH("gcc_wcss_tbu_clk")

  if (STRING.SCAN("&clk", "*", 0)==0)
  (
    &wild_head=1
  )
  if (STRING.SCAN("&clk", "*", 1)==(STRING.LENGTH("&clk")-1))
  (
    &wild_tail=1
  )

  if ((&wild_head==1)&&(&wild_tail==1))
  (
    if (STRING.SCAN("gcc_wcss_tbu_clk", STRING.MID("&clk", 1, &clk_input_length-2), 0)!=-1)
    ( 
      &match=1
    )
  )
  else if (&wild_head==1)
  (
    if (STRING.MID("gcc_wcss_tbu_clk", &clk_itr_length-&clk_input_length+1, &clk_input_length-1)==STRING.CUT("&clk", 1))
    ( 
      &match=1
    )
  )
  else if (&wild_tail==1)
  (
    if (STRING.MID("gcc_wcss_tbu_clk", 0, &clk_input_length-1)==STRING.CUT("&clk", -1))
    ( 
      &match=1
    )
  )
  else if ("gcc_wcss_tbu_clk"=="&clk")
  (
    &match=1
  )
  
  if (&match==1)
  (
    &clk_test=&CLK_TEST_GCC_WCSS_TBU_CLK
    &clk_reg=&HWIO_GCC_WCSS_TBU_CBCR_ADDR
    &clk_reg_name="GCC_WCSS_TBU_CBCR"
    &clk_name="gcc_wcss_tbu_clk"
    &clk_reg_cbcr_type="sm_cbc"
    &clk_vote_bit=17.
    &clk_multiplier=4.
    &clk_access_mode="&GCC_access_mode"

    gosub Print_Clk_Info_Line
  )

  &match=0
  &wild_head=0
  &wild_tail=0
  &clk_input_length=STRING.LENGTH("&clk")
  &clk_itr_length=STRING.LENGTH("gcc_wdsp_q6ss_axim_clk")

  if (STRING.SCAN("&clk", "*", 0)==0)
  (
    &wild_head=1
  )
  if (STRING.SCAN("&clk", "*", 1)==(STRING.LENGTH("&clk")-1))
  (
    &wild_tail=1
  )

  if ((&wild_head==1)&&(&wild_tail==1))
  (
    if (STRING.SCAN("gcc_wdsp_q6ss_axim_clk", STRING.MID("&clk", 1, &clk_input_length-2), 0)!=-1)
    ( 
      &match=1
    )
  )
  else if (&wild_head==1)
  (
    if (STRING.MID("gcc_wdsp_q6ss_axim_clk", &clk_itr_length-&clk_input_length+1, &clk_input_length-1)==STRING.CUT("&clk", 1))
    ( 
      &match=1
    )
  )
  else if (&wild_tail==1)
  (
    if (STRING.MID("gcc_wdsp_q6ss_axim_clk", 0, &clk_input_length-1)==STRING.CUT("&clk", -1))
    ( 
      &match=1
    )
  )
  else if ("gcc_wdsp_q6ss_axim_clk"=="&clk")
  (
    &match=1
  )
  
  if (&match==1)
  (
    &clk_test=&CLK_TEST_GCC_WDSP_Q6SS_AXIM_CLK
    &clk_reg=&HWIO_GCC_WDSP_Q6SS_AXIM_CBCR_ADDR
    &clk_reg_name="GCC_WDSP_Q6SS_AXIM_CBCR"
    &clk_name="gcc_wdsp_q6ss_axim_clk"
    &clk_reg_cbcr_type="sm_cbc"
    &clk_vote_bit=-1.
    &clk_multiplier=4.
    &clk_access_mode="&GCC_access_mode"

    gosub Print_Clk_Info_Line
  )

  &match=0
  &wild_head=0
  &wild_tail=0
  &clk_input_length=STRING.LENGTH("&clk")
  &clk_itr_length=STRING.LENGTH("gcc_wdsp_xpu_clk")

  if (STRING.SCAN("&clk", "*", 0)==0)
  (
    &wild_head=1
  )
  if (STRING.SCAN("&clk", "*", 1)==(STRING.LENGTH("&clk")-1))
  (
    &wild_tail=1
  )

  if ((&wild_head==1)&&(&wild_tail==1))
  (
    if (STRING.SCAN("gcc_wdsp_xpu_clk", STRING.MID("&clk", 1, &clk_input_length-2), 0)!=-1)
    ( 
      &match=1
    )
  )
  else if (&wild_head==1)
  (
    if (STRING.MID("gcc_wdsp_xpu_clk", &clk_itr_length-&clk_input_length+1, &clk_input_length-1)==STRING.CUT("&clk", 1))
    ( 
      &match=1
    )
  )
  else if (&wild_tail==1)
  (
    if (STRING.MID("gcc_wdsp_xpu_clk", 0, &clk_input_length-1)==STRING.CUT("&clk", -1))
    ( 
      &match=1
    )
  )
  else if ("gcc_wdsp_xpu_clk"=="&clk")
  (
    &match=1
  )
  
  if (&match==1)
  (
    &clk_test=&CLK_TEST_GCC_WDSP_XPU_CLK
    &clk_reg=&HWIO_GCC_WDSP_XPU_CBCR_ADDR
    &clk_reg_name="GCC_WDSP_XPU_CBCR"
    &clk_name="gcc_wdsp_xpu_clk"
    &clk_reg_cbcr_type="sm_cbc"
    &clk_vote_bit=0.
    &clk_multiplier=4.
    &clk_access_mode="&GCC_access_mode"

    gosub Print_Clk_Info_Line
  )

  &match=0
  &wild_head=0
  &wild_tail=0
  &clk_input_length=STRING.LENGTH("&clk")
  &clk_itr_length=STRING.LENGTH("gcc_tic_clk")

  if (STRING.SCAN("&clk", "*", 0)==0)
  (
    &wild_head=1
  )
  if (STRING.SCAN("&clk", "*", 1)==(STRING.LENGTH("&clk")-1))
  (
    &wild_tail=1
  )

  if ((&wild_head==1)&&(&wild_tail==1))
  (
    if (STRING.SCAN("gcc_tic_clk", STRING.MID("&clk", 1, &clk_input_length-2), 0)!=-1)
    ( 
      &match=1
    )
  )
  else if (&wild_head==1)
  (
    if (STRING.MID("gcc_tic_clk", &clk_itr_length-&clk_input_length+1, &clk_input_length-1)==STRING.CUT("&clk", 1))
    ( 
      &match=1
    )
  )
  else if (&wild_tail==1)
  (
    if (STRING.MID("gcc_tic_clk", 0, &clk_input_length-1)==STRING.CUT("&clk", -1))
    ( 
      &match=1
    )
  )
  else if ("gcc_tic_clk"=="&clk")
  (
    &match=1
  )
  
  if (&match==1)
  (
    &clk_test=0
    &clk_reg=0
    &clk_reg_name="No CBCR"
    &clk_name="gcc_tic_clk"
    &clk_reg_cbcr_type=""
    &clk_vote_bit=-1.
    &clk_multiplier=4.
    &clk_access_mode="&GCC_access_mode"

    gosub Print_Clk_Info_Line
  )

  &match=0
  &wild_head=0
  &wild_tail=0
  &clk_input_length=STRING.LENGTH("&clk")
  &clk_itr_length=STRING.LENGTH("gcc_usb20_mock_utmi_clk")

  if (STRING.SCAN("&clk", "*", 0)==0)
  (
    &wild_head=1
  )
  if (STRING.SCAN("&clk", "*", 1)==(STRING.LENGTH("&clk")-1))
  (
    &wild_tail=1
  )

  if ((&wild_head==1)&&(&wild_tail==1))
  (
    if (STRING.SCAN("gcc_usb20_mock_utmi_clk", STRING.MID("&clk", 1, &clk_input_length-2), 0)!=-1)
    ( 
      &match=1
    )
  )
  else if (&wild_head==1)
  (
    if (STRING.MID("gcc_usb20_mock_utmi_clk", &clk_itr_length-&clk_input_length+1, &clk_input_length-1)==STRING.CUT("&clk", 1))
    ( 
      &match=1
    )
  )
  else if (&wild_tail==1)
  (
    if (STRING.MID("gcc_usb20_mock_utmi_clk", 0, &clk_input_length-1)==STRING.CUT("&clk", -1))
    ( 
      &match=1
    )
  )
  else if ("gcc_usb20_mock_utmi_clk"=="&clk")
  (
    &match=1
  )
  
  if (&match==1)
  (
    &clk_test=&CLK_TEST_GCC_USB20_MOCK_UTMI_CLK
    &clk_reg=&HWIO_GCC_USB20_MOCK_UTMI_CBCR_ADDR
    &clk_reg_name="GCC_USB20_MOCK_UTMI_CBCR"
    &clk_name="gcc_usb20_mock_utmi_clk"
    &clk_reg_cbcr_type="sm_cbc"
    &clk_vote_bit=-1.
    &clk_multiplier=4.
    &clk_access_mode="&GCC_access_mode"

    gosub Print_Clk_Info_Line
  )

  &match=0
  &wild_head=0
  &wild_tail=0
  &clk_input_length=STRING.LENGTH("&clk")
  &clk_itr_length=STRING.LENGTH("gcc_pcnoc_bus_timeout11_ahb_clk")

  if (STRING.SCAN("&clk", "*", 0)==0)
  (
    &wild_head=1
  )
  if (STRING.SCAN("&clk", "*", 1)==(STRING.LENGTH("&clk")-1))
  (
    &wild_tail=1
  )

  if ((&wild_head==1)&&(&wild_tail==1))
  (
    if (STRING.SCAN("gcc_pcnoc_bus_timeout11_ahb_clk", STRING.MID("&clk", 1, &clk_input_length-2), 0)!=-1)
    ( 
      &match=1
    )
  )
  else if (&wild_head==1)
  (
    if (STRING.MID("gcc_pcnoc_bus_timeout11_ahb_clk", &clk_itr_length-&clk_input_length+1, &clk_input_length-1)==STRING.CUT("&clk", 1))
    ( 
      &match=1
    )
  )
  else if (&wild_tail==1)
  (
    if (STRING.MID("gcc_pcnoc_bus_timeout11_ahb_clk", 0, &clk_input_length-1)==STRING.CUT("&clk", -1))
    ( 
      &match=1
    )
  )
  else if ("gcc_pcnoc_bus_timeout11_ahb_clk"=="&clk")
  (
    &match=1
  )
  
  if (&match==1)
  (
    &clk_test=&CLK_TEST_GCC_PCNOC_BUS_TIMEOUT11_AHB_CLK
    &clk_reg=&HWIO_GCC_PCNOC_BUS_TIMEOUT11_AHB_CBCR_ADDR
    &clk_reg_name="GCC_PCNOC_BUS_TIMEOUT11_AHB_CBCR"
    &clk_name="gcc_pcnoc_bus_timeout11_ahb_clk"
    &clk_reg_cbcr_type="sm_cbc"
    &clk_vote_bit=-1.
    &clk_multiplier=4.
    &clk_access_mode="&GCC_access_mode"

    gosub Print_Clk_Info_Line
  )

  &match=0
  &wild_head=0
  &wild_tail=0
  &clk_input_length=STRING.LENGTH("&clk")
  &clk_itr_length=STRING.LENGTH("gcc_pcnoc_usb3_clk")

  if (STRING.SCAN("&clk", "*", 0)==0)
  (
    &wild_head=1
  )
  if (STRING.SCAN("&clk", "*", 1)==(STRING.LENGTH("&clk")-1))
  (
    &wild_tail=1
  )

  if ((&wild_head==1)&&(&wild_tail==1))
  (
    if (STRING.SCAN("gcc_pcnoc_usb3_clk", STRING.MID("&clk", 1, &clk_input_length-2), 0)!=-1)
    ( 
      &match=1
    )
  )
  else if (&wild_head==1)
  (
    if (STRING.MID("gcc_pcnoc_usb3_clk", &clk_itr_length-&clk_input_length+1, &clk_input_length-1)==STRING.CUT("&clk", 1))
    ( 
      &match=1
    )
  )
  else if (&wild_tail==1)
  (
    if (STRING.MID("gcc_pcnoc_usb3_clk", 0, &clk_input_length-1)==STRING.CUT("&clk", -1))
    ( 
      &match=1
    )
  )
  else if ("gcc_pcnoc_usb3_clk"=="&clk")
  (
    &match=1
  )
  
  if (&match==1)
  (
    &clk_test=&CLK_TEST_GCC_PCNOC_USB3_CLK
    &clk_reg=&HWIO_GCC_PCNOC_USB3_CBCR_ADDR
    &clk_reg_name="GCC_PCNOC_USB3_CBCR"
    &clk_name="gcc_pcnoc_usb3_clk"
    &clk_reg_cbcr_type="sm_cbc"
    &clk_vote_bit=-1.
    &clk_multiplier=4.
    &clk_access_mode="&GCC_access_mode"

    gosub Print_Clk_Info_Line
  )

  &match=0
  &wild_head=0
  &wild_tail=0
  &clk_input_length=STRING.LENGTH("&clk")
  &clk_itr_length=STRING.LENGTH("gcc_sys_noc_usb3_clk")

  if (STRING.SCAN("&clk", "*", 0)==0)
  (
    &wild_head=1
  )
  if (STRING.SCAN("&clk", "*", 1)==(STRING.LENGTH("&clk")-1))
  (
    &wild_tail=1
  )

  if ((&wild_head==1)&&(&wild_tail==1))
  (
    if (STRING.SCAN("gcc_sys_noc_usb3_clk", STRING.MID("&clk", 1, &clk_input_length-2), 0)!=-1)
    ( 
      &match=1
    )
  )
  else if (&wild_head==1)
  (
    if (STRING.MID("gcc_sys_noc_usb3_clk", &clk_itr_length-&clk_input_length+1, &clk_input_length-1)==STRING.CUT("&clk", 1))
    ( 
      &match=1
    )
  )
  else if (&wild_tail==1)
  (
    if (STRING.MID("gcc_sys_noc_usb3_clk", 0, &clk_input_length-1)==STRING.CUT("&clk", -1))
    ( 
      &match=1
    )
  )
  else if ("gcc_sys_noc_usb3_clk"=="&clk")
  (
    &match=1
  )
  
  if (&match==1)
  (
    &clk_test=&CLK_TEST_GCC_SYS_NOC_USB3_CLK
    &clk_reg=&HWIO_GCC_SYS_NOC_USB3_CBCR_ADDR
    &clk_reg_name="GCC_SYS_NOC_USB3_CBCR"
    &clk_name="gcc_sys_noc_usb3_clk"
    &clk_reg_cbcr_type="sm_cbc"
    &clk_vote_bit=-1.
    &clk_multiplier=4.
    &clk_access_mode="&GCC_access_mode"

    gosub Print_Clk_Info_Line
  )

  &match=0
  &wild_head=0
  &wild_tail=0
  &clk_input_length=STRING.LENGTH("&clk")
  &clk_itr_length=STRING.LENGTH("gcc_usb30_master_clk")

  if (STRING.SCAN("&clk", "*", 0)==0)
  (
    &wild_head=1
  )
  if (STRING.SCAN("&clk", "*", 1)==(STRING.LENGTH("&clk")-1))
  (
    &wild_tail=1
  )

  if ((&wild_head==1)&&(&wild_tail==1))
  (
    if (STRING.SCAN("gcc_usb30_master_clk", STRING.MID("&clk", 1, &clk_input_length-2), 0)!=-1)
    ( 
      &match=1
    )
  )
  else if (&wild_head==1)
  (
    if (STRING.MID("gcc_usb30_master_clk", &clk_itr_length-&clk_input_length+1, &clk_input_length-1)==STRING.CUT("&clk", 1))
    ( 
      &match=1
    )
  )
  else if (&wild_tail==1)
  (
    if (STRING.MID("gcc_usb30_master_clk", 0, &clk_input_length-1)==STRING.CUT("&clk", -1))
    ( 
      &match=1
    )
  )
  else if ("gcc_usb30_master_clk"=="&clk")
  (
    &match=1
  )
  
  if (&match==1)
  (
    &clk_test=&CLK_TEST_GCC_USB30_MASTER_CLK
    &clk_reg=&HWIO_GCC_USB30_MASTER_CBCR_ADDR
    &clk_reg_name="GCC_USB30_MASTER_CBCR"
    &clk_name="gcc_usb30_master_clk"
    &clk_reg_cbcr_type="sm_pscbc"
    &clk_vote_bit=-1.
    &clk_multiplier=4.
    &clk_access_mode="&GCC_access_mode"

    gosub Print_Clk_Info_Line
  )

  &match=0
  &wild_head=0
  &wild_tail=0
  &clk_input_length=STRING.LENGTH("&clk")
  &clk_itr_length=STRING.LENGTH("gcc_usb3_tbu_axi_clk")

  if (STRING.SCAN("&clk", "*", 0)==0)
  (
    &wild_head=1
  )
  if (STRING.SCAN("&clk", "*", 1)==(STRING.LENGTH("&clk")-1))
  (
    &wild_tail=1
  )

  if ((&wild_head==1)&&(&wild_tail==1))
  (
    if (STRING.SCAN("gcc_usb3_tbu_axi_clk", STRING.MID("&clk", 1, &clk_input_length-2), 0)!=-1)
    ( 
      &match=1
    )
  )
  else if (&wild_head==1)
  (
    if (STRING.MID("gcc_usb3_tbu_axi_clk", &clk_itr_length-&clk_input_length+1, &clk_input_length-1)==STRING.CUT("&clk", 1))
    ( 
      &match=1
    )
  )
  else if (&wild_tail==1)
  (
    if (STRING.MID("gcc_usb3_tbu_axi_clk", 0, &clk_input_length-1)==STRING.CUT("&clk", -1))
    ( 
      &match=1
    )
  )
  else if ("gcc_usb3_tbu_axi_clk"=="&clk")
  (
    &match=1
  )
  
  if (&match==1)
  (
    &clk_test=&CLK_TEST_GCC_USB3_TBU_AXI_CLK
    &clk_reg=&HWIO_GCC_USB3_TBU_AXI_CBCR_ADDR
    &clk_reg_name="GCC_USB3_TBU_AXI_CBCR"
    &clk_name="gcc_usb3_tbu_axi_clk"
    &clk_reg_cbcr_type="sm_cbc"
    &clk_vote_bit=7.
    &clk_multiplier=4.
    &clk_access_mode="&GCC_access_mode"

    gosub Print_Clk_Info_Line
  )

  &match=0
  &wild_head=0
  &wild_tail=0
  &clk_input_length=STRING.LENGTH("&clk")
  &clk_itr_length=STRING.LENGTH("gcc_usb30_mock_utmi_clk")

  if (STRING.SCAN("&clk", "*", 0)==0)
  (
    &wild_head=1
  )
  if (STRING.SCAN("&clk", "*", 1)==(STRING.LENGTH("&clk")-1))
  (
    &wild_tail=1
  )

  if ((&wild_head==1)&&(&wild_tail==1))
  (
    if (STRING.SCAN("gcc_usb30_mock_utmi_clk", STRING.MID("&clk", 1, &clk_input_length-2), 0)!=-1)
    ( 
      &match=1
    )
  )
  else if (&wild_head==1)
  (
    if (STRING.MID("gcc_usb30_mock_utmi_clk", &clk_itr_length-&clk_input_length+1, &clk_input_length-1)==STRING.CUT("&clk", 1))
    ( 
      &match=1
    )
  )
  else if (&wild_tail==1)
  (
    if (STRING.MID("gcc_usb30_mock_utmi_clk", 0, &clk_input_length-1)==STRING.CUT("&clk", -1))
    ( 
      &match=1
    )
  )
  else if ("gcc_usb30_mock_utmi_clk"=="&clk")
  (
    &match=1
  )
  
  if (&match==1)
  (
    &clk_test=&CLK_TEST_GCC_USB30_MOCK_UTMI_CLK
    &clk_reg=&HWIO_GCC_USB30_MOCK_UTMI_CBCR_ADDR
    &clk_reg_name="GCC_USB30_MOCK_UTMI_CBCR"
    &clk_name="gcc_usb30_mock_utmi_clk"
    &clk_reg_cbcr_type="sm_cbc"
    &clk_vote_bit=-1.
    &clk_multiplier=4.
    &clk_access_mode="&GCC_access_mode"

    gosub Print_Clk_Info_Line
  )

  &match=0
  &wild_head=0
  &wild_tail=0
  &clk_input_length=STRING.LENGTH("&clk")
  &clk_itr_length=STRING.LENGTH("gcc_usb30_phy_pipe_clk")

  if (STRING.SCAN("&clk", "*", 0)==0)
  (
    &wild_head=1
  )
  if (STRING.SCAN("&clk", "*", 1)==(STRING.LENGTH("&clk")-1))
  (
    &wild_tail=1
  )

  if ((&wild_head==1)&&(&wild_tail==1))
  (
    if (STRING.SCAN("gcc_usb30_phy_pipe_clk", STRING.MID("&clk", 1, &clk_input_length-2), 0)!=-1)
    ( 
      &match=1
    )
  )
  else if (&wild_head==1)
  (
    if (STRING.MID("gcc_usb30_phy_pipe_clk", &clk_itr_length-&clk_input_length+1, &clk_input_length-1)==STRING.CUT("&clk", 1))
    ( 
      &match=1
    )
  )
  else if (&wild_tail==1)
  (
    if (STRING.MID("gcc_usb30_phy_pipe_clk", 0, &clk_input_length-1)==STRING.CUT("&clk", -1))
    ( 
      &match=1
    )
  )
  else if ("gcc_usb30_phy_pipe_clk"=="&clk")
  (
    &match=1
  )
  
  if (&match==1)
  (
    &clk_test=&CLK_TEST_GCC_USB30_PHY_PIPE_CLK
    &clk_reg=&HWIO_GCC_USB30_PHY_PIPE_CBCR_ADDR
    &clk_reg_name="GCC_USB30_PHY_PIPE_CBCR"
    &clk_name="gcc_usb30_phy_pipe_clk"
    &clk_reg_cbcr_type="sm_cbc"
    &clk_vote_bit=-1.
    &clk_multiplier=4.
    &clk_access_mode="&GCC_access_mode"

    gosub Print_Clk_Info_Line
  )

  &match=0
  &wild_head=0
  &wild_tail=0
  &clk_input_length=STRING.LENGTH("&clk")
  &clk_itr_length=STRING.LENGTH("gcc_usb3_phy_aux_clk")

  if (STRING.SCAN("&clk", "*", 0)==0)
  (
    &wild_head=1
  )
  if (STRING.SCAN("&clk", "*", 1)==(STRING.LENGTH("&clk")-1))
  (
    &wild_tail=1
  )

  if ((&wild_head==1)&&(&wild_tail==1))
  (
    if (STRING.SCAN("gcc_usb3_phy_aux_clk", STRING.MID("&clk", 1, &clk_input_length-2), 0)!=-1)
    ( 
      &match=1
    )
  )
  else if (&wild_head==1)
  (
    if (STRING.MID("gcc_usb3_phy_aux_clk", &clk_itr_length-&clk_input_length+1, &clk_input_length-1)==STRING.CUT("&clk", 1))
    ( 
      &match=1
    )
  )
  else if (&wild_tail==1)
  (
    if (STRING.MID("gcc_usb3_phy_aux_clk", 0, &clk_input_length-1)==STRING.CUT("&clk", -1))
    ( 
      &match=1
    )
  )
  else if ("gcc_usb3_phy_aux_clk"=="&clk")
  (
    &match=1
  )
  
  if (&match==1)
  (
    &clk_test=&CLK_TEST_GCC_USB3_PHY_AUX_CLK
    &clk_reg=&HWIO_GCC_USB3_PHY_AUX_CBCR_ADDR
    &clk_reg_name="GCC_USB3_PHY_AUX_CBCR"
    &clk_name="gcc_usb3_phy_aux_clk"
    &clk_reg_cbcr_type="sm_cbc"
    &clk_vote_bit=-1.
    &clk_multiplier=4.
    &clk_access_mode="&GCC_access_mode"

    gosub Print_Clk_Info_Line
  )

  &match=0
  &wild_head=0
  &wild_tail=0
  &clk_input_length=STRING.LENGTH("&clk")
  &clk_itr_length=STRING.LENGTH("gcc_pcnoc_bus_timeout10_ahb_clk")

  if (STRING.SCAN("&clk", "*", 0)==0)
  (
    &wild_head=1
  )
  if (STRING.SCAN("&clk", "*", 1)==(STRING.LENGTH("&clk")-1))
  (
    &wild_tail=1
  )

  if ((&wild_head==1)&&(&wild_tail==1))
  (
    if (STRING.SCAN("gcc_pcnoc_bus_timeout10_ahb_clk", STRING.MID("&clk", 1, &clk_input_length-2), 0)!=-1)
    ( 
      &match=1
    )
  )
  else if (&wild_head==1)
  (
    if (STRING.MID("gcc_pcnoc_bus_timeout10_ahb_clk", &clk_itr_length-&clk_input_length+1, &clk_input_length-1)==STRING.CUT("&clk", 1))
    ( 
      &match=1
    )
  )
  else if (&wild_tail==1)
  (
    if (STRING.MID("gcc_pcnoc_bus_timeout10_ahb_clk", 0, &clk_input_length-1)==STRING.CUT("&clk", -1))
    ( 
      &match=1
    )
  )
  else if ("gcc_pcnoc_bus_timeout10_ahb_clk"=="&clk")
  (
    &match=1
  )
  
  if (&match==1)
  (
    &clk_test=&CLK_TEST_GCC_PCNOC_BUS_TIMEOUT10_AHB_CLK
    &clk_reg=&HWIO_GCC_PCNOC_BUS_TIMEOUT10_AHB_CBCR_ADDR
    &clk_reg_name="GCC_PCNOC_BUS_TIMEOUT10_AHB_CBCR"
    &clk_name="gcc_pcnoc_bus_timeout10_ahb_clk"
    &clk_reg_cbcr_type="sm_cbc"
    &clk_vote_bit=-1.
    &clk_multiplier=4.
    &clk_access_mode="&GCC_access_mode"

    gosub Print_Clk_Info_Line
  )

  &match=0
  &wild_head=0
  &wild_tail=0
  &clk_input_length=STRING.LENGTH("&clk")
  &clk_itr_length=STRING.LENGTH("gcc_pcnoc_usb2_clk")

  if (STRING.SCAN("&clk", "*", 0)==0)
  (
    &wild_head=1
  )
  if (STRING.SCAN("&clk", "*", 1)==(STRING.LENGTH("&clk")-1))
  (
    &wild_tail=1
  )

  if ((&wild_head==1)&&(&wild_tail==1))
  (
    if (STRING.SCAN("gcc_pcnoc_usb2_clk", STRING.MID("&clk", 1, &clk_input_length-2), 0)!=-1)
    ( 
      &match=1
    )
  )
  else if (&wild_head==1)
  (
    if (STRING.MID("gcc_pcnoc_usb2_clk", &clk_itr_length-&clk_input_length+1, &clk_input_length-1)==STRING.CUT("&clk", 1))
    ( 
      &match=1
    )
  )
  else if (&wild_tail==1)
  (
    if (STRING.MID("gcc_pcnoc_usb2_clk", 0, &clk_input_length-1)==STRING.CUT("&clk", -1))
    ( 
      &match=1
    )
  )
  else if ("gcc_pcnoc_usb2_clk"=="&clk")
  (
    &match=1
  )
  
  if (&match==1)
  (
    &clk_test=&CLK_TEST_GCC_PCNOC_USB2_CLK
    &clk_reg=&HWIO_GCC_PCNOC_USB2_CBCR_ADDR
    &clk_reg_name="GCC_PCNOC_USB2_CBCR"
    &clk_name="gcc_pcnoc_usb2_clk"
    &clk_reg_cbcr_type="sm_cbc"
    &clk_vote_bit=-1.
    &clk_multiplier=4.
    &clk_access_mode="&GCC_access_mode"

    gosub Print_Clk_Info_Line
  )

  &match=0
  &wild_head=0
  &wild_tail=0
  &clk_input_length=STRING.LENGTH("&clk")
  &clk_itr_length=STRING.LENGTH("gcc_usb_hs_system_clk")

  if (STRING.SCAN("&clk", "*", 0)==0)
  (
    &wild_head=1
  )
  if (STRING.SCAN("&clk", "*", 1)==(STRING.LENGTH("&clk")-1))
  (
    &wild_tail=1
  )

  if ((&wild_head==1)&&(&wild_tail==1))
  (
    if (STRING.SCAN("gcc_usb_hs_system_clk", STRING.MID("&clk", 1, &clk_input_length-2), 0)!=-1)
    ( 
      &match=1
    )
  )
  else if (&wild_head==1)
  (
    if (STRING.MID("gcc_usb_hs_system_clk", &clk_itr_length-&clk_input_length+1, &clk_input_length-1)==STRING.CUT("&clk", 1))
    ( 
      &match=1
    )
  )
  else if (&wild_tail==1)
  (
    if (STRING.MID("gcc_usb_hs_system_clk", 0, &clk_input_length-1)==STRING.CUT("&clk", -1))
    ( 
      &match=1
    )
  )
  else if ("gcc_usb_hs_system_clk"=="&clk")
  (
    &match=1
  )
  
  if (&match==1)
  (
    &clk_test=&CLK_TEST_GCC_USB_HS_SYSTEM_CLK
    &clk_reg=&HWIO_GCC_USB_HS_SYSTEM_CBCR_ADDR
    &clk_reg_name="GCC_USB_HS_SYSTEM_CBCR"
    &clk_name="gcc_usb_hs_system_clk"
    &clk_reg_cbcr_type="sm_pscbc"
    &clk_vote_bit=-1.
    &clk_multiplier=4.
    &clk_access_mode="&GCC_access_mode"

    gosub Print_Clk_Info_Line
  )

  &match=0
  &wild_head=0
  &wild_tail=0
  &clk_input_length=STRING.LENGTH("&clk")
  &clk_itr_length=STRING.LENGTH("gcc_mdss_vsync_clk")

  if (STRING.SCAN("&clk", "*", 0)==0)
  (
    &wild_head=1
  )
  if (STRING.SCAN("&clk", "*", 1)==(STRING.LENGTH("&clk")-1))
  (
    &wild_tail=1
  )

  if ((&wild_head==1)&&(&wild_tail==1))
  (
    if (STRING.SCAN("gcc_mdss_vsync_clk", STRING.MID("&clk", 1, &clk_input_length-2), 0)!=-1)
    ( 
      &match=1
    )
  )
  else if (&wild_head==1)
  (
    if (STRING.MID("gcc_mdss_vsync_clk", &clk_itr_length-&clk_input_length+1, &clk_input_length-1)==STRING.CUT("&clk", 1))
    ( 
      &match=1
    )
  )
  else if (&wild_tail==1)
  (
    if (STRING.MID("gcc_mdss_vsync_clk", 0, &clk_input_length-1)==STRING.CUT("&clk", -1))
    ( 
      &match=1
    )
  )
  else if ("gcc_mdss_vsync_clk"=="&clk")
  (
    &match=1
  )
  
  if (&match==1)
  (
    &clk_test=&CLK_TEST_GCC_MDSS_VSYNC_CLK
    &clk_reg=&HWIO_GCC_MDSS_VSYNC_CBCR_ADDR
    &clk_reg_name="GCC_MDSS_VSYNC_CBCR"
    &clk_name="gcc_mdss_vsync_clk"
    &clk_reg_cbcr_type="sm_cbc"
    &clk_vote_bit=-1.
    &clk_multiplier=4.
    &clk_access_mode="&GCC_access_mode"

    gosub Print_Clk_Info_Line
  )

  &match=0
  &wild_head=0
  &wild_tail=0
  &clk_input_length=STRING.LENGTH("&clk")
  &clk_itr_length=STRING.LENGTH("gcc_wdsp_q6ss_aon_clk")

  if (STRING.SCAN("&clk", "*", 0)==0)
  (
    &wild_head=1
  )
  if (STRING.SCAN("&clk", "*", 1)==(STRING.LENGTH("&clk")-1))
  (
    &wild_tail=1
  )

  if ((&wild_head==1)&&(&wild_tail==1))
  (
    if (STRING.SCAN("gcc_wdsp_q6ss_aon_clk", STRING.MID("&clk", 1, &clk_input_length-2), 0)!=-1)
    ( 
      &match=1
    )
  )
  else if (&wild_head==1)
  (
    if (STRING.MID("gcc_wdsp_q6ss_aon_clk", &clk_itr_length-&clk_input_length+1, &clk_input_length-1)==STRING.CUT("&clk", 1))
    ( 
      &match=1
    )
  )
  else if (&wild_tail==1)
  (
    if (STRING.MID("gcc_wdsp_q6ss_aon_clk", 0, &clk_input_length-1)==STRING.CUT("&clk", -1))
    ( 
      &match=1
    )
  )
  else if ("gcc_wdsp_q6ss_aon_clk"=="&clk")
  (
    &match=1
  )
  
  if (&match==1)
  (
    &clk_test=&CLK_TEST_GCC_WDSP_Q6SS_AON_CLK
    &clk_reg=&HWIO_GCC_WDSP_Q6SS_AON_CBCR_ADDR
    &clk_reg_name="GCC_WDSP_Q6SS_AON_CBCR"
    &clk_name="gcc_wdsp_q6ss_aon_clk"
    &clk_reg_cbcr_type="sm_cbc"
    &clk_vote_bit=-1.
    &clk_multiplier=4.
    &clk_access_mode="&GCC_access_mode"

    gosub Print_Clk_Info_Line
  )

  &match=0
  &wild_head=0
  &wild_tail=0
  &clk_input_length=STRING.LENGTH("&clk")
  &clk_itr_length=STRING.LENGTH("gcc_wdsp_q6ss_qos_clk")

  if (STRING.SCAN("&clk", "*", 0)==0)
  (
    &wild_head=1
  )
  if (STRING.SCAN("&clk", "*", 1)==(STRING.LENGTH("&clk")-1))
  (
    &wild_tail=1
  )

  if ((&wild_head==1)&&(&wild_tail==1))
  (
    if (STRING.SCAN("gcc_wdsp_q6ss_qos_clk", STRING.MID("&clk", 1, &clk_input_length-2), 0)!=-1)
    ( 
      &match=1
    )
  )
  else if (&wild_head==1)
  (
    if (STRING.MID("gcc_wdsp_q6ss_qos_clk", &clk_itr_length-&clk_input_length+1, &clk_input_length-1)==STRING.CUT("&clk", 1))
    ( 
      &match=1
    )
  )
  else if (&wild_tail==1)
  (
    if (STRING.MID("gcc_wdsp_q6ss_qos_clk", 0, &clk_input_length-1)==STRING.CUT("&clk", -1))
    ( 
      &match=1
    )
  )
  else if ("gcc_wdsp_q6ss_qos_clk"=="&clk")
  (
    &match=1
  )
  
  if (&match==1)
  (
    &clk_test=&CLK_TEST_GCC_WDSP_Q6SS_QOS_CLK
    &clk_reg=&HWIO_GCC_WDSP_Q6SS_QOS_CBCR_ADDR
    &clk_reg_name="GCC_WDSP_Q6SS_QOS_CBCR"
    &clk_name="gcc_wdsp_q6ss_qos_clk"
    &clk_reg_cbcr_type="sm_cbc"
    &clk_vote_bit=-1.
    &clk_multiplier=4.
    &clk_access_mode="&GCC_access_mode"

    gosub Print_Clk_Info_Line
  )

  &match=0
  &wild_head=0
  &wild_tail=0
  &clk_input_length=STRING.LENGTH("&clk")
  &clk_itr_length=STRING.LENGTH("apss_gcc_dbg_clk")

  if (STRING.SCAN("&clk", "*", 0)==0)
  (
    &wild_head=1
  )
  if (STRING.SCAN("&clk", "*", 1)==(STRING.LENGTH("&clk")-1))
  (
    &wild_tail=1
  )

  if ((&wild_head==1)&&(&wild_tail==1))
  (
    if (STRING.SCAN("apss_gcc_dbg_clk", STRING.MID("&clk", 1, &clk_input_length-2), 0)!=-1)
    ( 
      &match=1
    )
  )
  else if (&wild_head==1)
  (
    if (STRING.MID("apss_gcc_dbg_clk", &clk_itr_length-&clk_input_length+1, &clk_input_length-1)==STRING.CUT("&clk", 1))
    ( 
      &match=1
    )
  )
  else if (&wild_tail==1)
  (
    if (STRING.MID("apss_gcc_dbg_clk", 0, &clk_input_length-1)==STRING.CUT("&clk", -1))
    ( 
      &match=1
    )
  )
  else if ("apss_gcc_dbg_clk"=="&clk")
  (
    &match=1
  )
  
  if (&match==1)
  (
    &clk_test=&CLK_TEST_APSS_GCC_DBG_CLK
    &clk_reg=0
    &clk_reg_name="No CBCR"
    &clk_name="apss_gcc_dbg_clk"
    &clk_reg_cbcr_type=""
    &clk_vote_bit=-1.
    &clk_multiplier=4.
    &clk_access_mode="&GCC_access_mode"

    gosub Print_Clk_Info_Line
  )

  &match=0
  &wild_head=0
  &wild_tail=0
  &clk_input_length=STRING.LENGTH("&clk")
  &clk_itr_length=STRING.LENGTH("apss_gcc_ringosc_clk")

  if (STRING.SCAN("&clk", "*", 0)==0)
  (
    &wild_head=1
  )
  if (STRING.SCAN("&clk", "*", 1)==(STRING.LENGTH("&clk")-1))
  (
    &wild_tail=1
  )

  if ((&wild_head==1)&&(&wild_tail==1))
  (
    if (STRING.SCAN("apss_gcc_ringosc_clk", STRING.MID("&clk", 1, &clk_input_length-2), 0)!=-1)
    ( 
      &match=1
    )
  )
  else if (&wild_head==1)
  (
    if (STRING.MID("apss_gcc_ringosc_clk", &clk_itr_length-&clk_input_length+1, &clk_input_length-1)==STRING.CUT("&clk", 1))
    ( 
      &match=1
    )
  )
  else if (&wild_tail==1)
  (
    if (STRING.MID("apss_gcc_ringosc_clk", 0, &clk_input_length-1)==STRING.CUT("&clk", -1))
    ( 
      &match=1
    )
  )
  else if ("apss_gcc_ringosc_clk"=="&clk")
  (
    &match=1
  )
  
  if (&match==1)
  (
    &clk_test=&CLK_TEST_APSS_GCC_RINGOSC_CLK
    &clk_reg=0
    &clk_reg_name="No CBCR"
    &clk_name="apss_gcc_ringosc_clk"
    &clk_reg_cbcr_type=""
    &clk_vote_bit=-1.
    &clk_multiplier=4.
    &clk_access_mode="&GCC_access_mode"

    gosub Print_Clk_Info_Line
  )

  &match=0
  &wild_head=0
  &wild_tail=0
  &clk_input_length=STRING.LENGTH("&clk")
  &clk_itr_length=STRING.LENGTH("bimc_pll_dtest")

  if (STRING.SCAN("&clk", "*", 0)==0)
  (
    &wild_head=1
  )
  if (STRING.SCAN("&clk", "*", 1)==(STRING.LENGTH("&clk")-1))
  (
    &wild_tail=1
  )

  if ((&wild_head==1)&&(&wild_tail==1))
  (
    if (STRING.SCAN("bimc_pll_dtest", STRING.MID("&clk", 1, &clk_input_length-2), 0)!=-1)
    ( 
      &match=1
    )
  )
  else if (&wild_head==1)
  (
    if (STRING.MID("bimc_pll_dtest", &clk_itr_length-&clk_input_length+1, &clk_input_length-1)==STRING.CUT("&clk", 1))
    ( 
      &match=1
    )
  )
  else if (&wild_tail==1)
  (
    if (STRING.MID("bimc_pll_dtest", 0, &clk_input_length-1)==STRING.CUT("&clk", -1))
    ( 
      &match=1
    )
  )
  else if ("bimc_pll_dtest"=="&clk")
  (
    &match=1
  )
  
  if (&match==1)
  (
    &clk_test=&CLK_TEST_BIMC_PLL_DTEST
    &clk_reg=0
    &clk_reg_name="No CBCR"
    &clk_name="bimc_pll_dtest"
    &clk_reg_cbcr_type=""
    &clk_vote_bit=-1.
    &clk_multiplier=4.
    &clk_access_mode="&GCC_access_mode"

    gosub Print_Clk_Info_Line
  )

  &match=0
  &wild_head=0
  &wild_tail=0
  &clk_input_length=STRING.LENGTH("&clk")
  &clk_itr_length=STRING.LENGTH("bimc_pll_lock_det")

  if (STRING.SCAN("&clk", "*", 0)==0)
  (
    &wild_head=1
  )
  if (STRING.SCAN("&clk", "*", 1)==(STRING.LENGTH("&clk")-1))
  (
    &wild_tail=1
  )

  if ((&wild_head==1)&&(&wild_tail==1))
  (
    if (STRING.SCAN("bimc_pll_lock_det", STRING.MID("&clk", 1, &clk_input_length-2), 0)!=-1)
    ( 
      &match=1
    )
  )
  else if (&wild_head==1)
  (
    if (STRING.MID("bimc_pll_lock_det", &clk_itr_length-&clk_input_length+1, &clk_input_length-1)==STRING.CUT("&clk", 1))
    ( 
      &match=1
    )
  )
  else if (&wild_tail==1)
  (
    if (STRING.MID("bimc_pll_lock_det", 0, &clk_input_length-1)==STRING.CUT("&clk", -1))
    ( 
      &match=1
    )
  )
  else if ("bimc_pll_lock_det"=="&clk")
  (
    &match=1
  )
  
  if (&match==1)
  (
    &clk_test=&CLK_TEST_BIMC_PLL_LOCK_DET
    &clk_reg=0
    &clk_reg_name="No CBCR"
    &clk_name="bimc_pll_lock_det"
    &clk_reg_cbcr_type=""
    &clk_vote_bit=-1.
    &clk_multiplier=4.
    &clk_access_mode="&GCC_access_mode"

    gosub Print_Clk_Info_Line
  )

  &match=0
  &wild_head=0
  &wild_tail=0
  &clk_input_length=STRING.LENGTH("&clk")
  &clk_itr_length=STRING.LENGTH("gpll0_dtest")

  if (STRING.SCAN("&clk", "*", 0)==0)
  (
    &wild_head=1
  )
  if (STRING.SCAN("&clk", "*", 1)==(STRING.LENGTH("&clk")-1))
  (
    &wild_tail=1
  )

  if ((&wild_head==1)&&(&wild_tail==1))
  (
    if (STRING.SCAN("gpll0_dtest", STRING.MID("&clk", 1, &clk_input_length-2), 0)!=-1)
    ( 
      &match=1
    )
  )
  else if (&wild_head==1)
  (
    if (STRING.MID("gpll0_dtest", &clk_itr_length-&clk_input_length+1, &clk_input_length-1)==STRING.CUT("&clk", 1))
    ( 
      &match=1
    )
  )
  else if (&wild_tail==1)
  (
    if (STRING.MID("gpll0_dtest", 0, &clk_input_length-1)==STRING.CUT("&clk", -1))
    ( 
      &match=1
    )
  )
  else if ("gpll0_dtest"=="&clk")
  (
    &match=1
  )
  
  if (&match==1)
  (
    &clk_test=&CLK_TEST_GPLL0_DTEST
    &clk_reg=0
    &clk_reg_name="No CBCR"
    &clk_name="gpll0_dtest"
    &clk_reg_cbcr_type=""
    &clk_vote_bit=-1.
    &clk_multiplier=4.
    &clk_access_mode="&GCC_access_mode"

    gosub Print_Clk_Info_Line
  )

  &match=0
  &wild_head=0
  &wild_tail=0
  &clk_input_length=STRING.LENGTH("&clk")
  &clk_itr_length=STRING.LENGTH("gpll0_lock_det")

  if (STRING.SCAN("&clk", "*", 0)==0)
  (
    &wild_head=1
  )
  if (STRING.SCAN("&clk", "*", 1)==(STRING.LENGTH("&clk")-1))
  (
    &wild_tail=1
  )

  if ((&wild_head==1)&&(&wild_tail==1))
  (
    if (STRING.SCAN("gpll0_lock_det", STRING.MID("&clk", 1, &clk_input_length-2), 0)!=-1)
    ( 
      &match=1
    )
  )
  else if (&wild_head==1)
  (
    if (STRING.MID("gpll0_lock_det", &clk_itr_length-&clk_input_length+1, &clk_input_length-1)==STRING.CUT("&clk", 1))
    ( 
      &match=1
    )
  )
  else if (&wild_tail==1)
  (
    if (STRING.MID("gpll0_lock_det", 0, &clk_input_length-1)==STRING.CUT("&clk", -1))
    ( 
      &match=1
    )
  )
  else if ("gpll0_lock_det"=="&clk")
  (
    &match=1
  )
  
  if (&match==1)
  (
    &clk_test=&CLK_TEST_GPLL0_LOCK_DET
    &clk_reg=0
    &clk_reg_name="No CBCR"
    &clk_name="gpll0_lock_det"
    &clk_reg_cbcr_type=""
    &clk_vote_bit=-1.
    &clk_multiplier=4.
    &clk_access_mode="&GCC_access_mode"

    gosub Print_Clk_Info_Line
  )

  &match=0
  &wild_head=0
  &wild_tail=0
  &clk_input_length=STRING.LENGTH("&clk")
  &clk_itr_length=STRING.LENGTH("gpll3_dtest")

  if (STRING.SCAN("&clk", "*", 0)==0)
  (
    &wild_head=1
  )
  if (STRING.SCAN("&clk", "*", 1)==(STRING.LENGTH("&clk")-1))
  (
    &wild_tail=1
  )

  if ((&wild_head==1)&&(&wild_tail==1))
  (
    if (STRING.SCAN("gpll3_dtest", STRING.MID("&clk", 1, &clk_input_length-2), 0)!=-1)
    ( 
      &match=1
    )
  )
  else if (&wild_head==1)
  (
    if (STRING.MID("gpll3_dtest", &clk_itr_length-&clk_input_length+1, &clk_input_length-1)==STRING.CUT("&clk", 1))
    ( 
      &match=1
    )
  )
  else if (&wild_tail==1)
  (
    if (STRING.MID("gpll3_dtest", 0, &clk_input_length-1)==STRING.CUT("&clk", -1))
    ( 
      &match=1
    )
  )
  else if ("gpll3_dtest"=="&clk")
  (
    &match=1
  )
  
  if (&match==1)
  (
    &clk_test=&CLK_TEST_GPLL3_DTEST
    &clk_reg=0
    &clk_reg_name="No CBCR"
    &clk_name="gpll3_dtest"
    &clk_reg_cbcr_type=""
    &clk_vote_bit=-1.
    &clk_multiplier=4.
    &clk_access_mode="&GCC_access_mode"

    gosub Print_Clk_Info_Line
  )

  &match=0
  &wild_head=0
  &wild_tail=0
  &clk_input_length=STRING.LENGTH("&clk")
  &clk_itr_length=STRING.LENGTH("gpll3_lock_det")

  if (STRING.SCAN("&clk", "*", 0)==0)
  (
    &wild_head=1
  )
  if (STRING.SCAN("&clk", "*", 1)==(STRING.LENGTH("&clk")-1))
  (
    &wild_tail=1
  )

  if ((&wild_head==1)&&(&wild_tail==1))
  (
    if (STRING.SCAN("gpll3_lock_det", STRING.MID("&clk", 1, &clk_input_length-2), 0)!=-1)
    ( 
      &match=1
    )
  )
  else if (&wild_head==1)
  (
    if (STRING.MID("gpll3_lock_det", &clk_itr_length-&clk_input_length+1, &clk_input_length-1)==STRING.CUT("&clk", 1))
    ( 
      &match=1
    )
  )
  else if (&wild_tail==1)
  (
    if (STRING.MID("gpll3_lock_det", 0, &clk_input_length-1)==STRING.CUT("&clk", -1))
    ( 
      &match=1
    )
  )
  else if ("gpll3_lock_det"=="&clk")
  (
    &match=1
  )
  
  if (&match==1)
  (
    &clk_test=&CLK_TEST_GPLL3_LOCK_DET
    &clk_reg=0
    &clk_reg_name="No CBCR"
    &clk_name="gpll3_lock_det"
    &clk_reg_cbcr_type=""
    &clk_vote_bit=-1.
    &clk_multiplier=4.
    &clk_access_mode="&GCC_access_mode"

    gosub Print_Clk_Info_Line
  )

  &match=0
  &wild_head=0
  &wild_tail=0
  &clk_input_length=STRING.LENGTH("&clk")
  &clk_itr_length=STRING.LENGTH("gpll4_dtest")

  if (STRING.SCAN("&clk", "*", 0)==0)
  (
    &wild_head=1
  )
  if (STRING.SCAN("&clk", "*", 1)==(STRING.LENGTH("&clk")-1))
  (
    &wild_tail=1
  )

  if ((&wild_head==1)&&(&wild_tail==1))
  (
    if (STRING.SCAN("gpll4_dtest", STRING.MID("&clk", 1, &clk_input_length-2), 0)!=-1)
    ( 
      &match=1
    )
  )
  else if (&wild_head==1)
  (
    if (STRING.MID("gpll4_dtest", &clk_itr_length-&clk_input_length+1, &clk_input_length-1)==STRING.CUT("&clk", 1))
    ( 
      &match=1
    )
  )
  else if (&wild_tail==1)
  (
    if (STRING.MID("gpll4_dtest", 0, &clk_input_length-1)==STRING.CUT("&clk", -1))
    ( 
      &match=1
    )
  )
  else if ("gpll4_dtest"=="&clk")
  (
    &match=1
  )
  
  if (&match==1)
  (
    &clk_test=&CLK_TEST_GPLL4_DTEST
    &clk_reg=0
    &clk_reg_name="No CBCR"
    &clk_name="gpll4_dtest"
    &clk_reg_cbcr_type=""
    &clk_vote_bit=-1.
    &clk_multiplier=4.
    &clk_access_mode="&GCC_access_mode"

    gosub Print_Clk_Info_Line
  )

  &match=0
  &wild_head=0
  &wild_tail=0
  &clk_input_length=STRING.LENGTH("&clk")
  &clk_itr_length=STRING.LENGTH("gpll4_lock_det")

  if (STRING.SCAN("&clk", "*", 0)==0)
  (
    &wild_head=1
  )
  if (STRING.SCAN("&clk", "*", 1)==(STRING.LENGTH("&clk")-1))
  (
    &wild_tail=1
  )

  if ((&wild_head==1)&&(&wild_tail==1))
  (
    if (STRING.SCAN("gpll4_lock_det", STRING.MID("&clk", 1, &clk_input_length-2), 0)!=-1)
    ( 
      &match=1
    )
  )
  else if (&wild_head==1)
  (
    if (STRING.MID("gpll4_lock_det", &clk_itr_length-&clk_input_length+1, &clk_input_length-1)==STRING.CUT("&clk", 1))
    ( 
      &match=1
    )
  )
  else if (&wild_tail==1)
  (
    if (STRING.MID("gpll4_lock_det", 0, &clk_input_length-1)==STRING.CUT("&clk", -1))
    ( 
      &match=1
    )
  )
  else if ("gpll4_lock_det"=="&clk")
  (
    &match=1
  )
  
  if (&match==1)
  (
    &clk_test=&CLK_TEST_GPLL4_LOCK_DET
    &clk_reg=0
    &clk_reg_name="No CBCR"
    &clk_name="gpll4_lock_det"
    &clk_reg_cbcr_type=""
    &clk_vote_bit=-1.
    &clk_multiplier=4.
    &clk_access_mode="&GCC_access_mode"

    gosub Print_Clk_Info_Line
  )

  &match=0
  &wild_head=0
  &wild_tail=0
  &clk_input_length=STRING.LENGTH("&clk")
  &clk_itr_length=STRING.LENGTH("gpll5_dtest")

  if (STRING.SCAN("&clk", "*", 0)==0)
  (
    &wild_head=1
  )
  if (STRING.SCAN("&clk", "*", 1)==(STRING.LENGTH("&clk")-1))
  (
    &wild_tail=1
  )

  if ((&wild_head==1)&&(&wild_tail==1))
  (
    if (STRING.SCAN("gpll5_dtest", STRING.MID("&clk", 1, &clk_input_length-2), 0)!=-1)
    ( 
      &match=1
    )
  )
  else if (&wild_head==1)
  (
    if (STRING.MID("gpll5_dtest", &clk_itr_length-&clk_input_length+1, &clk_input_length-1)==STRING.CUT("&clk", 1))
    ( 
      &match=1
    )
  )
  else if (&wild_tail==1)
  (
    if (STRING.MID("gpll5_dtest", 0, &clk_input_length-1)==STRING.CUT("&clk", -1))
    ( 
      &match=1
    )
  )
  else if ("gpll5_dtest"=="&clk")
  (
    &match=1
  )
  
  if (&match==1)
  (
    &clk_test=&CLK_TEST_GPLL5_DTEST
    &clk_reg=0
    &clk_reg_name="No CBCR"
    &clk_name="gpll5_dtest"
    &clk_reg_cbcr_type=""
    &clk_vote_bit=-1.
    &clk_multiplier=4.
    &clk_access_mode="&GCC_access_mode"

    gosub Print_Clk_Info_Line
  )

  &match=0
  &wild_head=0
  &wild_tail=0
  &clk_input_length=STRING.LENGTH("&clk")
  &clk_itr_length=STRING.LENGTH("gpll5_lock_det")

  if (STRING.SCAN("&clk", "*", 0)==0)
  (
    &wild_head=1
  )
  if (STRING.SCAN("&clk", "*", 1)==(STRING.LENGTH("&clk")-1))
  (
    &wild_tail=1
  )

  if ((&wild_head==1)&&(&wild_tail==1))
  (
    if (STRING.SCAN("gpll5_lock_det", STRING.MID("&clk", 1, &clk_input_length-2), 0)!=-1)
    ( 
      &match=1
    )
  )
  else if (&wild_head==1)
  (
    if (STRING.MID("gpll5_lock_det", &clk_itr_length-&clk_input_length+1, &clk_input_length-1)==STRING.CUT("&clk", 1))
    ( 
      &match=1
    )
  )
  else if (&wild_tail==1)
  (
    if (STRING.MID("gpll5_lock_det", 0, &clk_input_length-1)==STRING.CUT("&clk", -1))
    ( 
      &match=1
    )
  )
  else if ("gpll5_lock_det"=="&clk")
  (
    &match=1
  )
  
  if (&match==1)
  (
    &clk_test=&CLK_TEST_GPLL5_LOCK_DET
    &clk_reg=0
    &clk_reg_name="No CBCR"
    &clk_name="gpll5_lock_det"
    &clk_reg_cbcr_type=""
    &clk_vote_bit=-1.
    &clk_multiplier=4.
    &clk_access_mode="&GCC_access_mode"

    gosub Print_Clk_Info_Line
  )

  &match=0
  &wild_head=0
  &wild_tail=0
  &clk_input_length=STRING.LENGTH("&clk")
  &clk_itr_length=STRING.LENGTH("gpll6_dtest")

  if (STRING.SCAN("&clk", "*", 0)==0)
  (
    &wild_head=1
  )
  if (STRING.SCAN("&clk", "*", 1)==(STRING.LENGTH("&clk")-1))
  (
    &wild_tail=1
  )

  if ((&wild_head==1)&&(&wild_tail==1))
  (
    if (STRING.SCAN("gpll6_dtest", STRING.MID("&clk", 1, &clk_input_length-2), 0)!=-1)
    ( 
      &match=1
    )
  )
  else if (&wild_head==1)
  (
    if (STRING.MID("gpll6_dtest", &clk_itr_length-&clk_input_length+1, &clk_input_length-1)==STRING.CUT("&clk", 1))
    ( 
      &match=1
    )
  )
  else if (&wild_tail==1)
  (
    if (STRING.MID("gpll6_dtest", 0, &clk_input_length-1)==STRING.CUT("&clk", -1))
    ( 
      &match=1
    )
  )
  else if ("gpll6_dtest"=="&clk")
  (
    &match=1
  )
  
  if (&match==1)
  (
    &clk_test=&CLK_TEST_GPLL6_DTEST
    &clk_reg=0
    &clk_reg_name="No CBCR"
    &clk_name="gpll6_dtest"
    &clk_reg_cbcr_type=""
    &clk_vote_bit=-1.
    &clk_multiplier=4.
    &clk_access_mode="&GCC_access_mode"

    gosub Print_Clk_Info_Line
  )

  &match=0
  &wild_head=0
  &wild_tail=0
  &clk_input_length=STRING.LENGTH("&clk")
  &clk_itr_length=STRING.LENGTH("gpll6_lock_det")

  if (STRING.SCAN("&clk", "*", 0)==0)
  (
    &wild_head=1
  )
  if (STRING.SCAN("&clk", "*", 1)==(STRING.LENGTH("&clk")-1))
  (
    &wild_tail=1
  )

  if ((&wild_head==1)&&(&wild_tail==1))
  (
    if (STRING.SCAN("gpll6_lock_det", STRING.MID("&clk", 1, &clk_input_length-2), 0)!=-1)
    ( 
      &match=1
    )
  )
  else if (&wild_head==1)
  (
    if (STRING.MID("gpll6_lock_det", &clk_itr_length-&clk_input_length+1, &clk_input_length-1)==STRING.CUT("&clk", 1))
    ( 
      &match=1
    )
  )
  else if (&wild_tail==1)
  (
    if (STRING.MID("gpll6_lock_det", 0, &clk_input_length-1)==STRING.CUT("&clk", -1))
    ( 
      &match=1
    )
  )
  else if ("gpll6_lock_det"=="&clk")
  (
    &match=1
  )
  
  if (&match==1)
  (
    &clk_test=&CLK_TEST_GPLL6_LOCK_DET
    &clk_reg=0
    &clk_reg_name="No CBCR"
    &clk_name="gpll6_lock_det"
    &clk_reg_cbcr_type=""
    &clk_vote_bit=-1.
    &clk_multiplier=4.
    &clk_access_mode="&GCC_access_mode"

    gosub Print_Clk_Info_Line
  )

  &match=0
  &wild_head=0
  &wild_tail=0
  &clk_input_length=STRING.LENGTH("&clk")
  &clk_itr_length=STRING.LENGTH("lpass_gcc_dbg_clk")

  if (STRING.SCAN("&clk", "*", 0)==0)
  (
    &wild_head=1
  )
  if (STRING.SCAN("&clk", "*", 1)==(STRING.LENGTH("&clk")-1))
  (
    &wild_tail=1
  )

  if ((&wild_head==1)&&(&wild_tail==1))
  (
    if (STRING.SCAN("lpass_gcc_dbg_clk", STRING.MID("&clk", 1, &clk_input_length-2), 0)!=-1)
    ( 
      &match=1
    )
  )
  else if (&wild_head==1)
  (
    if (STRING.MID("lpass_gcc_dbg_clk", &clk_itr_length-&clk_input_length+1, &clk_input_length-1)==STRING.CUT("&clk", 1))
    ( 
      &match=1
    )
  )
  else if (&wild_tail==1)
  (
    if (STRING.MID("lpass_gcc_dbg_clk", 0, &clk_input_length-1)==STRING.CUT("&clk", -1))
    ( 
      &match=1
    )
  )
  else if ("lpass_gcc_dbg_clk"=="&clk")
  (
    &match=1
  )
  
  if (&match==1)
  (
    &clk_test=&CLK_TEST_LPASS_GCC_DBG_CLK
    &clk_reg=0
    &clk_reg_name="No CBCR"
    &clk_name="lpass_gcc_dbg_clk"
    &clk_reg_cbcr_type=""
    &clk_vote_bit=-1.
    &clk_multiplier=4.
    &clk_access_mode="&GCC_access_mode"

    gosub Print_Clk_Info_Line
  )

  &match=0
  &wild_head=0
  &wild_tail=0
  &clk_input_length=STRING.LENGTH("&clk")
  &clk_itr_length=STRING.LENGTH("mpm_gcc_temp_sensor_ringosc_clk")

  if (STRING.SCAN("&clk", "*", 0)==0)
  (
    &wild_head=1
  )
  if (STRING.SCAN("&clk", "*", 1)==(STRING.LENGTH("&clk")-1))
  (
    &wild_tail=1
  )

  if ((&wild_head==1)&&(&wild_tail==1))
  (
    if (STRING.SCAN("mpm_gcc_temp_sensor_ringosc_clk", STRING.MID("&clk", 1, &clk_input_length-2), 0)!=-1)
    ( 
      &match=1
    )
  )
  else if (&wild_head==1)
  (
    if (STRING.MID("mpm_gcc_temp_sensor_ringosc_clk", &clk_itr_length-&clk_input_length+1, &clk_input_length-1)==STRING.CUT("&clk", 1))
    ( 
      &match=1
    )
  )
  else if (&wild_tail==1)
  (
    if (STRING.MID("mpm_gcc_temp_sensor_ringosc_clk", 0, &clk_input_length-1)==STRING.CUT("&clk", -1))
    ( 
      &match=1
    )
  )
  else if ("mpm_gcc_temp_sensor_ringosc_clk"=="&clk")
  (
    &match=1
  )
  
  if (&match==1)
  (
    &clk_test=&CLK_TEST_MPM_GCC_TEMP_SENSOR_RINGOSC_CLK
    &clk_reg=0
    &clk_reg_name="No CBCR"
    &clk_name="mpm_gcc_temp_sensor_ringosc_clk"
    &clk_reg_cbcr_type=""
    &clk_vote_bit=-1.
    &clk_multiplier=4.
    &clk_access_mode="&GCC_access_mode"

    gosub Print_Clk_Info_Line
  )

  &match=0
  &wild_head=0
  &wild_tail=0
  &clk_input_length=STRING.LENGTH("&clk")
  &clk_itr_length=STRING.LENGTH("pcie_0_pipe_clk")

  if (STRING.SCAN("&clk", "*", 0)==0)
  (
    &wild_head=1
  )
  if (STRING.SCAN("&clk", "*", 1)==(STRING.LENGTH("&clk")-1))
  (
    &wild_tail=1
  )

  if ((&wild_head==1)&&(&wild_tail==1))
  (
    if (STRING.SCAN("pcie_0_pipe_clk", STRING.MID("&clk", 1, &clk_input_length-2), 0)!=-1)
    ( 
      &match=1
    )
  )
  else if (&wild_head==1)
  (
    if (STRING.MID("pcie_0_pipe_clk", &clk_itr_length-&clk_input_length+1, &clk_input_length-1)==STRING.CUT("&clk", 1))
    ( 
      &match=1
    )
  )
  else if (&wild_tail==1)
  (
    if (STRING.MID("pcie_0_pipe_clk", 0, &clk_input_length-1)==STRING.CUT("&clk", -1))
    ( 
      &match=1
    )
  )
  else if ("pcie_0_pipe_clk"=="&clk")
  (
    &match=1
  )
  
  if (&match==1)
  (
    &clk_test=&CLK_TEST_PCIE_0_PIPE_CLK
    &clk_reg=0
    &clk_reg_name="No CBCR"
    &clk_name="pcie_0_pipe_clk"
    &clk_reg_cbcr_type=""
    &clk_vote_bit=-1.
    &clk_multiplier=4.
    &clk_access_mode="&GCC_access_mode"

    gosub Print_Clk_Info_Line
  )

  &match=0
  &wild_head=0
  &wild_tail=0
  &clk_input_length=STRING.LENGTH("&clk")
  &clk_itr_length=STRING.LENGTH("usb2_phy_gcc_atest_ulpi_0_clk")

  if (STRING.SCAN("&clk", "*", 0)==0)
  (
    &wild_head=1
  )
  if (STRING.SCAN("&clk", "*", 1)==(STRING.LENGTH("&clk")-1))
  (
    &wild_tail=1
  )

  if ((&wild_head==1)&&(&wild_tail==1))
  (
    if (STRING.SCAN("usb2_phy_gcc_atest_ulpi_0_clk", STRING.MID("&clk", 1, &clk_input_length-2), 0)!=-1)
    ( 
      &match=1
    )
  )
  else if (&wild_head==1)
  (
    if (STRING.MID("usb2_phy_gcc_atest_ulpi_0_clk", &clk_itr_length-&clk_input_length+1, &clk_input_length-1)==STRING.CUT("&clk", 1))
    ( 
      &match=1
    )
  )
  else if (&wild_tail==1)
  (
    if (STRING.MID("usb2_phy_gcc_atest_ulpi_0_clk", 0, &clk_input_length-1)==STRING.CUT("&clk", -1))
    ( 
      &match=1
    )
  )
  else if ("usb2_phy_gcc_atest_ulpi_0_clk"=="&clk")
  (
    &match=1
  )
  
  if (&match==1)
  (
    &clk_test=&CLK_TEST_USB2_PHY_GCC_ATEST_ULPI_0_CLK
    &clk_reg=0
    &clk_reg_name="No CBCR"
    &clk_name="usb2_phy_gcc_atest_ulpi_0_clk"
    &clk_reg_cbcr_type=""
    &clk_vote_bit=-1.
    &clk_multiplier=4.
    &clk_access_mode="&GCC_access_mode"

    gosub Print_Clk_Info_Line
  )

  &match=0
  &wild_head=0
  &wild_tail=0
  &clk_input_length=STRING.LENGTH("&clk")
  &clk_itr_length=STRING.LENGTH("usb2_phy_gcc_atest_ulpi_1_clk")

  if (STRING.SCAN("&clk", "*", 0)==0)
  (
    &wild_head=1
  )
  if (STRING.SCAN("&clk", "*", 1)==(STRING.LENGTH("&clk")-1))
  (
    &wild_tail=1
  )

  if ((&wild_head==1)&&(&wild_tail==1))
  (
    if (STRING.SCAN("usb2_phy_gcc_atest_ulpi_1_clk", STRING.MID("&clk", 1, &clk_input_length-2), 0)!=-1)
    ( 
      &match=1
    )
  )
  else if (&wild_head==1)
  (
    if (STRING.MID("usb2_phy_gcc_atest_ulpi_1_clk", &clk_itr_length-&clk_input_length+1, &clk_input_length-1)==STRING.CUT("&clk", 1))
    ( 
      &match=1
    )
  )
  else if (&wild_tail==1)
  (
    if (STRING.MID("usb2_phy_gcc_atest_ulpi_1_clk", 0, &clk_input_length-1)==STRING.CUT("&clk", -1))
    ( 
      &match=1
    )
  )
  else if ("usb2_phy_gcc_atest_ulpi_1_clk"=="&clk")
  (
    &match=1
  )
  
  if (&match==1)
  (
    &clk_test=&CLK_TEST_USB2_PHY_GCC_ATEST_ULPI_1_CLK
    &clk_reg=0
    &clk_reg_name="No CBCR"
    &clk_name="usb2_phy_gcc_atest_ulpi_1_clk"
    &clk_reg_cbcr_type=""
    &clk_vote_bit=-1.
    &clk_multiplier=4.
    &clk_access_mode="&GCC_access_mode"

    gosub Print_Clk_Info_Line
  )

  &match=0
  &wild_head=0
  &wild_tail=0
  &clk_input_length=STRING.LENGTH("&clk")
  &clk_itr_length=STRING.LENGTH("wcss_gcc_dbg_clk")

  if (STRING.SCAN("&clk", "*", 0)==0)
  (
    &wild_head=1
  )
  if (STRING.SCAN("&clk", "*", 1)==(STRING.LENGTH("&clk")-1))
  (
    &wild_tail=1
  )

  if ((&wild_head==1)&&(&wild_tail==1))
  (
    if (STRING.SCAN("wcss_gcc_dbg_clk", STRING.MID("&clk", 1, &clk_input_length-2), 0)!=-1)
    ( 
      &match=1
    )
  )
  else if (&wild_head==1)
  (
    if (STRING.MID("wcss_gcc_dbg_clk", &clk_itr_length-&clk_input_length+1, &clk_input_length-1)==STRING.CUT("&clk", 1))
    ( 
      &match=1
    )
  )
  else if (&wild_tail==1)
  (
    if (STRING.MID("wcss_gcc_dbg_clk", 0, &clk_input_length-1)==STRING.CUT("&clk", -1))
    ( 
      &match=1
    )
  )
  else if ("wcss_gcc_dbg_clk"=="&clk")
  (
    &match=1
  )
  
  if (&match==1)
  (
    &clk_test=&CLK_TEST_WCSS_GCC_DBG_CLK
    &clk_reg=0
    &clk_reg_name="No CBCR"
    &clk_name="wcss_gcc_dbg_clk"
    &clk_reg_cbcr_type=""
    &clk_vote_bit=-1.
    &clk_multiplier=4.
    &clk_access_mode="&GCC_access_mode"

    gosub Print_Clk_Info_Line
  )


  return



;-----------------------------------------------------------------------------
; Set appropriate mux settings for configurable clocks 
;-----------------------------------------------------------------------------

Set_Clock_Freq_Enter:

  ; Return for now. Need to figure out a way to map source to HW.
  return

  if ("&clk"=="gcc_sec_ctrl_acc_clk")
  (
    gosub PRINT_SET_CLOCK_FREQ_WARNING

    &clk_cmd_rcgr_addr=&HWIO_GCC_ACC_CMD_RCGR_ADDR
    &clk_cfg_rcgr_addr=&HWIO_GCC_ACC_CFG_RCGR_ADDR

    print "Choose frequency (MHz) from list below: " 

    print "9.6            19.2           100.0          " 
    print "200.0          " 

    print " "
    print "Enter desired frequency (r to return): "
    enter &clk_desired_freq
    print " "

    if ("&clk_desired_freq"=="9.6")
    (
      &clk_src_name="XO"
      &clk_src_sel=SRC_SEL TODO.
      &clk_src_div=4.
      &clk_m_val=0.
      &clk_n_val=0.
      &clk_2d_val=0.
      
      gosub Set_Clock_Freq
      return
    )
    else if ("&clk_desired_freq"=="19.2")
    (
      &clk_src_name="XO"
      &clk_src_sel=SRC_SEL TODO.
      &clk_src_div=2.
      &clk_m_val=0.
      &clk_n_val=0.
      &clk_2d_val=0.
      
      gosub Set_Clock_Freq
      return
    )
    else if ("&clk_desired_freq"=="100.0")
    (
      &clk_src_name="GPLL0_OUT_MAIN"
      &clk_src_sel=SRC_SEL TODO.
      &clk_src_div=16.
      &clk_m_val=0.
      &clk_n_val=0.
      &clk_2d_val=0.
      
      gosub Set_Clock_Freq
      return
    )
    else if ("&clk_desired_freq"=="200.0")
    (
      &clk_src_name="GPLL0_OUT_MAIN"
      &clk_src_sel=SRC_SEL TODO.
      &clk_src_div=8.
      &clk_m_val=0.
      &clk_n_val=0.
      &clk_2d_val=0.
      
      gosub Set_Clock_Freq
      return
    )
    else if ("&clk_desired_freq"=="r")
    (
      return
    )
    else
    (
      print "Invalid selection."
      goto Set_Clock_Freq_Enter
    )
  )

  if ("&clk"=="gcc_apss_ahb_clk")||("&clk"=="gcc_snoc_bus_timeout0_ahb_clk")||("&clk"=="gcc_sys_noc_apss_ahb_clk")
  (
    gosub PRINT_SET_CLOCK_FREQ_WARNING

    &clk_cmd_rcgr_addr=&HWIO_GCC_APSS_AHB_CMD_RCGR_ADDR
    &clk_cfg_rcgr_addr=&HWIO_GCC_APSS_AHB_CFG_RCGR_ADDR

    print "Choose frequency (MHz) from list below: " 

    print "19.2           50.0           100.0          " 
    print "133.333333     " 

    print " "
    print "Enter desired frequency (r to return): "
    enter &clk_desired_freq
    print " "

    if ("&clk_desired_freq"=="19.2")
    (
      &clk_src_name="XO"
      &clk_src_sel=SRC_SEL TODO.
      &clk_src_div=2.
      &clk_m_val=0.
      &clk_n_val=0.
      &clk_2d_val=0.
      
      gosub Set_Clock_Freq
      return
    )
    else if ("&clk_desired_freq"=="50.0")
    (
      &clk_src_name="GPLL0_OUT_MAIN"
      &clk_src_sel=SRC_SEL TODO.
      &clk_src_div=32.
      &clk_m_val=0.
      &clk_n_val=0.
      &clk_2d_val=0.
      
      gosub Set_Clock_Freq
      return
    )
    else if ("&clk_desired_freq"=="100.0")
    (
      &clk_src_name="GPLL0_OUT_MAIN"
      &clk_src_sel=SRC_SEL TODO.
      &clk_src_div=16.
      &clk_m_val=0.
      &clk_n_val=0.
      &clk_2d_val=0.
      
      gosub Set_Clock_Freq
      return
    )
    else if ("&clk_desired_freq"=="133.333333")
    (
      &clk_src_name="GPLL0_OUT_MAIN"
      &clk_src_sel=SRC_SEL TODO.
      &clk_src_div=12.
      &clk_m_val=0.
      &clk_n_val=0.
      &clk_2d_val=0.
      
      gosub Set_Clock_Freq
      return
    )
    else if ("&clk_desired_freq"=="r")
    (
      return
    )
    else
    (
      print "Invalid selection."
      goto Set_Clock_Freq_Enter
    )
  )

  if ("&clk"=="gcc_apss_axi_clk")||("&clk"=="gcc_bimc_apss_axi_clk")
  (
    gosub PRINT_SET_CLOCK_FREQ_WARNING

    &clk_cmd_rcgr_addr=&HWIO_GCC_APSS_AXI_CMD_RCGR_ADDR
    &clk_cfg_rcgr_addr=&HWIO_GCC_APSS_AXI_CFG_RCGR_ADDR

    print "Choose frequency (MHz) from list below: " 

    print "19.2           200.0          400.0          " 
    print "540.0          " 

    print " "
    print "Enter desired frequency (r to return): "
    enter &clk_desired_freq
    print " "

    if ("&clk_desired_freq"=="19.2")
    (
      &clk_src_name="XO"
      &clk_src_sel=SRC_SEL TODO.
      &clk_src_div=2.
      &clk_m_val=0.
      &clk_n_val=0.
      &clk_2d_val=0.
      
      gosub Set_Clock_Freq
      return
    )
    else if ("&clk_desired_freq"=="200.0")
    (
      &clk_src_name="GPLL0_OUT_MAIN"
      &clk_src_sel=SRC_SEL TODO.
      &clk_src_div=8.
      &clk_m_val=0.
      &clk_n_val=0.
      &clk_2d_val=0.
      
      gosub Set_Clock_Freq
      return
    )
    else if ("&clk_desired_freq"=="400.0")
    (
      &clk_src_name="GPLL0_OUT_MAIN"
      &clk_src_sel=SRC_SEL TODO.
      &clk_src_div=4.
      &clk_m_val=0.
      &clk_n_val=0.
      &clk_2d_val=0.
      
      gosub Set_Clock_Freq
      return
    )
    else if ("&clk_desired_freq"=="540.0")
    (
      &clk_src_name="GPLL6_OUT_MAIN"
      &clk_src_sel=SRC_SEL TODO.
      &clk_src_div=4.
      &clk_m_val=0.
      &clk_n_val=0.
      &clk_2d_val=0.
      
      gosub Set_Clock_Freq
      return
    )
    else if ("&clk_desired_freq"=="r")
    (
      return
    )
    else
    (
      print "Invalid selection."
      goto Set_Clock_Freq_Enter
    )
  )

  if ("&clk"=="gcc_apss_tcu_async_clk")||("&clk"=="gcc_bimc_apss_tcu_clk")
  (
    gosub PRINT_SET_CLOCK_FREQ_WARNING

    &clk_cmd_rcgr_addr=&HWIO_GCC_APSS_TCU_CMD_RCGR_ADDR
    &clk_cfg_rcgr_addr=&HWIO_GCC_APSS_TCU_CFG_RCGR_ADDR

    print "Choose frequency (MHz) from list below: " 

    print "19.2           160.0          320.0          " 
    print "432.0          " 

    print " "
    print "Enter desired frequency (r to return): "
    enter &clk_desired_freq
    print " "

    if ("&clk_desired_freq"=="19.2")
    (
      &clk_src_name="XO"
      &clk_src_sel=SRC_SEL TODO.
      &clk_src_div=2.
      &clk_m_val=0.
      &clk_n_val=0.
      &clk_2d_val=0.
      
      gosub Set_Clock_Freq
      return
    )
    else if ("&clk_desired_freq"=="160.0")
    (
      &clk_src_name="GPLL0_OUT_MAIN"
      &clk_src_sel=SRC_SEL TODO.
      &clk_src_div=10.
      &clk_m_val=0.
      &clk_n_val=0.
      &clk_2d_val=0.
      
      gosub Set_Clock_Freq
      return
    )
    else if ("&clk_desired_freq"=="320.0")
    (
      &clk_src_name="GPLL0_OUT_MAIN"
      &clk_src_sel=SRC_SEL TODO.
      &clk_src_div=5.
      &clk_m_val=0.
      &clk_n_val=0.
      &clk_2d_val=0.
      
      gosub Set_Clock_Freq
      return
    )
    else if ("&clk_desired_freq"=="432.0")
    (
      &clk_src_name="GPLL6_OUT_MAIN"
      &clk_src_sel=SRC_SEL TODO.
      &clk_src_div=5.
      &clk_m_val=0.
      &clk_n_val=0.
      &clk_2d_val=0.
      
      gosub Set_Clock_Freq
      return
    )
    else if ("&clk_desired_freq"=="r")
    (
      return
    )
    else
    (
      print "Invalid selection."
      goto Set_Clock_Freq_Enter
    )
  )

  if ("&clk"=="gcc_bimc_clk")||("&clk"=="gcc_debug_mux")||("&clk"=="gcc_spdm_bimc_cy_clk")||("&clk"=="gcc_spdm_debug_cy_clk")
  (
    gosub PRINT_SET_CLOCK_FREQ_WARNING

    &clk_cmd_rcgr_addr=&HWIO_GCC_BIMC_DDR_CMD_RCGR_ADDR
    &clk_cfg_rcgr_addr=&HWIO_GCC_BIMC_DDR_CFG_RCGR_ADDR

    print "Choose frequency (MHz) from list below: " 

    print "19.2           201.6          422.4          " 
    print "595.2          768.0          844.8          " 
    print "1036.8         1190.4         1344.0         " 
    print "1420.8         " 

    print " "
    print "Enter desired frequency (r to return): "
    enter &clk_desired_freq
    print " "

    if ("&clk_desired_freq"=="19.2")
    (
      &clk_src_name="XO"
      &clk_src_sel=SRC_SEL TODO.
      &clk_src_div=2.
      &clk_m_val=0.
      &clk_n_val=0.
      &clk_2d_val=0.
      
      gosub Set_Clock_Freq
      return
    )
    else if ("&clk_desired_freq"=="201.6")
    (
      &clk_src_name="GPLL5_OUT_EARLY"
      &clk_src_sel=SRC_SEL TODO.
      &clk_src_div=8.
      &clk_m_val=0.
      &clk_n_val=0.
      &clk_2d_val=0.
      
      gosub Set_Clock_Freq
      return
    )
    else if ("&clk_desired_freq"=="422.4")
    (
      &clk_src_name="GPLL5_OUT_EARLY"
      &clk_src_sel=SRC_SEL TODO.
      &clk_src_div=2.
      &clk_m_val=0.
      &clk_n_val=0.
      &clk_2d_val=0.
      
      gosub Set_Clock_Freq
      return
    )
    else if ("&clk_desired_freq"=="595.2")
    (
      &clk_src_name="GPLL5_OUT_EARLY"
      &clk_src_sel=SRC_SEL TODO.
      &clk_src_div=2.
      &clk_m_val=0.
      &clk_n_val=0.
      &clk_2d_val=0.
      
      gosub Set_Clock_Freq
      return
    )
    else if ("&clk_desired_freq"=="768.0")
    (
      &clk_src_name="GPLL5_OUT_EARLY"
      &clk_src_sel=SRC_SEL TODO.
      &clk_src_div=2.
      &clk_m_val=0.
      &clk_n_val=0.
      &clk_2d_val=0.
      
      gosub Set_Clock_Freq
      return
    )
    else if ("&clk_desired_freq"=="844.8")
    (
      &clk_src_name="GPLL5_OUT_EARLY"
      &clk_src_sel=SRC_SEL TODO.
      &clk_src_div=2.
      &clk_m_val=0.
      &clk_n_val=0.
      &clk_2d_val=0.
      
      gosub Set_Clock_Freq
      return
    )
    else if ("&clk_desired_freq"=="1036.8")
    (
      &clk_src_name="GPLL5_OUT_EARLY"
      &clk_src_sel=SRC_SEL TODO.
      &clk_src_div=2.
      &clk_m_val=0.
      &clk_n_val=0.
      &clk_2d_val=0.
      
      gosub Set_Clock_Freq
      return
    )
    else if ("&clk_desired_freq"=="1190.4")
    (
      &clk_src_name="GPLL5_OUT_EARLY"
      &clk_src_sel=SRC_SEL TODO.
      &clk_src_div=2.
      &clk_m_val=0.
      &clk_n_val=0.
      &clk_2d_val=0.
      
      gosub Set_Clock_Freq
      return
    )
    else if ("&clk_desired_freq"=="1344.0")
    (
      &clk_src_name="GPLL5_OUT_EARLY"
      &clk_src_sel=SRC_SEL TODO.
      &clk_src_div=2.
      &clk_m_val=0.
      &clk_n_val=0.
      &clk_2d_val=0.
      
      gosub Set_Clock_Freq
      return
    )
    else if ("&clk_desired_freq"=="1420.8")
    (
      &clk_src_name="GPLL5_OUT_EARLY"
      &clk_src_sel=SRC_SEL TODO.
      &clk_src_div=2.
      &clk_m_val=0.
      &clk_n_val=0.
      &clk_2d_val=0.
      
      gosub Set_Clock_Freq
      return
    )
    else if ("&clk_desired_freq"=="r")
    (
      return
    )
    else
    (
      print "Invalid selection."
      goto Set_Clock_Freq_Enter
    )
  )

  if ("&clk"=="gcc_bimc_gfx_clk")||("&clk"=="gcc_bimc_gpu_clk")||("&clk"=="gcc_gfx_tbu_clk")||("&clk"=="gcc_gfx_tcu_clk")
  (
    gosub PRINT_SET_CLOCK_FREQ_WARNING

    &clk_cmd_rcgr_addr=&HWIO_GCC_BIMC_GPU_CMD_RCGR_ADDR
    &clk_cfg_rcgr_addr=&HWIO_GCC_BIMC_GPU_CFG_RCGR_ADDR

    print "Choose frequency (MHz) from list below: " 

    print "9.6            50.4           105.6          " 
    print "148.8          192.0          211.2          " 
    print "259.2          297.6          400.0          " 

    print " "
    print "Enter desired frequency (r to return): "
    enter &clk_desired_freq
    print " "

    if ("&clk_desired_freq"=="9.6")
    (
      &clk_src_name="XO"
      &clk_src_sel=SRC_SEL TODO.
      &clk_src_div=4.
      &clk_m_val=0.
      &clk_n_val=0.
      &clk_2d_val=0.
      
      gosub Set_Clock_Freq
      return
    )
    else if ("&clk_desired_freq"=="50.4")
    (
      &clk_src_name="GPLL5_OUT_EARLY"
      &clk_src_sel=SRC_SEL TODO.
      &clk_src_div=32.
      &clk_m_val=0.
      &clk_n_val=0.
      &clk_2d_val=0.
      
      gosub Set_Clock_Freq
      return
    )
    else if ("&clk_desired_freq"=="105.6")
    (
      &clk_src_name="GPLL5_OUT_EARLY"
      &clk_src_sel=SRC_SEL TODO.
      &clk_src_div=8.
      &clk_m_val=0.
      &clk_n_val=0.
      &clk_2d_val=0.
      
      gosub Set_Clock_Freq
      return
    )
    else if ("&clk_desired_freq"=="148.8")
    (
      &clk_src_name="GPLL5_OUT_EARLY"
      &clk_src_sel=SRC_SEL TODO.
      &clk_src_div=8.
      &clk_m_val=0.
      &clk_n_val=0.
      &clk_2d_val=0.
      
      gosub Set_Clock_Freq
      return
    )
    else if ("&clk_desired_freq"=="192.0")
    (
      &clk_src_name="GPLL5_OUT_EARLY"
      &clk_src_sel=SRC_SEL TODO.
      &clk_src_div=8.
      &clk_m_val=0.
      &clk_n_val=0.
      &clk_2d_val=0.
      
      gosub Set_Clock_Freq
      return
    )
    else if ("&clk_desired_freq"=="211.2")
    (
      &clk_src_name="GPLL5_OUT_EARLY"
      &clk_src_sel=SRC_SEL TODO.
      &clk_src_div=8.
      &clk_m_val=0.
      &clk_n_val=0.
      &clk_2d_val=0.
      
      gosub Set_Clock_Freq
      return
    )
    else if ("&clk_desired_freq"=="259.2")
    (
      &clk_src_name="GPLL5_OUT_EARLY"
      &clk_src_sel=SRC_SEL TODO.
      &clk_src_div=8.
      &clk_m_val=0.
      &clk_n_val=0.
      &clk_2d_val=0.
      
      gosub Set_Clock_Freq
      return
    )
    else if ("&clk_desired_freq"=="297.6")
    (
      &clk_src_name="GPLL5_OUT_EARLY"
      &clk_src_sel=SRC_SEL TODO.
      &clk_src_div=8.
      &clk_m_val=0.
      &clk_n_val=0.
      &clk_2d_val=0.
      
      gosub Set_Clock_Freq
      return
    )
    else if ("&clk_desired_freq"=="400.0")
    (
      &clk_src_name="GPLL0_OUT_MAIN"
      &clk_src_sel=SRC_SEL TODO.
      &clk_src_div=4.
      &clk_m_val=0.
      &clk_n_val=0.
      &clk_2d_val=0.
      
      gosub Set_Clock_Freq
      return
    )
    else if ("&clk_desired_freq"=="r")
    (
      return
    )
    else
    (
      print "Invalid selection."
      goto Set_Clock_Freq_Enter
    )
  )

  if ("&clk"=="gcc_blsp1_qup0_i2c_apps_clk")
  (
    gosub PRINT_SET_CLOCK_FREQ_WARNING

    &clk_cmd_rcgr_addr=&HWIO_GCC_BLSP1_QUP0_I2C_APPS_CMD_RCGR_ADDR
    &clk_cfg_rcgr_addr=&HWIO_GCC_BLSP1_QUP0_I2C_APPS_CFG_RCGR_ADDR

    print "Choose frequency (MHz) from list below: " 

    print "19.2           50.0           " 

    print " "
    print "Enter desired frequency (r to return): "
    enter &clk_desired_freq
    print " "

    if ("&clk_desired_freq"=="19.2")
    (
      &clk_src_name="XO"
      &clk_src_sel=SRC_SEL TODO.
      &clk_src_div=2.
      &clk_m_val=0.
      &clk_n_val=0.
      &clk_2d_val=0.
      
      gosub Set_Clock_Freq
      return
    )
    else if ("&clk_desired_freq"=="50.0")
    (
      &clk_src_name="GPLL0_OUT_MAIN"
      &clk_src_sel=SRC_SEL TODO.
      &clk_src_div=32.
      &clk_m_val=0.
      &clk_n_val=0.
      &clk_2d_val=0.
      
      gosub Set_Clock_Freq
      return
    )
    else if ("&clk_desired_freq"=="r")
    (
      return
    )
    else
    (
      print "Invalid selection."
      goto Set_Clock_Freq_Enter
    )
  )

  if ("&clk"=="gcc_blsp1_qup0_spi_apps_clk")
  (
    gosub PRINT_SET_CLOCK_FREQ_WARNING

    &clk_cmd_rcgr_addr=&HWIO_GCC_BLSP1_QUP0_SPI_APPS_CMD_RCGR_ADDR
    &clk_cfg_rcgr_addr=&HWIO_GCC_BLSP1_QUP0_SPI_APPS_CFG_RCGR_ADDR

    print "Choose frequency (MHz) from list below: " 

    print "0.96           4.8            9.6            " 
    print "16.0           19.2           25.0           " 
    print "50.0           " 

    print " "
    print "Enter desired frequency (r to return): "
    enter &clk_desired_freq
    print " "

    if ("&clk_desired_freq"=="0.96")
    (
      &clk_src_name="XO"
      &clk_src_sel=SRC_SEL TODO.
      &clk_src_div=20.
      &clk_m_val=1.
      &clk_n_val=2.
      &clk_2d_val=2.
      
      gosub Set_Clock_Freq
      return
    )
    else if ("&clk_desired_freq"=="4.8")
    (
      &clk_src_name="XO"
      &clk_src_sel=SRC_SEL TODO.
      &clk_src_div=8.
      &clk_m_val=0.
      &clk_n_val=0.
      &clk_2d_val=0.
      
      gosub Set_Clock_Freq
      return
    )
    else if ("&clk_desired_freq"=="9.6")
    (
      &clk_src_name="XO"
      &clk_src_sel=SRC_SEL TODO.
      &clk_src_div=4.
      &clk_m_val=0.
      &clk_n_val=0.
      &clk_2d_val=0.
      
      gosub Set_Clock_Freq
      return
    )
    else if ("&clk_desired_freq"=="16.0")
    (
      &clk_src_name="GPLL0_OUT_MAIN"
      &clk_src_sel=SRC_SEL TODO.
      &clk_src_div=20.
      &clk_m_val=1.
      &clk_n_val=5.
      &clk_2d_val=5.
      
      gosub Set_Clock_Freq
      return
    )
    else if ("&clk_desired_freq"=="19.2")
    (
      &clk_src_name="XO"
      &clk_src_sel=SRC_SEL TODO.
      &clk_src_div=2.
      &clk_m_val=0.
      &clk_n_val=0.
      &clk_2d_val=0.
      
      gosub Set_Clock_Freq
      return
    )
    else if ("&clk_desired_freq"=="25.0")
    (
      &clk_src_name="GPLL0_OUT_MAIN"
      &clk_src_sel=SRC_SEL TODO.
      &clk_src_div=32.
      &clk_m_val=1.
      &clk_n_val=2.
      &clk_2d_val=2.
      
      gosub Set_Clock_Freq
      return
    )
    else if ("&clk_desired_freq"=="50.0")
    (
      &clk_src_name="GPLL0_OUT_MAIN"
      &clk_src_sel=SRC_SEL TODO.
      &clk_src_div=32.
      &clk_m_val=0.
      &clk_n_val=0.
      &clk_2d_val=0.
      
      gosub Set_Clock_Freq
      return
    )
    else if ("&clk_desired_freq"=="r")
    (
      return
    )
    else
    (
      print "Invalid selection."
      goto Set_Clock_Freq_Enter
    )
  )

  if ("&clk"=="gcc_blsp1_qup1_i2c_apps_clk")
  (
    gosub PRINT_SET_CLOCK_FREQ_WARNING

    &clk_cmd_rcgr_addr=&HWIO_GCC_BLSP1_QUP1_I2C_APPS_CMD_RCGR_ADDR
    &clk_cfg_rcgr_addr=&HWIO_GCC_BLSP1_QUP1_I2C_APPS_CFG_RCGR_ADDR

    print "Choose frequency (MHz) from list below: " 

    print "19.2           50.0           " 

    print " "
    print "Enter desired frequency (r to return): "
    enter &clk_desired_freq
    print " "

    if ("&clk_desired_freq"=="19.2")
    (
      &clk_src_name="XO"
      &clk_src_sel=SRC_SEL TODO.
      &clk_src_div=2.
      &clk_m_val=0.
      &clk_n_val=0.
      &clk_2d_val=0.
      
      gosub Set_Clock_Freq
      return
    )
    else if ("&clk_desired_freq"=="50.0")
    (
      &clk_src_name="GPLL0_OUT_MAIN"
      &clk_src_sel=SRC_SEL TODO.
      &clk_src_div=32.
      &clk_m_val=0.
      &clk_n_val=0.
      &clk_2d_val=0.
      
      gosub Set_Clock_Freq
      return
    )
    else if ("&clk_desired_freq"=="r")
    (
      return
    )
    else
    (
      print "Invalid selection."
      goto Set_Clock_Freq_Enter
    )
  )

  if ("&clk"=="gcc_blsp1_qup1_spi_apps_clk")
  (
    gosub PRINT_SET_CLOCK_FREQ_WARNING

    &clk_cmd_rcgr_addr=&HWIO_GCC_BLSP1_QUP1_SPI_APPS_CMD_RCGR_ADDR
    &clk_cfg_rcgr_addr=&HWIO_GCC_BLSP1_QUP1_SPI_APPS_CFG_RCGR_ADDR

    print "Choose frequency (MHz) from list below: " 

    print "0.96           4.8            9.6            " 
    print "16.0           19.2           25.0           " 
    print "30.0           " 

    print " "
    print "Enter desired frequency (r to return): "
    enter &clk_desired_freq
    print " "

    if ("&clk_desired_freq"=="0.96")
    (
      &clk_src_name="XO"
      &clk_src_sel=SRC_SEL TODO.
      &clk_src_div=20.
      &clk_m_val=1.
      &clk_n_val=2.
      &clk_2d_val=2.
      
      gosub Set_Clock_Freq
      return
    )
    else if ("&clk_desired_freq"=="4.8")
    (
      &clk_src_name="XO"
      &clk_src_sel=SRC_SEL TODO.
      &clk_src_div=8.
      &clk_m_val=0.
      &clk_n_val=0.
      &clk_2d_val=0.
      
      gosub Set_Clock_Freq
      return
    )
    else if ("&clk_desired_freq"=="9.6")
    (
      &clk_src_name="XO"
      &clk_src_sel=SRC_SEL TODO.
      &clk_src_div=4.
      &clk_m_val=0.
      &clk_n_val=0.
      &clk_2d_val=0.
      
      gosub Set_Clock_Freq
      return
    )
    else if ("&clk_desired_freq"=="16.0")
    (
      &clk_src_name="GPLL0_OUT_MAIN"
      &clk_src_sel=SRC_SEL TODO.
      &clk_src_div=20.
      &clk_m_val=1.
      &clk_n_val=5.
      &clk_2d_val=5.
      
      gosub Set_Clock_Freq
      return
    )
    else if ("&clk_desired_freq"=="19.2")
    (
      &clk_src_name="XO"
      &clk_src_sel=SRC_SEL TODO.
      &clk_src_div=2.
      &clk_m_val=0.
      &clk_n_val=0.
      &clk_2d_val=0.
      
      gosub Set_Clock_Freq
      return
    )
    else if ("&clk_desired_freq"=="25.0")
    (
      &clk_src_name="GPLL0_OUT_MAIN"
      &clk_src_sel=SRC_SEL TODO.
      &clk_src_div=32.
      &clk_m_val=1.
      &clk_n_val=2.
      &clk_2d_val=2.
      
      gosub Set_Clock_Freq
      return
    )
    else if ("&clk_desired_freq"=="30.0")
    (
      &clk_src_name="GPLL0_OUT_MAIN"
      &clk_src_sel=SRC_SEL TODO.
      &clk_src_div=2.
      &clk_m_val=3.
      &clk_n_val=80.
      &clk_2d_val=80.
      
      gosub Set_Clock_Freq
      return
    )
    else if ("&clk_desired_freq"=="r")
    (
      return
    )
    else
    (
      print "Invalid selection."
      goto Set_Clock_Freq_Enter
    )
  )

  if ("&clk"=="gcc_blsp1_qup2_i2c_apps_clk")
  (
    gosub PRINT_SET_CLOCK_FREQ_WARNING

    &clk_cmd_rcgr_addr=&HWIO_GCC_BLSP1_QUP2_I2C_APPS_CMD_RCGR_ADDR
    &clk_cfg_rcgr_addr=&HWIO_GCC_BLSP1_QUP2_I2C_APPS_CFG_RCGR_ADDR

    print "Choose frequency (MHz) from list below: " 

    print "19.2           50.0           " 

    print " "
    print "Enter desired frequency (r to return): "
    enter &clk_desired_freq
    print " "

    if ("&clk_desired_freq"=="19.2")
    (
      &clk_src_name="XO"
      &clk_src_sel=SRC_SEL TODO.
      &clk_src_div=2.
      &clk_m_val=0.
      &clk_n_val=0.
      &clk_2d_val=0.
      
      gosub Set_Clock_Freq
      return
    )
    else if ("&clk_desired_freq"=="50.0")
    (
      &clk_src_name="GPLL0_OUT_MAIN"
      &clk_src_sel=SRC_SEL TODO.
      &clk_src_div=32.
      &clk_m_val=0.
      &clk_n_val=0.
      &clk_2d_val=0.
      
      gosub Set_Clock_Freq
      return
    )
    else if ("&clk_desired_freq"=="r")
    (
      return
    )
    else
    (
      print "Invalid selection."
      goto Set_Clock_Freq_Enter
    )
  )

  if ("&clk"=="gcc_blsp1_qup2_spi_apps_clk")
  (
    gosub PRINT_SET_CLOCK_FREQ_WARNING

    &clk_cmd_rcgr_addr=&HWIO_GCC_BLSP1_QUP2_SPI_APPS_CMD_RCGR_ADDR
    &clk_cfg_rcgr_addr=&HWIO_GCC_BLSP1_QUP2_SPI_APPS_CFG_RCGR_ADDR

    print "Choose frequency (MHz) from list below: " 

    print "0.96           4.8            9.6            " 
    print "16.0           19.2           25.0           " 
    print "30.0           " 

    print " "
    print "Enter desired frequency (r to return): "
    enter &clk_desired_freq
    print " "

    if ("&clk_desired_freq"=="0.96")
    (
      &clk_src_name="XO"
      &clk_src_sel=SRC_SEL TODO.
      &clk_src_div=20.
      &clk_m_val=1.
      &clk_n_val=2.
      &clk_2d_val=2.
      
      gosub Set_Clock_Freq
      return
    )
    else if ("&clk_desired_freq"=="4.8")
    (
      &clk_src_name="XO"
      &clk_src_sel=SRC_SEL TODO.
      &clk_src_div=8.
      &clk_m_val=0.
      &clk_n_val=0.
      &clk_2d_val=0.
      
      gosub Set_Clock_Freq
      return
    )
    else if ("&clk_desired_freq"=="9.6")
    (
      &clk_src_name="XO"
      &clk_src_sel=SRC_SEL TODO.
      &clk_src_div=4.
      &clk_m_val=0.
      &clk_n_val=0.
      &clk_2d_val=0.
      
      gosub Set_Clock_Freq
      return
    )
    else if ("&clk_desired_freq"=="16.0")
    (
      &clk_src_name="GPLL0_OUT_MAIN"
      &clk_src_sel=SRC_SEL TODO.
      &clk_src_div=20.
      &clk_m_val=1.
      &clk_n_val=5.
      &clk_2d_val=5.
      
      gosub Set_Clock_Freq
      return
    )
    else if ("&clk_desired_freq"=="19.2")
    (
      &clk_src_name="XO"
      &clk_src_sel=SRC_SEL TODO.
      &clk_src_div=2.
      &clk_m_val=0.
      &clk_n_val=0.
      &clk_2d_val=0.
      
      gosub Set_Clock_Freq
      return
    )
    else if ("&clk_desired_freq"=="25.0")
    (
      &clk_src_name="GPLL0_OUT_MAIN"
      &clk_src_sel=SRC_SEL TODO.
      &clk_src_div=32.
      &clk_m_val=1.
      &clk_n_val=2.
      &clk_2d_val=2.
      
      gosub Set_Clock_Freq
      return
    )
    else if ("&clk_desired_freq"=="30.0")
    (
      &clk_src_name="GPLL0_OUT_MAIN"
      &clk_src_sel=SRC_SEL TODO.
      &clk_src_div=2.
      &clk_m_val=3.
      &clk_n_val=80.
      &clk_2d_val=80.
      
      gosub Set_Clock_Freq
      return
    )
    else if ("&clk_desired_freq"=="r")
    (
      return
    )
    else
    (
      print "Invalid selection."
      goto Set_Clock_Freq_Enter
    )
  )

  if ("&clk"=="gcc_blsp1_qup3_i2c_apps_clk")
  (
    gosub PRINT_SET_CLOCK_FREQ_WARNING

    &clk_cmd_rcgr_addr=&HWIO_GCC_BLSP1_QUP3_I2C_APPS_CMD_RCGR_ADDR
    &clk_cfg_rcgr_addr=&HWIO_GCC_BLSP1_QUP3_I2C_APPS_CFG_RCGR_ADDR

    print "Choose frequency (MHz) from list below: " 

    print "19.2           50.0           " 

    print " "
    print "Enter desired frequency (r to return): "
    enter &clk_desired_freq
    print " "

    if ("&clk_desired_freq"=="19.2")
    (
      &clk_src_name="XO"
      &clk_src_sel=SRC_SEL TODO.
      &clk_src_div=2.
      &clk_m_val=0.
      &clk_n_val=0.
      &clk_2d_val=0.
      
      gosub Set_Clock_Freq
      return
    )
    else if ("&clk_desired_freq"=="50.0")
    (
      &clk_src_name="GPLL0_OUT_MAIN"
      &clk_src_sel=SRC_SEL TODO.
      &clk_src_div=32.
      &clk_m_val=0.
      &clk_n_val=0.
      &clk_2d_val=0.
      
      gosub Set_Clock_Freq
      return
    )
    else if ("&clk_desired_freq"=="r")
    (
      return
    )
    else
    (
      print "Invalid selection."
      goto Set_Clock_Freq_Enter
    )
  )

  if ("&clk"=="gcc_blsp1_qup3_spi_apps_clk")
  (
    gosub PRINT_SET_CLOCK_FREQ_WARNING

    &clk_cmd_rcgr_addr=&HWIO_GCC_BLSP1_QUP3_SPI_APPS_CMD_RCGR_ADDR
    &clk_cfg_rcgr_addr=&HWIO_GCC_BLSP1_QUP3_SPI_APPS_CFG_RCGR_ADDR

    print "Choose frequency (MHz) from list below: " 

    print "0.96           4.8            9.6            " 
    print "16.0           19.2           25.0           " 
    print "50.0           " 

    print " "
    print "Enter desired frequency (r to return): "
    enter &clk_desired_freq
    print " "

    if ("&clk_desired_freq"=="0.96")
    (
      &clk_src_name="XO"
      &clk_src_sel=SRC_SEL TODO.
      &clk_src_div=20.
      &clk_m_val=1.
      &clk_n_val=2.
      &clk_2d_val=2.
      
      gosub Set_Clock_Freq
      return
    )
    else if ("&clk_desired_freq"=="4.8")
    (
      &clk_src_name="XO"
      &clk_src_sel=SRC_SEL TODO.
      &clk_src_div=8.
      &clk_m_val=0.
      &clk_n_val=0.
      &clk_2d_val=0.
      
      gosub Set_Clock_Freq
      return
    )
    else if ("&clk_desired_freq"=="9.6")
    (
      &clk_src_name="XO"
      &clk_src_sel=SRC_SEL TODO.
      &clk_src_div=4.
      &clk_m_val=0.
      &clk_n_val=0.
      &clk_2d_val=0.
      
      gosub Set_Clock_Freq
      return
    )
    else if ("&clk_desired_freq"=="16.0")
    (
      &clk_src_name="GPLL0_OUT_MAIN"
      &clk_src_sel=SRC_SEL TODO.
      &clk_src_div=20.
      &clk_m_val=1.
      &clk_n_val=5.
      &clk_2d_val=5.
      
      gosub Set_Clock_Freq
      return
    )
    else if ("&clk_desired_freq"=="19.2")
    (
      &clk_src_name="XO"
      &clk_src_sel=SRC_SEL TODO.
      &clk_src_div=2.
      &clk_m_val=0.
      &clk_n_val=0.
      &clk_2d_val=0.
      
      gosub Set_Clock_Freq
      return
    )
    else if ("&clk_desired_freq"=="25.0")
    (
      &clk_src_name="GPLL0_OUT_MAIN"
      &clk_src_sel=SRC_SEL TODO.
      &clk_src_div=32.
      &clk_m_val=1.
      &clk_n_val=2.
      &clk_2d_val=2.
      
      gosub Set_Clock_Freq
      return
    )
    else if ("&clk_desired_freq"=="50.0")
    (
      &clk_src_name="GPLL0_OUT_MAIN"
      &clk_src_sel=SRC_SEL TODO.
      &clk_src_div=32.
      &clk_m_val=0.
      &clk_n_val=0.
      &clk_2d_val=0.
      
      gosub Set_Clock_Freq
      return
    )
    else if ("&clk_desired_freq"=="r")
    (
      return
    )
    else
    (
      print "Invalid selection."
      goto Set_Clock_Freq_Enter
    )
  )

  if ("&clk"=="gcc_blsp1_qup4_i2c_apps_clk")
  (
    gosub PRINT_SET_CLOCK_FREQ_WARNING

    &clk_cmd_rcgr_addr=&HWIO_GCC_BLSP1_QUP4_I2C_APPS_CMD_RCGR_ADDR
    &clk_cfg_rcgr_addr=&HWIO_GCC_BLSP1_QUP4_I2C_APPS_CFG_RCGR_ADDR

    print "Choose frequency (MHz) from list below: " 

    print "19.2           50.0           " 

    print " "
    print "Enter desired frequency (r to return): "
    enter &clk_desired_freq
    print " "

    if ("&clk_desired_freq"=="19.2")
    (
      &clk_src_name="XO"
      &clk_src_sel=SRC_SEL TODO.
      &clk_src_div=2.
      &clk_m_val=0.
      &clk_n_val=0.
      &clk_2d_val=0.
      
      gosub Set_Clock_Freq
      return
    )
    else if ("&clk_desired_freq"=="50.0")
    (
      &clk_src_name="GPLL0_OUT_MAIN"
      &clk_src_sel=SRC_SEL TODO.
      &clk_src_div=32.
      &clk_m_val=0.
      &clk_n_val=0.
      &clk_2d_val=0.
      
      gosub Set_Clock_Freq
      return
    )
    else if ("&clk_desired_freq"=="r")
    (
      return
    )
    else
    (
      print "Invalid selection."
      goto Set_Clock_Freq_Enter
    )
  )

  if ("&clk"=="gcc_blsp1_qup4_spi_apps_clk")
  (
    gosub PRINT_SET_CLOCK_FREQ_WARNING

    &clk_cmd_rcgr_addr=&HWIO_GCC_BLSP1_QUP4_SPI_APPS_CMD_RCGR_ADDR
    &clk_cfg_rcgr_addr=&HWIO_GCC_BLSP1_QUP4_SPI_APPS_CFG_RCGR_ADDR

    print "Choose frequency (MHz) from list below: " 

    print "0.96           4.8            9.6            " 
    print "16.0           19.2           25.0           " 
    print "50.0           " 

    print " "
    print "Enter desired frequency (r to return): "
    enter &clk_desired_freq
    print " "

    if ("&clk_desired_freq"=="0.96")
    (
      &clk_src_name="XO"
      &clk_src_sel=SRC_SEL TODO.
      &clk_src_div=20.
      &clk_m_val=1.
      &clk_n_val=2.
      &clk_2d_val=2.
      
      gosub Set_Clock_Freq
      return
    )
    else if ("&clk_desired_freq"=="4.8")
    (
      &clk_src_name="XO"
      &clk_src_sel=SRC_SEL TODO.
      &clk_src_div=8.
      &clk_m_val=0.
      &clk_n_val=0.
      &clk_2d_val=0.
      
      gosub Set_Clock_Freq
      return
    )
    else if ("&clk_desired_freq"=="9.6")
    (
      &clk_src_name="XO"
      &clk_src_sel=SRC_SEL TODO.
      &clk_src_div=4.
      &clk_m_val=0.
      &clk_n_val=0.
      &clk_2d_val=0.
      
      gosub Set_Clock_Freq
      return
    )
    else if ("&clk_desired_freq"=="16.0")
    (
      &clk_src_name="GPLL0_OUT_MAIN"
      &clk_src_sel=SRC_SEL TODO.
      &clk_src_div=20.
      &clk_m_val=1.
      &clk_n_val=5.
      &clk_2d_val=5.
      
      gosub Set_Clock_Freq
      return
    )
    else if ("&clk_desired_freq"=="19.2")
    (
      &clk_src_name="XO"
      &clk_src_sel=SRC_SEL TODO.
      &clk_src_div=2.
      &clk_m_val=0.
      &clk_n_val=0.
      &clk_2d_val=0.
      
      gosub Set_Clock_Freq
      return
    )
    else if ("&clk_desired_freq"=="25.0")
    (
      &clk_src_name="GPLL0_OUT_MAIN"
      &clk_src_sel=SRC_SEL TODO.
      &clk_src_div=32.
      &clk_m_val=1.
      &clk_n_val=2.
      &clk_2d_val=2.
      
      gosub Set_Clock_Freq
      return
    )
    else if ("&clk_desired_freq"=="50.0")
    (
      &clk_src_name="GPLL0_OUT_MAIN"
      &clk_src_sel=SRC_SEL TODO.
      &clk_src_div=32.
      &clk_m_val=0.
      &clk_n_val=0.
      &clk_2d_val=0.
      
      gosub Set_Clock_Freq
      return
    )
    else if ("&clk_desired_freq"=="r")
    (
      return
    )
    else
    (
      print "Invalid selection."
      goto Set_Clock_Freq_Enter
    )
  )

  if ("&clk"=="gcc_blsp1_uart0_apps_clk")
  (
    gosub PRINT_SET_CLOCK_FREQ_WARNING

    &clk_cmd_rcgr_addr=&HWIO_GCC_BLSP1_UART0_APPS_CMD_RCGR_ADDR
    &clk_cfg_rcgr_addr=&HWIO_GCC_BLSP1_UART0_APPS_CFG_RCGR_ADDR

    print "Choose frequency (MHz) from list below: " 

    print "3.6864         7.3728         14.7456        " 
    print "16.0           19.2           24.0           " 
    print "25.0           32.0           40.0           " 
    print "46.4           48.0           51.2           " 
    print "56.0           58.9824        60.0           " 
    print "64.0           " 

    print " "
    print "Enter desired frequency (r to return): "
    enter &clk_desired_freq
    print " "

    if ("&clk_desired_freq"=="3.6864")
    (
      &clk_src_name="GPLL0_OUT_MAIN"
      &clk_src_sel=SRC_SEL TODO.
      &clk_src_div=2.
      &clk_m_val=72.
      &clk_n_val=15625.
      &clk_2d_val=15625.
      
      gosub Set_Clock_Freq
      return
    )
    else if ("&clk_desired_freq"=="7.3728")
    (
      &clk_src_name="GPLL0_OUT_MAIN"
      &clk_src_sel=SRC_SEL TODO.
      &clk_src_div=2.
      &clk_m_val=144.
      &clk_n_val=15625.
      &clk_2d_val=15625.
      
      gosub Set_Clock_Freq
      return
    )
    else if ("&clk_desired_freq"=="14.7456")
    (
      &clk_src_name="GPLL0_OUT_MAIN"
      &clk_src_sel=SRC_SEL TODO.
      &clk_src_div=2.
      &clk_m_val=288.
      &clk_n_val=15625.
      &clk_2d_val=15625.
      
      gosub Set_Clock_Freq
      return
    )
    else if ("&clk_desired_freq"=="16.0")
    (
      &clk_src_name="GPLL0_OUT_MAIN"
      &clk_src_sel=SRC_SEL TODO.
      &clk_src_div=20.
      &clk_m_val=1.
      &clk_n_val=5.
      &clk_2d_val=5.
      
      gosub Set_Clock_Freq
      return
    )
    else if ("&clk_desired_freq"=="19.2")
    (
      &clk_src_name="XO"
      &clk_src_sel=SRC_SEL TODO.
      &clk_src_div=2.
      &clk_m_val=0.
      &clk_n_val=0.
      &clk_2d_val=0.
      
      gosub Set_Clock_Freq
      return
    )
    else if ("&clk_desired_freq"=="24.0")
    (
      &clk_src_name="GPLL0_OUT_MAIN"
      &clk_src_sel=SRC_SEL TODO.
      &clk_src_div=2.
      &clk_m_val=3.
      &clk_n_val=100.
      &clk_2d_val=100.
      
      gosub Set_Clock_Freq
      return
    )
    else if ("&clk_desired_freq"=="25.0")
    (
      &clk_src_name="GPLL0_OUT_MAIN"
      &clk_src_sel=SRC_SEL TODO.
      &clk_src_div=32.
      &clk_m_val=1.
      &clk_n_val=2.
      &clk_2d_val=2.
      
      gosub Set_Clock_Freq
      return
    )
    else if ("&clk_desired_freq"=="32.0")
    (
      &clk_src_name="GPLL0_OUT_MAIN"
      &clk_src_sel=SRC_SEL TODO.
      &clk_src_div=2.
      &clk_m_val=1.
      &clk_n_val=25.
      &clk_2d_val=25.
      
      gosub Set_Clock_Freq
      return
    )
    else if ("&clk_desired_freq"=="40.0")
    (
      &clk_src_name="GPLL0_OUT_MAIN"
      &clk_src_sel=SRC_SEL TODO.
      &clk_src_div=2.
      &clk_m_val=1.
      &clk_n_val=20.
      &clk_2d_val=20.
      
      gosub Set_Clock_Freq
      return
    )
    else if ("&clk_desired_freq"=="46.4")
    (
      &clk_src_name="GPLL0_OUT_MAIN"
      &clk_src_sel=SRC_SEL TODO.
      &clk_src_div=2.
      &clk_m_val=29.
      &clk_n_val=500.
      &clk_2d_val=500.
      
      gosub Set_Clock_Freq
      return
    )
    else if ("&clk_desired_freq"=="48.0")
    (
      &clk_src_name="GPLL0_OUT_MAIN"
      &clk_src_sel=SRC_SEL TODO.
      &clk_src_div=2.
      &clk_m_val=3.
      &clk_n_val=50.
      &clk_2d_val=50.
      
      gosub Set_Clock_Freq
      return
    )
    else if ("&clk_desired_freq"=="51.2")
    (
      &clk_src_name="GPLL0_OUT_MAIN"
      &clk_src_sel=SRC_SEL TODO.
      &clk_src_div=2.
      &clk_m_val=8.
      &clk_n_val=125.
      &clk_2d_val=125.
      
      gosub Set_Clock_Freq
      return
    )
    else if ("&clk_desired_freq"=="56.0")
    (
      &clk_src_name="GPLL0_OUT_MAIN"
      &clk_src_sel=SRC_SEL TODO.
      &clk_src_div=2.
      &clk_m_val=7.
      &clk_n_val=100.
      &clk_2d_val=100.
      
      gosub Set_Clock_Freq
      return
    )
    else if ("&clk_desired_freq"=="58.9824")
    (
      &clk_src_name="GPLL0_OUT_MAIN"
      &clk_src_sel=SRC_SEL TODO.
      &clk_src_div=2.
      &clk_m_val=1152.
      &clk_n_val=15625.
      &clk_2d_val=15625.
      
      gosub Set_Clock_Freq
      return
    )
    else if ("&clk_desired_freq"=="60.0")
    (
      &clk_src_name="GPLL0_OUT_MAIN"
      &clk_src_sel=SRC_SEL TODO.
      &clk_src_div=2.
      &clk_m_val=3.
      &clk_n_val=40.
      &clk_2d_val=40.
      
      gosub Set_Clock_Freq
      return
    )
    else if ("&clk_desired_freq"=="64.0")
    (
      &clk_src_name="GPLL0_OUT_MAIN"
      &clk_src_sel=SRC_SEL TODO.
      &clk_src_div=2.
      &clk_m_val=2.
      &clk_n_val=25.
      &clk_2d_val=25.
      
      gosub Set_Clock_Freq
      return
    )
    else if ("&clk_desired_freq"=="r")
    (
      return
    )
    else
    (
      print "Invalid selection."
      goto Set_Clock_Freq_Enter
    )
  )

  if ("&clk"=="gcc_blsp1_uart1_apps_clk")
  (
    gosub PRINT_SET_CLOCK_FREQ_WARNING

    &clk_cmd_rcgr_addr=&HWIO_GCC_BLSP1_UART1_APPS_CMD_RCGR_ADDR
    &clk_cfg_rcgr_addr=&HWIO_GCC_BLSP1_UART1_APPS_CFG_RCGR_ADDR

    print "Choose frequency (MHz) from list below: " 

    print "3.6864         7.3728         14.7456        " 
    print "16.0           19.2           24.0           " 
    print "25.0           32.0           40.0           " 
    print "46.4           48.0           51.2           " 
    print "56.0           58.9824        60.0           " 
    print "64.0           " 

    print " "
    print "Enter desired frequency (r to return): "
    enter &clk_desired_freq
    print " "

    if ("&clk_desired_freq"=="3.6864")
    (
      &clk_src_name="GPLL0_OUT_MAIN"
      &clk_src_sel=SRC_SEL TODO.
      &clk_src_div=2.
      &clk_m_val=72.
      &clk_n_val=15625.
      &clk_2d_val=15625.
      
      gosub Set_Clock_Freq
      return
    )
    else if ("&clk_desired_freq"=="7.3728")
    (
      &clk_src_name="GPLL0_OUT_MAIN"
      &clk_src_sel=SRC_SEL TODO.
      &clk_src_div=2.
      &clk_m_val=144.
      &clk_n_val=15625.
      &clk_2d_val=15625.
      
      gosub Set_Clock_Freq
      return
    )
    else if ("&clk_desired_freq"=="14.7456")
    (
      &clk_src_name="GPLL0_OUT_MAIN"
      &clk_src_sel=SRC_SEL TODO.
      &clk_src_div=2.
      &clk_m_val=288.
      &clk_n_val=15625.
      &clk_2d_val=15625.
      
      gosub Set_Clock_Freq
      return
    )
    else if ("&clk_desired_freq"=="16.0")
    (
      &clk_src_name="GPLL0_OUT_MAIN"
      &clk_src_sel=SRC_SEL TODO.
      &clk_src_div=20.
      &clk_m_val=1.
      &clk_n_val=5.
      &clk_2d_val=5.
      
      gosub Set_Clock_Freq
      return
    )
    else if ("&clk_desired_freq"=="19.2")
    (
      &clk_src_name="XO"
      &clk_src_sel=SRC_SEL TODO.
      &clk_src_div=2.
      &clk_m_val=0.
      &clk_n_val=0.
      &clk_2d_val=0.
      
      gosub Set_Clock_Freq
      return
    )
    else if ("&clk_desired_freq"=="24.0")
    (
      &clk_src_name="GPLL0_OUT_MAIN"
      &clk_src_sel=SRC_SEL TODO.
      &clk_src_div=2.
      &clk_m_val=3.
      &clk_n_val=100.
      &clk_2d_val=100.
      
      gosub Set_Clock_Freq
      return
    )
    else if ("&clk_desired_freq"=="25.0")
    (
      &clk_src_name="GPLL0_OUT_MAIN"
      &clk_src_sel=SRC_SEL TODO.
      &clk_src_div=32.
      &clk_m_val=1.
      &clk_n_val=2.
      &clk_2d_val=2.
      
      gosub Set_Clock_Freq
      return
    )
    else if ("&clk_desired_freq"=="32.0")
    (
      &clk_src_name="GPLL0_OUT_MAIN"
      &clk_src_sel=SRC_SEL TODO.
      &clk_src_div=2.
      &clk_m_val=1.
      &clk_n_val=25.
      &clk_2d_val=25.
      
      gosub Set_Clock_Freq
      return
    )
    else if ("&clk_desired_freq"=="40.0")
    (
      &clk_src_name="GPLL0_OUT_MAIN"
      &clk_src_sel=SRC_SEL TODO.
      &clk_src_div=2.
      &clk_m_val=1.
      &clk_n_val=20.
      &clk_2d_val=20.
      
      gosub Set_Clock_Freq
      return
    )
    else if ("&clk_desired_freq"=="46.4")
    (
      &clk_src_name="GPLL0_OUT_MAIN"
      &clk_src_sel=SRC_SEL TODO.
      &clk_src_div=2.
      &clk_m_val=29.
      &clk_n_val=500.
      &clk_2d_val=500.
      
      gosub Set_Clock_Freq
      return
    )
    else if ("&clk_desired_freq"=="48.0")
    (
      &clk_src_name="GPLL0_OUT_MAIN"
      &clk_src_sel=SRC_SEL TODO.
      &clk_src_div=2.
      &clk_m_val=3.
      &clk_n_val=50.
      &clk_2d_val=50.
      
      gosub Set_Clock_Freq
      return
    )
    else if ("&clk_desired_freq"=="51.2")
    (
      &clk_src_name="GPLL0_OUT_MAIN"
      &clk_src_sel=SRC_SEL TODO.
      &clk_src_div=2.
      &clk_m_val=8.
      &clk_n_val=125.
      &clk_2d_val=125.
      
      gosub Set_Clock_Freq
      return
    )
    else if ("&clk_desired_freq"=="56.0")
    (
      &clk_src_name="GPLL0_OUT_MAIN"
      &clk_src_sel=SRC_SEL TODO.
      &clk_src_div=2.
      &clk_m_val=7.
      &clk_n_val=100.
      &clk_2d_val=100.
      
      gosub Set_Clock_Freq
      return
    )
    else if ("&clk_desired_freq"=="58.9824")
    (
      &clk_src_name="GPLL0_OUT_MAIN"
      &clk_src_sel=SRC_SEL TODO.
      &clk_src_div=2.
      &clk_m_val=1152.
      &clk_n_val=15625.
      &clk_2d_val=15625.
      
      gosub Set_Clock_Freq
      return
    )
    else if ("&clk_desired_freq"=="60.0")
    (
      &clk_src_name="GPLL0_OUT_MAIN"
      &clk_src_sel=SRC_SEL TODO.
      &clk_src_div=2.
      &clk_m_val=3.
      &clk_n_val=40.
      &clk_2d_val=40.
      
      gosub Set_Clock_Freq
      return
    )
    else if ("&clk_desired_freq"=="64.0")
    (
      &clk_src_name="GPLL0_OUT_MAIN"
      &clk_src_sel=SRC_SEL TODO.
      &clk_src_div=2.
      &clk_m_val=2.
      &clk_n_val=25.
      &clk_2d_val=25.
      
      gosub Set_Clock_Freq
      return
    )
    else if ("&clk_desired_freq"=="r")
    (
      return
    )
    else
    (
      print "Invalid selection."
      goto Set_Clock_Freq_Enter
    )
  )

  if ("&clk"=="gcc_blsp1_uart2_apps_clk")
  (
    gosub PRINT_SET_CLOCK_FREQ_WARNING

    &clk_cmd_rcgr_addr=&HWIO_GCC_BLSP1_UART2_APPS_CMD_RCGR_ADDR
    &clk_cfg_rcgr_addr=&HWIO_GCC_BLSP1_UART2_APPS_CFG_RCGR_ADDR

    print "Choose frequency (MHz) from list below: " 

    print "3.6864         7.3728         14.7456        " 
    print "16.0           19.2           24.0           " 
    print "25.0           32.0           40.0           " 
    print "46.4           48.0           51.2           " 
    print "56.0           58.9824        60.0           " 
    print "64.0           " 

    print " "
    print "Enter desired frequency (r to return): "
    enter &clk_desired_freq
    print " "

    if ("&clk_desired_freq"=="3.6864")
    (
      &clk_src_name="GPLL0_OUT_MAIN"
      &clk_src_sel=SRC_SEL TODO.
      &clk_src_div=2.
      &clk_m_val=72.
      &clk_n_val=15625.
      &clk_2d_val=15625.
      
      gosub Set_Clock_Freq
      return
    )
    else if ("&clk_desired_freq"=="7.3728")
    (
      &clk_src_name="GPLL0_OUT_MAIN"
      &clk_src_sel=SRC_SEL TODO.
      &clk_src_div=2.
      &clk_m_val=144.
      &clk_n_val=15625.
      &clk_2d_val=15625.
      
      gosub Set_Clock_Freq
      return
    )
    else if ("&clk_desired_freq"=="14.7456")
    (
      &clk_src_name="GPLL0_OUT_MAIN"
      &clk_src_sel=SRC_SEL TODO.
      &clk_src_div=2.
      &clk_m_val=288.
      &clk_n_val=15625.
      &clk_2d_val=15625.
      
      gosub Set_Clock_Freq
      return
    )
    else if ("&clk_desired_freq"=="16.0")
    (
      &clk_src_name="GPLL0_OUT_MAIN"
      &clk_src_sel=SRC_SEL TODO.
      &clk_src_div=20.
      &clk_m_val=1.
      &clk_n_val=5.
      &clk_2d_val=5.
      
      gosub Set_Clock_Freq
      return
    )
    else if ("&clk_desired_freq"=="19.2")
    (
      &clk_src_name="XO"
      &clk_src_sel=SRC_SEL TODO.
      &clk_src_div=2.
      &clk_m_val=0.
      &clk_n_val=0.
      &clk_2d_val=0.
      
      gosub Set_Clock_Freq
      return
    )
    else if ("&clk_desired_freq"=="24.0")
    (
      &clk_src_name="GPLL0_OUT_MAIN"
      &clk_src_sel=SRC_SEL TODO.
      &clk_src_div=2.
      &clk_m_val=3.
      &clk_n_val=100.
      &clk_2d_val=100.
      
      gosub Set_Clock_Freq
      return
    )
    else if ("&clk_desired_freq"=="25.0")
    (
      &clk_src_name="GPLL0_OUT_MAIN"
      &clk_src_sel=SRC_SEL TODO.
      &clk_src_div=32.
      &clk_m_val=1.
      &clk_n_val=2.
      &clk_2d_val=2.
      
      gosub Set_Clock_Freq
      return
    )
    else if ("&clk_desired_freq"=="32.0")
    (
      &clk_src_name="GPLL0_OUT_MAIN"
      &clk_src_sel=SRC_SEL TODO.
      &clk_src_div=2.
      &clk_m_val=1.
      &clk_n_val=25.
      &clk_2d_val=25.
      
      gosub Set_Clock_Freq
      return
    )
    else if ("&clk_desired_freq"=="40.0")
    (
      &clk_src_name="GPLL0_OUT_MAIN"
      &clk_src_sel=SRC_SEL TODO.
      &clk_src_div=2.
      &clk_m_val=1.
      &clk_n_val=20.
      &clk_2d_val=20.
      
      gosub Set_Clock_Freq
      return
    )
    else if ("&clk_desired_freq"=="46.4")
    (
      &clk_src_name="GPLL0_OUT_MAIN"
      &clk_src_sel=SRC_SEL TODO.
      &clk_src_div=2.
      &clk_m_val=29.
      &clk_n_val=500.
      &clk_2d_val=500.
      
      gosub Set_Clock_Freq
      return
    )
    else if ("&clk_desired_freq"=="48.0")
    (
      &clk_src_name="GPLL0_OUT_MAIN"
      &clk_src_sel=SRC_SEL TODO.
      &clk_src_div=2.
      &clk_m_val=3.
      &clk_n_val=50.
      &clk_2d_val=50.
      
      gosub Set_Clock_Freq
      return
    )
    else if ("&clk_desired_freq"=="51.2")
    (
      &clk_src_name="GPLL0_OUT_MAIN"
      &clk_src_sel=SRC_SEL TODO.
      &clk_src_div=2.
      &clk_m_val=8.
      &clk_n_val=125.
      &clk_2d_val=125.
      
      gosub Set_Clock_Freq
      return
    )
    else if ("&clk_desired_freq"=="56.0")
    (
      &clk_src_name="GPLL0_OUT_MAIN"
      &clk_src_sel=SRC_SEL TODO.
      &clk_src_div=2.
      &clk_m_val=7.
      &clk_n_val=100.
      &clk_2d_val=100.
      
      gosub Set_Clock_Freq
      return
    )
    else if ("&clk_desired_freq"=="58.9824")
    (
      &clk_src_name="GPLL0_OUT_MAIN"
      &clk_src_sel=SRC_SEL TODO.
      &clk_src_div=2.
      &clk_m_val=1152.
      &clk_n_val=15625.
      &clk_2d_val=15625.
      
      gosub Set_Clock_Freq
      return
    )
    else if ("&clk_desired_freq"=="60.0")
    (
      &clk_src_name="GPLL0_OUT_MAIN"
      &clk_src_sel=SRC_SEL TODO.
      &clk_src_div=2.
      &clk_m_val=3.
      &clk_n_val=40.
      &clk_2d_val=40.
      
      gosub Set_Clock_Freq
      return
    )
    else if ("&clk_desired_freq"=="64.0")
    (
      &clk_src_name="GPLL0_OUT_MAIN"
      &clk_src_sel=SRC_SEL TODO.
      &clk_src_div=2.
      &clk_m_val=2.
      &clk_n_val=25.
      &clk_2d_val=25.
      
      gosub Set_Clock_Freq
      return
    )
    else if ("&clk_desired_freq"=="r")
    (
      return
    )
    else
    (
      print "Invalid selection."
      goto Set_Clock_Freq_Enter
    )
  )

  if ("&clk"=="gcc_blsp1_uart3_apps_clk")
  (
    gosub PRINT_SET_CLOCK_FREQ_WARNING

    &clk_cmd_rcgr_addr=&HWIO_GCC_BLSP1_UART3_APPS_CMD_RCGR_ADDR
    &clk_cfg_rcgr_addr=&HWIO_GCC_BLSP1_UART3_APPS_CFG_RCGR_ADDR

    print "Choose frequency (MHz) from list below: " 

    print "3.6864         7.3728         14.7456        " 
    print "16.0           19.2           24.0           " 
    print "25.0           32.0           40.0           " 
    print "46.4           48.0           51.2           " 
    print "56.0           58.9824        60.0           " 
    print "64.0           " 

    print " "
    print "Enter desired frequency (r to return): "
    enter &clk_desired_freq
    print " "

    if ("&clk_desired_freq"=="3.6864")
    (
      &clk_src_name="GPLL0_OUT_MAIN"
      &clk_src_sel=SRC_SEL TODO.
      &clk_src_div=2.
      &clk_m_val=72.
      &clk_n_val=15625.
      &clk_2d_val=15625.
      
      gosub Set_Clock_Freq
      return
    )
    else if ("&clk_desired_freq"=="7.3728")
    (
      &clk_src_name="GPLL0_OUT_MAIN"
      &clk_src_sel=SRC_SEL TODO.
      &clk_src_div=2.
      &clk_m_val=144.
      &clk_n_val=15625.
      &clk_2d_val=15625.
      
      gosub Set_Clock_Freq
      return
    )
    else if ("&clk_desired_freq"=="14.7456")
    (
      &clk_src_name="GPLL0_OUT_MAIN"
      &clk_src_sel=SRC_SEL TODO.
      &clk_src_div=2.
      &clk_m_val=288.
      &clk_n_val=15625.
      &clk_2d_val=15625.
      
      gosub Set_Clock_Freq
      return
    )
    else if ("&clk_desired_freq"=="16.0")
    (
      &clk_src_name="GPLL0_OUT_MAIN"
      &clk_src_sel=SRC_SEL TODO.
      &clk_src_div=20.
      &clk_m_val=1.
      &clk_n_val=5.
      &clk_2d_val=5.
      
      gosub Set_Clock_Freq
      return
    )
    else if ("&clk_desired_freq"=="19.2")
    (
      &clk_src_name="XO"
      &clk_src_sel=SRC_SEL TODO.
      &clk_src_div=2.
      &clk_m_val=0.
      &clk_n_val=0.
      &clk_2d_val=0.
      
      gosub Set_Clock_Freq
      return
    )
    else if ("&clk_desired_freq"=="24.0")
    (
      &clk_src_name="GPLL0_OUT_MAIN"
      &clk_src_sel=SRC_SEL TODO.
      &clk_src_div=2.
      &clk_m_val=3.
      &clk_n_val=100.
      &clk_2d_val=100.
      
      gosub Set_Clock_Freq
      return
    )
    else if ("&clk_desired_freq"=="25.0")
    (
      &clk_src_name="GPLL0_OUT_MAIN"
      &clk_src_sel=SRC_SEL TODO.
      &clk_src_div=32.
      &clk_m_val=1.
      &clk_n_val=2.
      &clk_2d_val=2.
      
      gosub Set_Clock_Freq
      return
    )
    else if ("&clk_desired_freq"=="32.0")
    (
      &clk_src_name="GPLL0_OUT_MAIN"
      &clk_src_sel=SRC_SEL TODO.
      &clk_src_div=2.
      &clk_m_val=1.
      &clk_n_val=25.
      &clk_2d_val=25.
      
      gosub Set_Clock_Freq
      return
    )
    else if ("&clk_desired_freq"=="40.0")
    (
      &clk_src_name="GPLL0_OUT_MAIN"
      &clk_src_sel=SRC_SEL TODO.
      &clk_src_div=2.
      &clk_m_val=1.
      &clk_n_val=20.
      &clk_2d_val=20.
      
      gosub Set_Clock_Freq
      return
    )
    else if ("&clk_desired_freq"=="46.4")
    (
      &clk_src_name="GPLL0_OUT_MAIN"
      &clk_src_sel=SRC_SEL TODO.
      &clk_src_div=2.
      &clk_m_val=29.
      &clk_n_val=500.
      &clk_2d_val=500.
      
      gosub Set_Clock_Freq
      return
    )
    else if ("&clk_desired_freq"=="48.0")
    (
      &clk_src_name="GPLL0_OUT_MAIN"
      &clk_src_sel=SRC_SEL TODO.
      &clk_src_div=2.
      &clk_m_val=3.
      &clk_n_val=50.
      &clk_2d_val=50.
      
      gosub Set_Clock_Freq
      return
    )
    else if ("&clk_desired_freq"=="51.2")
    (
      &clk_src_name="GPLL0_OUT_MAIN"
      &clk_src_sel=SRC_SEL TODO.
      &clk_src_div=2.
      &clk_m_val=8.
      &clk_n_val=125.
      &clk_2d_val=125.
      
      gosub Set_Clock_Freq
      return
    )
    else if ("&clk_desired_freq"=="56.0")
    (
      &clk_src_name="GPLL0_OUT_MAIN"
      &clk_src_sel=SRC_SEL TODO.
      &clk_src_div=2.
      &clk_m_val=7.
      &clk_n_val=100.
      &clk_2d_val=100.
      
      gosub Set_Clock_Freq
      return
    )
    else if ("&clk_desired_freq"=="58.9824")
    (
      &clk_src_name="GPLL0_OUT_MAIN"
      &clk_src_sel=SRC_SEL TODO.
      &clk_src_div=2.
      &clk_m_val=1152.
      &clk_n_val=15625.
      &clk_2d_val=15625.
      
      gosub Set_Clock_Freq
      return
    )
    else if ("&clk_desired_freq"=="60.0")
    (
      &clk_src_name="GPLL0_OUT_MAIN"
      &clk_src_sel=SRC_SEL TODO.
      &clk_src_div=2.
      &clk_m_val=3.
      &clk_n_val=40.
      &clk_2d_val=40.
      
      gosub Set_Clock_Freq
      return
    )
    else if ("&clk_desired_freq"=="64.0")
    (
      &clk_src_name="GPLL0_OUT_MAIN"
      &clk_src_sel=SRC_SEL TODO.
      &clk_src_div=2.
      &clk_m_val=2.
      &clk_n_val=25.
      &clk_2d_val=25.
      
      gosub Set_Clock_Freq
      return
    )
    else if ("&clk_desired_freq"=="r")
    (
      return
    )
    else
    (
      print "Invalid selection."
      goto Set_Clock_Freq_Enter
    )
  )

  if ("&clk"=="gcc_blsp2_qup0_i2c_apps_clk")
  (
    gosub PRINT_SET_CLOCK_FREQ_WARNING

    &clk_cmd_rcgr_addr=&HWIO_GCC_BLSP2_QUP0_I2C_APPS_CMD_RCGR_ADDR
    &clk_cfg_rcgr_addr=&HWIO_GCC_BLSP2_QUP0_I2C_APPS_CFG_RCGR_ADDR

    print "Choose frequency (MHz) from list below: " 

    print "19.2           50.0           " 

    print " "
    print "Enter desired frequency (r to return): "
    enter &clk_desired_freq
    print " "

    if ("&clk_desired_freq"=="19.2")
    (
      &clk_src_name="XO"
      &clk_src_sel=SRC_SEL TODO.
      &clk_src_div=2.
      &clk_m_val=0.
      &clk_n_val=0.
      &clk_2d_val=0.
      
      gosub Set_Clock_Freq
      return
    )
    else if ("&clk_desired_freq"=="50.0")
    (
      &clk_src_name="GPLL0_OUT_MAIN"
      &clk_src_sel=SRC_SEL TODO.
      &clk_src_div=32.
      &clk_m_val=0.
      &clk_n_val=0.
      &clk_2d_val=0.
      
      gosub Set_Clock_Freq
      return
    )
    else if ("&clk_desired_freq"=="r")
    (
      return
    )
    else
    (
      print "Invalid selection."
      goto Set_Clock_Freq_Enter
    )
  )

  if ("&clk"=="gcc_blsp2_qup0_spi_apps_clk")
  (
    gosub PRINT_SET_CLOCK_FREQ_WARNING

    &clk_cmd_rcgr_addr=&HWIO_GCC_BLSP2_QUP0_SPI_APPS_CMD_RCGR_ADDR
    &clk_cfg_rcgr_addr=&HWIO_GCC_BLSP2_QUP0_SPI_APPS_CFG_RCGR_ADDR

    print "Choose frequency (MHz) from list below: " 

    print "0.96           4.8            9.6            " 
    print "16.0           19.2           25.0           " 
    print "50.0           " 

    print " "
    print "Enter desired frequency (r to return): "
    enter &clk_desired_freq
    print " "

    if ("&clk_desired_freq"=="0.96")
    (
      &clk_src_name="XO"
      &clk_src_sel=SRC_SEL TODO.
      &clk_src_div=20.
      &clk_m_val=1.
      &clk_n_val=2.
      &clk_2d_val=2.
      
      gosub Set_Clock_Freq
      return
    )
    else if ("&clk_desired_freq"=="4.8")
    (
      &clk_src_name="XO"
      &clk_src_sel=SRC_SEL TODO.
      &clk_src_div=8.
      &clk_m_val=0.
      &clk_n_val=0.
      &clk_2d_val=0.
      
      gosub Set_Clock_Freq
      return
    )
    else if ("&clk_desired_freq"=="9.6")
    (
      &clk_src_name="XO"
      &clk_src_sel=SRC_SEL TODO.
      &clk_src_div=4.
      &clk_m_val=0.
      &clk_n_val=0.
      &clk_2d_val=0.
      
      gosub Set_Clock_Freq
      return
    )
    else if ("&clk_desired_freq"=="16.0")
    (
      &clk_src_name="GPLL0_OUT_MAIN"
      &clk_src_sel=SRC_SEL TODO.
      &clk_src_div=20.
      &clk_m_val=1.
      &clk_n_val=5.
      &clk_2d_val=5.
      
      gosub Set_Clock_Freq
      return
    )
    else if ("&clk_desired_freq"=="19.2")
    (
      &clk_src_name="XO"
      &clk_src_sel=SRC_SEL TODO.
      &clk_src_div=2.
      &clk_m_val=0.
      &clk_n_val=0.
      &clk_2d_val=0.
      
      gosub Set_Clock_Freq
      return
    )
    else if ("&clk_desired_freq"=="25.0")
    (
      &clk_src_name="GPLL0_OUT_MAIN"
      &clk_src_sel=SRC_SEL TODO.
      &clk_src_div=32.
      &clk_m_val=1.
      &clk_n_val=2.
      &clk_2d_val=2.
      
      gosub Set_Clock_Freq
      return
    )
    else if ("&clk_desired_freq"=="50.0")
    (
      &clk_src_name="GPLL0_OUT_MAIN"
      &clk_src_sel=SRC_SEL TODO.
      &clk_src_div=32.
      &clk_m_val=0.
      &clk_n_val=0.
      &clk_2d_val=0.
      
      gosub Set_Clock_Freq
      return
    )
    else if ("&clk_desired_freq"=="r")
    (
      return
    )
    else
    (
      print "Invalid selection."
      goto Set_Clock_Freq_Enter
    )
  )

  if ("&clk"=="gcc_blsp2_uart0_apps_clk")
  (
    gosub PRINT_SET_CLOCK_FREQ_WARNING

    &clk_cmd_rcgr_addr=&HWIO_GCC_BLSP2_UART0_APPS_CMD_RCGR_ADDR
    &clk_cfg_rcgr_addr=&HWIO_GCC_BLSP2_UART0_APPS_CFG_RCGR_ADDR

    print "Choose frequency (MHz) from list below: " 

    print "3.6864         7.3728         14.7456        " 
    print "16.0           19.2           24.0           " 
    print "25.0           32.0           40.0           " 
    print "46.4           48.0           51.2           " 
    print "56.0           58.9824        60.0           " 
    print "64.0           " 

    print " "
    print "Enter desired frequency (r to return): "
    enter &clk_desired_freq
    print " "

    if ("&clk_desired_freq"=="3.6864")
    (
      &clk_src_name="GPLL0_OUT_MAIN"
      &clk_src_sel=SRC_SEL TODO.
      &clk_src_div=2.
      &clk_m_val=72.
      &clk_n_val=15625.
      &clk_2d_val=15625.
      
      gosub Set_Clock_Freq
      return
    )
    else if ("&clk_desired_freq"=="7.3728")
    (
      &clk_src_name="GPLL0_OUT_MAIN"
      &clk_src_sel=SRC_SEL TODO.
      &clk_src_div=2.
      &clk_m_val=144.
      &clk_n_val=15625.
      &clk_2d_val=15625.
      
      gosub Set_Clock_Freq
      return
    )
    else if ("&clk_desired_freq"=="14.7456")
    (
      &clk_src_name="GPLL0_OUT_MAIN"
      &clk_src_sel=SRC_SEL TODO.
      &clk_src_div=2.
      &clk_m_val=288.
      &clk_n_val=15625.
      &clk_2d_val=15625.
      
      gosub Set_Clock_Freq
      return
    )
    else if ("&clk_desired_freq"=="16.0")
    (
      &clk_src_name="GPLL0_OUT_MAIN"
      &clk_src_sel=SRC_SEL TODO.
      &clk_src_div=20.
      &clk_m_val=1.
      &clk_n_val=5.
      &clk_2d_val=5.
      
      gosub Set_Clock_Freq
      return
    )
    else if ("&clk_desired_freq"=="19.2")
    (
      &clk_src_name="XO"
      &clk_src_sel=SRC_SEL TODO.
      &clk_src_div=2.
      &clk_m_val=0.
      &clk_n_val=0.
      &clk_2d_val=0.
      
      gosub Set_Clock_Freq
      return
    )
    else if ("&clk_desired_freq"=="24.0")
    (
      &clk_src_name="GPLL0_OUT_MAIN"
      &clk_src_sel=SRC_SEL TODO.
      &clk_src_div=2.
      &clk_m_val=3.
      &clk_n_val=100.
      &clk_2d_val=100.
      
      gosub Set_Clock_Freq
      return
    )
    else if ("&clk_desired_freq"=="25.0")
    (
      &clk_src_name="GPLL0_OUT_MAIN"
      &clk_src_sel=SRC_SEL TODO.
      &clk_src_div=32.
      &clk_m_val=1.
      &clk_n_val=2.
      &clk_2d_val=2.
      
      gosub Set_Clock_Freq
      return
    )
    else if ("&clk_desired_freq"=="32.0")
    (
      &clk_src_name="GPLL0_OUT_MAIN"
      &clk_src_sel=SRC_SEL TODO.
      &clk_src_div=2.
      &clk_m_val=1.
      &clk_n_val=25.
      &clk_2d_val=25.
      
      gosub Set_Clock_Freq
      return
    )
    else if ("&clk_desired_freq"=="40.0")
    (
      &clk_src_name="GPLL0_OUT_MAIN"
      &clk_src_sel=SRC_SEL TODO.
      &clk_src_div=2.
      &clk_m_val=1.
      &clk_n_val=20.
      &clk_2d_val=20.
      
      gosub Set_Clock_Freq
      return
    )
    else if ("&clk_desired_freq"=="46.4")
    (
      &clk_src_name="GPLL0_OUT_MAIN"
      &clk_src_sel=SRC_SEL TODO.
      &clk_src_div=2.
      &clk_m_val=29.
      &clk_n_val=500.
      &clk_2d_val=500.
      
      gosub Set_Clock_Freq
      return
    )
    else if ("&clk_desired_freq"=="48.0")
    (
      &clk_src_name="GPLL0_OUT_MAIN"
      &clk_src_sel=SRC_SEL TODO.
      &clk_src_div=2.
      &clk_m_val=3.
      &clk_n_val=50.
      &clk_2d_val=50.
      
      gosub Set_Clock_Freq
      return
    )
    else if ("&clk_desired_freq"=="51.2")
    (
      &clk_src_name="GPLL0_OUT_MAIN"
      &clk_src_sel=SRC_SEL TODO.
      &clk_src_div=2.
      &clk_m_val=8.
      &clk_n_val=125.
      &clk_2d_val=125.
      
      gosub Set_Clock_Freq
      return
    )
    else if ("&clk_desired_freq"=="56.0")
    (
      &clk_src_name="GPLL0_OUT_MAIN"
      &clk_src_sel=SRC_SEL TODO.
      &clk_src_div=2.
      &clk_m_val=7.
      &clk_n_val=100.
      &clk_2d_val=100.
      
      gosub Set_Clock_Freq
      return
    )
    else if ("&clk_desired_freq"=="58.9824")
    (
      &clk_src_name="GPLL0_OUT_MAIN"
      &clk_src_sel=SRC_SEL TODO.
      &clk_src_div=2.
      &clk_m_val=1152.
      &clk_n_val=15625.
      &clk_2d_val=15625.
      
      gosub Set_Clock_Freq
      return
    )
    else if ("&clk_desired_freq"=="60.0")
    (
      &clk_src_name="GPLL0_OUT_MAIN"
      &clk_src_sel=SRC_SEL TODO.
      &clk_src_div=2.
      &clk_m_val=3.
      &clk_n_val=40.
      &clk_2d_val=40.
      
      gosub Set_Clock_Freq
      return
    )
    else if ("&clk_desired_freq"=="64.0")
    (
      &clk_src_name="GPLL0_OUT_MAIN"
      &clk_src_sel=SRC_SEL TODO.
      &clk_src_div=2.
      &clk_m_val=2.
      &clk_n_val=25.
      &clk_2d_val=25.
      
      gosub Set_Clock_Freq
      return
    )
    else if ("&clk_desired_freq"=="r")
    (
      return
    )
    else
    (
      print "Invalid selection."
      goto Set_Clock_Freq_Enter
    )
  )

  if ("&clk"=="gcc_blsp1_uart0_sim_clk")||("&clk"=="gcc_blsp1_uart1_sim_clk")||("&clk"=="gcc_blsp1_uart2_sim_clk")||("&clk"=="gcc_blsp1_uart3_sim_clk")||("&clk"=="gcc_blsp2_uart0_sim_clk")
  (
    gosub PRINT_SET_CLOCK_FREQ_WARNING

    &clk_cmd_rcgr_addr=&HWIO_GCC_BLSP_UART_SIM_CMD_RCGR_ADDR
    &clk_cfg_rcgr_addr=&HWIO_GCC_BLSP_UART_SIM_CFG_RCGR_ADDR

    print "Choose frequency (MHz) from list below: " 

    print "3.84           " 

    print " "
    print "Enter desired frequency (r to return): "
    enter &clk_desired_freq
    print " "

    if ("&clk_desired_freq"=="3.84")
    (
      &clk_src_name="XO"
      &clk_src_sel=SRC_SEL TODO.
      &clk_src_div=10.
      &clk_m_val=0.
      &clk_n_val=0.
      &clk_2d_val=0.
      
      gosub Set_Clock_Freq
      return
    )
    else if ("&clk_desired_freq"=="r")
    (
      return
    )
    else
    (
      print "Invalid selection."
      goto Set_Clock_Freq_Enter
    )
  )

  if ("&clk"=="gcc_mdss_byte0_clk")
  (
    gosub PRINT_SET_CLOCK_FREQ_WARNING

    &clk_cmd_rcgr_addr=&HWIO_GCC_BYTE0_CMD_RCGR_ADDR
    &clk_cfg_rcgr_addr=&HWIO_GCC_BYTE0_CFG_RCGR_ADDR

    print "Choose frequency (MHz) from list below: " 

    print "19.2           125.0          187.5          " 

    print " "
    print "Enter desired frequency (r to return): "
    enter &clk_desired_freq
    print " "

    if ("&clk_desired_freq"=="19.2")
    (
      &clk_src_name="XO"
      &clk_src_sel=SRC_SEL TODO.
      &clk_src_div=2.
      &clk_m_val=0.
      &clk_n_val=0.
      &clk_2d_val=0.
      
      gosub Set_Clock_Freq
      return
    )
    else if ("&clk_desired_freq"=="125.0")
    (
      &clk_src_name="EXTERNAL"
      &clk_src_sel=SRC_SEL TODO.
      &clk_src_div=2.
      &clk_m_val=0.
      &clk_n_val=0.
      &clk_2d_val=0.
      
      gosub Set_Clock_Freq
      return
    )
    else if ("&clk_desired_freq"=="187.5")
    (
      &clk_src_name="EXTERNAL"
      &clk_src_sel=SRC_SEL TODO.
      &clk_src_div=2.
      &clk_m_val=0.
      &clk_n_val=0.
      &clk_2d_val=0.
      
      gosub Set_Clock_Freq
      return
    )
    else if ("&clk_desired_freq"=="r")
    (
      return
    )
    else
    (
      print "Invalid selection."
      goto Set_Clock_Freq_Enter
    )
  )

  if ("&clk"=="gcc_bimc_cdsp_clk")||("&clk"=="gcc_cdsp_bimc_clk")||("&clk"=="gcc_cdsp_tbu_clk")
  (
    gosub PRINT_SET_CLOCK_FREQ_WARNING

    &clk_cmd_rcgr_addr=&HWIO_GCC_CDSP_BIMC_CMD_RCGR_ADDR
    &clk_cfg_rcgr_addr=&HWIO_GCC_CDSP_BIMC_CFG_RCGR_ADDR

    print "Choose frequency (MHz) from list below: " 

    print "19.2           133.333333     266.666667     " 
    print "320.0          " 

    print " "
    print "Enter desired frequency (r to return): "
    enter &clk_desired_freq
    print " "

    if ("&clk_desired_freq"=="19.2")
    (
      &clk_src_name="XO"
      &clk_src_sel=SRC_SEL TODO.
      &clk_src_div=2.
      &clk_m_val=0.
      &clk_n_val=0.
      &clk_2d_val=0.
      
      gosub Set_Clock_Freq
      return
    )
    else if ("&clk_desired_freq"=="133.333333")
    (
      &clk_src_name="GPLL0_OUT_MAIN"
      &clk_src_sel=SRC_SEL TODO.
      &clk_src_div=12.
      &clk_m_val=0.
      &clk_n_val=0.
      &clk_2d_val=0.
      
      gosub Set_Clock_Freq
      return
    )
    else if ("&clk_desired_freq"=="266.666667")
    (
      &clk_src_name="GPLL0_OUT_MAIN"
      &clk_src_sel=SRC_SEL TODO.
      &clk_src_div=6.
      &clk_m_val=0.
      &clk_n_val=0.
      &clk_2d_val=0.
      
      gosub Set_Clock_Freq
      return
    )
    else if ("&clk_desired_freq"=="320.0")
    (
      &clk_src_name="GPLL0_OUT_MAIN"
      &clk_src_sel=SRC_SEL TODO.
      &clk_src_div=5.
      &clk_m_val=0.
      &clk_n_val=0.
      &clk_2d_val=0.
      
      gosub Set_Clock_Freq
      return
    )
    else if ("&clk_desired_freq"=="r")
    (
      return
    )
    else
    (
      print "Invalid selection."
      goto Set_Clock_Freq_Enter
    )
  )

  if ("&clk"=="gcc_crypto_clk")
  (
    gosub PRINT_SET_CLOCK_FREQ_WARNING

    &clk_cmd_rcgr_addr=&HWIO_GCC_CRYPTO_CMD_RCGR_ADDR
    &clk_cfg_rcgr_addr=&HWIO_GCC_CRYPTO_CFG_RCGR_ADDR

    print "Choose frequency (MHz) from list below: " 

    print "19.2           80.0           160.0          " 

    print " "
    print "Enter desired frequency (r to return): "
    enter &clk_desired_freq
    print " "

    if ("&clk_desired_freq"=="19.2")
    (
      &clk_src_name="XO"
      &clk_src_sel=SRC_SEL TODO.
      &clk_src_div=2.
      &clk_m_val=0.
      &clk_n_val=0.
      &clk_2d_val=0.
      
      gosub Set_Clock_Freq
      return
    )
    else if ("&clk_desired_freq"=="80.0")
    (
      &clk_src_name="GPLL0_OUT_MAIN"
      &clk_src_sel=SRC_SEL TODO.
      &clk_src_div=20.
      &clk_m_val=0.
      &clk_n_val=0.
      &clk_2d_val=0.
      
      gosub Set_Clock_Freq
      return
    )
    else if ("&clk_desired_freq"=="160.0")
    (
      &clk_src_name="GPLL0_OUT_MAIN"
      &clk_src_sel=SRC_SEL TODO.
      &clk_src_div=10.
      &clk_m_val=0.
      &clk_n_val=0.
      &clk_2d_val=0.
      
      gosub Set_Clock_Freq
      return
    )
    else if ("&clk_desired_freq"=="r")
    (
      return
    )
    else
    (
      print "Invalid selection."
      goto Set_Clock_Freq_Enter
    )
  )

  if ("&clk"=="gcc_eth_rgmii_clk")
  (
    gosub PRINT_SET_CLOCK_FREQ_WARNING

    &clk_cmd_rcgr_addr=&HWIO_GCC_EMAC_CMD_RCGR_ADDR
    &clk_cfg_rcgr_addr=&HWIO_GCC_EMAC_CFG_RCGR_ADDR

    print "Choose frequency (MHz) from list below: " 

    print "125.0          250.0          " 

    print " "
    print "Enter desired frequency (r to return): "
    enter &clk_desired_freq
    print " "

    if ("&clk_desired_freq"=="125.0")
    (
      &clk_src_name="GPLL1_OUT_MAIN"
      &clk_src_sel=SRC_SEL TODO.
      &clk_src_div=8.
      &clk_m_val=0.
      &clk_n_val=0.
      &clk_2d_val=0.
      
      gosub Set_Clock_Freq
      return
    )
    else if ("&clk_desired_freq"=="250.0")
    (
      &clk_src_name="GPLL1_OUT_MAIN"
      &clk_src_sel=SRC_SEL TODO.
      &clk_src_div=4.
      &clk_m_val=0.
      &clk_n_val=0.
      &clk_2d_val=0.
      
      gosub Set_Clock_Freq
      return
    )
    else if ("&clk_desired_freq"=="r")
    (
      return
    )
    else
    (
      print "Invalid selection."
      goto Set_Clock_Freq_Enter
    )
  )

  if ("&clk"=="gcc_eth_ptp_clk")
  (
    gosub PRINT_SET_CLOCK_FREQ_WARNING

    &clk_cmd_rcgr_addr=&HWIO_GCC_EMAC_PTP_CMD_RCGR_ADDR
    &clk_cfg_rcgr_addr=&HWIO_GCC_EMAC_PTP_CFG_RCGR_ADDR

    print "Choose frequency (MHz) from list below: " 

    print "125.0          250.0          " 

    print " "
    print "Enter desired frequency (r to return): "
    enter &clk_desired_freq
    print " "

    if ("&clk_desired_freq"=="125.0")
    (
      &clk_src_name="GPLL1_OUT_MAIN"
      &clk_src_sel=SRC_SEL TODO.
      &clk_src_div=8.
      &clk_m_val=0.
      &clk_n_val=0.
      &clk_2d_val=0.
      
      gosub Set_Clock_Freq
      return
    )
    else if ("&clk_desired_freq"=="250.0")
    (
      &clk_src_name="GPLL1_OUT_MAIN"
      &clk_src_sel=SRC_SEL TODO.
      &clk_src_div=4.
      &clk_m_val=0.
      &clk_n_val=0.
      &clk_2d_val=0.
      
      gosub Set_Clock_Freq
      return
    )
    else if ("&clk_desired_freq"=="r")
    (
      return
    )
    else
    (
      print "Invalid selection."
      goto Set_Clock_Freq_Enter
    )
  )

  if ("&clk"=="gcc_mdss_esc0_clk")
  (
    gosub PRINT_SET_CLOCK_FREQ_WARNING

    &clk_cmd_rcgr_addr=&HWIO_GCC_ESC0_CMD_RCGR_ADDR
    &clk_cfg_rcgr_addr=&HWIO_GCC_ESC0_CFG_RCGR_ADDR

    print "Choose frequency (MHz) from list below: " 

    print "19.2           19.2           " 

    print " "
    print "Enter desired frequency (r to return): "
    enter &clk_desired_freq
    print " "

    if ("&clk_desired_freq"=="19.2")
    (
      &clk_src_name="XO"
      &clk_src_sel=SRC_SEL TODO.
      &clk_src_div=2.
      &clk_m_val=0.
      &clk_n_val=0.
      &clk_2d_val=0.
      
      gosub Set_Clock_Freq
      return
    )
    else if ("&clk_desired_freq"=="19.2")
    (
      &clk_src_name="EXTERNAL"
      &clk_src_sel=SRC_SEL TODO.
      &clk_src_div=2.
      &clk_m_val=0.
      &clk_n_val=0.
      &clk_2d_val=0.
      
      gosub Set_Clock_Freq
      return
    )
    else if ("&clk_desired_freq"=="r")
    (
      return
    )
    else
    (
      print "Invalid selection."
      goto Set_Clock_Freq_Enter
    )
  )

  if ("&clk"=="gcc_oxili_gfx3d_clk")
  (
    gosub PRINT_SET_CLOCK_FREQ_WARNING

    &clk_cmd_rcgr_addr=&HWIO_GCC_GFX3D_CMD_RCGR_ADDR
    &clk_cfg_rcgr_addr=&HWIO_GCC_GFX3D_CFG_RCGR_ADDR

    print "Choose frequency (MHz) from list below: " 

    print "19.2           50.0           80.0           " 
    print "100.0          160.0          200.0          " 
    print "228.571429     240.0          266.666667     " 
    print "270.0          320.0          400.0          " 
    print "484.8          523.2          550.0          " 
    print "598.0          " 

    print " "
    print "Enter desired frequency (r to return): "
    enter &clk_desired_freq
    print " "

    if ("&clk_desired_freq"=="19.2")
    (
      &clk_src_name="XO"
      &clk_src_sel=SRC_SEL TODO.
      &clk_src_div=2.
      &clk_m_val=0.
      &clk_n_val=0.
      &clk_2d_val=0.
      
      gosub Set_Clock_Freq
      return
    )
    else if ("&clk_desired_freq"=="50.0")
    (
      &clk_src_name="GPLL0_OUT_MAIN"
      &clk_src_sel=SRC_SEL TODO.
      &clk_src_div=32.
      &clk_m_val=0.
      &clk_n_val=0.
      &clk_2d_val=0.
      
      gosub Set_Clock_Freq
      return
    )
    else if ("&clk_desired_freq"=="80.0")
    (
      &clk_src_name="GPLL0_OUT_MAIN"
      &clk_src_sel=SRC_SEL TODO.
      &clk_src_div=20.
      &clk_m_val=0.
      &clk_n_val=0.
      &clk_2d_val=0.
      
      gosub Set_Clock_Freq
      return
    )
    else if ("&clk_desired_freq"=="100.0")
    (
      &clk_src_name="GPLL0_OUT_MAIN"
      &clk_src_sel=SRC_SEL TODO.
      &clk_src_div=16.
      &clk_m_val=0.
      &clk_n_val=0.
      &clk_2d_val=0.
      
      gosub Set_Clock_Freq
      return
    )
    else if ("&clk_desired_freq"=="160.0")
    (
      &clk_src_name="GPLL0_OUT_MAIN"
      &clk_src_sel=SRC_SEL TODO.
      &clk_src_div=10.
      &clk_m_val=0.
      &clk_n_val=0.
      &clk_2d_val=0.
      
      gosub Set_Clock_Freq
      return
    )
    else if ("&clk_desired_freq"=="200.0")
    (
      &clk_src_name="GPLL0_OUT_MAIN"
      &clk_src_sel=SRC_SEL TODO.
      &clk_src_div=8.
      &clk_m_val=0.
      &clk_n_val=0.
      &clk_2d_val=0.
      
      gosub Set_Clock_Freq
      return
    )
    else if ("&clk_desired_freq"=="228.571429")
    (
      &clk_src_name="GPLL0_OUT_MAIN"
      &clk_src_sel=SRC_SEL TODO.
      &clk_src_div=7.
      &clk_m_val=0.
      &clk_n_val=0.
      &clk_2d_val=0.
      
      gosub Set_Clock_Freq
      return
    )
    else if ("&clk_desired_freq"=="240.0")
    (
      &clk_src_name="GPLL6_OUT_AUX"
      &clk_src_sel=SRC_SEL TODO.
      &clk_src_div=9.
      &clk_m_val=0.
      &clk_n_val=0.
      &clk_2d_val=0.
      
      gosub Set_Clock_Freq
      return
    )
    else if ("&clk_desired_freq"=="266.666667")
    (
      &clk_src_name="GPLL0_OUT_MAIN"
      &clk_src_sel=SRC_SEL TODO.
      &clk_src_div=6.
      &clk_m_val=0.
      &clk_n_val=0.
      &clk_2d_val=0.
      
      gosub Set_Clock_Freq
      return
    )
    else if ("&clk_desired_freq"=="270.0")
    (
      &clk_src_name="GPLL6_OUT_AUX"
      &clk_src_sel=SRC_SEL TODO.
      &clk_src_div=8.
      &clk_m_val=0.
      &clk_n_val=0.
      &clk_2d_val=0.
      
      gosub Set_Clock_Freq
      return
    )
    else if ("&clk_desired_freq"=="320.0")
    (
      &clk_src_name="GPLL0_OUT_MAIN"
      &clk_src_sel=SRC_SEL TODO.
      &clk_src_div=5.
      &clk_m_val=0.
      &clk_n_val=0.
      &clk_2d_val=0.
      
      gosub Set_Clock_Freq
      return
    )
    else if ("&clk_desired_freq"=="400.0")
    (
      &clk_src_name="GPLL0_OUT_MAIN"
      &clk_src_sel=SRC_SEL TODO.
      &clk_src_div=4.
      &clk_m_val=0.
      &clk_n_val=0.
      &clk_2d_val=0.
      
      gosub Set_Clock_Freq
      return
    )
    else if ("&clk_desired_freq"=="484.8")
    (
      &clk_src_name="GPLL3_OUT_MAIN"
      &clk_src_sel=SRC_SEL TODO.
      &clk_src_div=2.
      &clk_m_val=0.
      &clk_n_val=0.
      &clk_2d_val=0.
      
      gosub Set_Clock_Freq
      return
    )
    else if ("&clk_desired_freq"=="523.2")
    (
      &clk_src_name="GPLL3_OUT_MAIN"
      &clk_src_sel=SRC_SEL TODO.
      &clk_src_div=2.
      &clk_m_val=0.
      &clk_n_val=0.
      &clk_2d_val=0.
      
      gosub Set_Clock_Freq
      return
    )
    else if ("&clk_desired_freq"=="550.0")
    (
      &clk_src_name="GPLL3_OUT_MAIN"
      &clk_src_sel=SRC_SEL TODO.
      &clk_src_div=2.
      &clk_m_val=0.
      &clk_n_val=0.
      &clk_2d_val=0.
      
      gosub Set_Clock_Freq
      return
    )
    else if ("&clk_desired_freq"=="598.0")
    (
      &clk_src_name="GPLL3_OUT_MAIN"
      &clk_src_sel=SRC_SEL TODO.
      &clk_src_div=2.
      &clk_m_val=0.
      &clk_n_val=0.
      &clk_2d_val=0.
      
      gosub Set_Clock_Freq
      return
    )
    else if ("&clk_desired_freq"=="r")
    (
      return
    )
    else
    (
      print "Invalid selection."
      goto Set_Clock_Freq_Enter
    )
  )

  if ("&clk"=="gcc_gp1_clk")
  (
    gosub PRINT_SET_CLOCK_FREQ_WARNING

    &clk_cmd_rcgr_addr=&HWIO_GCC_GP1_CMD_RCGR_ADDR
    &clk_cfg_rcgr_addr=&HWIO_GCC_GP1_CFG_RCGR_ADDR

    print "Choose frequency (MHz) from list below: " 

    print "19.2           100.0          200.0          " 

    print " "
    print "Enter desired frequency (r to return): "
    enter &clk_desired_freq
    print " "

    if ("&clk_desired_freq"=="19.2")
    (
      &clk_src_name="XO"
      &clk_src_sel=SRC_SEL TODO.
      &clk_src_div=2.
      &clk_m_val=0.
      &clk_n_val=0.
      &clk_2d_val=0.
      
      gosub Set_Clock_Freq
      return
    )
    else if ("&clk_desired_freq"=="100.0")
    (
      &clk_src_name="GPLL0_OUT_MAIN"
      &clk_src_sel=SRC_SEL TODO.
      &clk_src_div=16.
      &clk_m_val=0.
      &clk_n_val=0.
      &clk_2d_val=0.
      
      gosub Set_Clock_Freq
      return
    )
    else if ("&clk_desired_freq"=="200.0")
    (
      &clk_src_name="GPLL0_OUT_MAIN"
      &clk_src_sel=SRC_SEL TODO.
      &clk_src_div=8.
      &clk_m_val=0.
      &clk_n_val=0.
      &clk_2d_val=0.
      
      gosub Set_Clock_Freq
      return
    )
    else if ("&clk_desired_freq"=="r")
    (
      return
    )
    else
    (
      print "Invalid selection."
      goto Set_Clock_Freq_Enter
    )
  )

  if ("&clk"=="gcc_gp2_clk")
  (
    gosub PRINT_SET_CLOCK_FREQ_WARNING

    &clk_cmd_rcgr_addr=&HWIO_GCC_GP2_CMD_RCGR_ADDR
    &clk_cfg_rcgr_addr=&HWIO_GCC_GP2_CFG_RCGR_ADDR

    print "Choose frequency (MHz) from list below: " 

    print "19.2           100.0          200.0          " 

    print " "
    print "Enter desired frequency (r to return): "
    enter &clk_desired_freq
    print " "

    if ("&clk_desired_freq"=="19.2")
    (
      &clk_src_name="XO"
      &clk_src_sel=SRC_SEL TODO.
      &clk_src_div=2.
      &clk_m_val=0.
      &clk_n_val=0.
      &clk_2d_val=0.
      
      gosub Set_Clock_Freq
      return
    )
    else if ("&clk_desired_freq"=="100.0")
    (
      &clk_src_name="GPLL0_OUT_MAIN"
      &clk_src_sel=SRC_SEL TODO.
      &clk_src_div=16.
      &clk_m_val=0.
      &clk_n_val=0.
      &clk_2d_val=0.
      
      gosub Set_Clock_Freq
      return
    )
    else if ("&clk_desired_freq"=="200.0")
    (
      &clk_src_name="GPLL0_OUT_MAIN"
      &clk_src_sel=SRC_SEL TODO.
      &clk_src_div=8.
      &clk_m_val=0.
      &clk_n_val=0.
      &clk_2d_val=0.
      
      gosub Set_Clock_Freq
      return
    )
    else if ("&clk_desired_freq"=="r")
    (
      return
    )
    else
    (
      print "Invalid selection."
      goto Set_Clock_Freq_Enter
    )
  )

  if ("&clk"=="gcc_gp3_clk")
  (
    gosub PRINT_SET_CLOCK_FREQ_WARNING

    &clk_cmd_rcgr_addr=&HWIO_GCC_GP3_CMD_RCGR_ADDR
    &clk_cfg_rcgr_addr=&HWIO_GCC_GP3_CFG_RCGR_ADDR

    print "Choose frequency (MHz) from list below: " 

    print "19.2           100.0          200.0          " 

    print " "
    print "Enter desired frequency (r to return): "
    enter &clk_desired_freq
    print " "

    if ("&clk_desired_freq"=="19.2")
    (
      &clk_src_name="XO"
      &clk_src_sel=SRC_SEL TODO.
      &clk_src_div=2.
      &clk_m_val=0.
      &clk_n_val=0.
      &clk_2d_val=0.
      
      gosub Set_Clock_Freq
      return
    )
    else if ("&clk_desired_freq"=="100.0")
    (
      &clk_src_name="GPLL0_OUT_MAIN"
      &clk_src_sel=SRC_SEL TODO.
      &clk_src_div=16.
      &clk_m_val=0.
      &clk_n_val=0.
      &clk_2d_val=0.
      
      gosub Set_Clock_Freq
      return
    )
    else if ("&clk_desired_freq"=="200.0")
    (
      &clk_src_name="GPLL0_OUT_MAIN"
      &clk_src_sel=SRC_SEL TODO.
      &clk_src_div=8.
      &clk_m_val=0.
      &clk_n_val=0.
      &clk_2d_val=0.
      
      gosub Set_Clock_Freq
      return
    )
    else if ("&clk_desired_freq"=="r")
    (
      return
    )
    else
    (
      print "Invalid selection."
      goto Set_Clock_Freq_Enter
    )
  )

  if ("&clk"=="gcc_mdss_hdmi_app_clk")
  (
    gosub PRINT_SET_CLOCK_FREQ_WARNING

    &clk_cmd_rcgr_addr=&HWIO_GCC_HDMI_APP_CMD_RCGR_ADDR
    &clk_cfg_rcgr_addr=&HWIO_GCC_HDMI_APP_CFG_RCGR_ADDR

    print "Choose frequency (MHz) from list below: " 

    print "19.2           " 

    print " "
    print "Enter desired frequency (r to return): "
    enter &clk_desired_freq
    print " "

    if ("&clk_desired_freq"=="19.2")
    (
      &clk_src_name="XO"
      &clk_src_sel=SRC_SEL TODO.
      &clk_src_div=2.
      &clk_m_val=0.
      &clk_n_val=0.
      &clk_2d_val=0.
      
      gosub Set_Clock_Freq
      return
    )
    else if ("&clk_desired_freq"=="r")
    (
      return
    )
    else
    (
      print "Invalid selection."
      goto Set_Clock_Freq_Enter
    )
  )

  if ("&clk"=="gcc_mdss_hdmi_pclk_clk")
  (
    gosub PRINT_SET_CLOCK_FREQ_WARNING

    &clk_cmd_rcgr_addr=&HWIO_GCC_HDMI_PCLK_CMD_RCGR_ADDR
    &clk_cfg_rcgr_addr=&HWIO_GCC_HDMI_PCLK_CFG_RCGR_ADDR

    print "Choose frequency (MHz) from list below: " 

    print "19.2           75.0           150.0          " 

    print " "
    print "Enter desired frequency (r to return): "
    enter &clk_desired_freq
    print " "

    if ("&clk_desired_freq"=="19.2")
    (
      &clk_src_name="XO"
      &clk_src_sel=SRC_SEL TODO.
      &clk_src_div=2.
      &clk_m_val=0.
      &clk_n_val=0.
      &clk_2d_val=0.
      
      gosub Set_Clock_Freq
      return
    )
    else if ("&clk_desired_freq"=="75.0")
    (
      &clk_src_name="EXTERNAL"
      &clk_src_sel=SRC_SEL TODO.
      &clk_src_div=2.
      &clk_m_val=0.
      &clk_n_val=0.
      &clk_2d_val=0.
      
      gosub Set_Clock_Freq
      return
    )
    else if ("&clk_desired_freq"=="150.0")
    (
      &clk_src_name="EXTERNAL"
      &clk_src_sel=SRC_SEL TODO.
      &clk_src_div=2.
      &clk_m_val=0.
      &clk_n_val=0.
      &clk_2d_val=0.
      
      gosub Set_Clock_Freq
      return
    )
    else if ("&clk_desired_freq"=="r")
    (
      return
    )
    else
    (
      print "Invalid selection."
      goto Set_Clock_Freq_Enter
    )
  )

  if ("&clk"=="gcc_bimc_lpass_clk")||("&clk"=="gcc_lpass_agnoc_clk")||("&clk"=="gcc_lpass_core_mport_clk")||("&clk"=="gcc_lpass_hw_af_clk")||("&clk"=="gcc_lpass_q6_axim_clk")||("&clk"=="gcc_lpass_tbu_clk")
  (
    gosub PRINT_SET_CLOCK_FREQ_WARNING

    &clk_cmd_rcgr_addr=&HWIO_GCC_LPASS_BIMC_CMD_RCGR_ADDR
    &clk_cfg_rcgr_addr=&HWIO_GCC_LPASS_BIMC_CFG_RCGR_ADDR

    print "Choose frequency (MHz) from list below: " 

    print "19.2           154.285714     308.571429     " 
    print "400.0          " 

    print " "
    print "Enter desired frequency (r to return): "
    enter &clk_desired_freq
    print " "

    if ("&clk_desired_freq"=="19.2")
    (
      &clk_src_name="XO"
      &clk_src_sel=SRC_SEL TODO.
      &clk_src_div=2.
      &clk_m_val=0.
      &clk_n_val=0.
      &clk_2d_val=0.
      
      gosub Set_Clock_Freq
      return
    )
    else if ("&clk_desired_freq"=="154.285714")
    (
      &clk_src_name="GPLL6_OUT_MAIN"
      &clk_src_sel=SRC_SEL TODO.
      &clk_src_div=14.
      &clk_m_val=0.
      &clk_n_val=0.
      &clk_2d_val=0.
      
      gosub Set_Clock_Freq
      return
    )
    else if ("&clk_desired_freq"=="308.571429")
    (
      &clk_src_name="GPLL6_OUT_MAIN"
      &clk_src_sel=SRC_SEL TODO.
      &clk_src_div=7.
      &clk_m_val=0.
      &clk_n_val=0.
      &clk_2d_val=0.
      
      gosub Set_Clock_Freq
      return
    )
    else if ("&clk_desired_freq"=="400.0")
    (
      &clk_src_name="GPLL0_OUT_MAIN"
      &clk_src_sel=SRC_SEL TODO.
      &clk_src_div=4.
      &clk_m_val=0.
      &clk_n_val=0.
      &clk_2d_val=0.
      
      gosub Set_Clock_Freq
      return
    )
    else if ("&clk_desired_freq"=="r")
    (
      return
    )
    else
    (
      print "Invalid selection."
      goto Set_Clock_Freq_Enter
    )
  )

  if ("&clk"=="gcc_mdss_mdp_clk")
  (
    gosub PRINT_SET_CLOCK_FREQ_WARNING

    &clk_cmd_rcgr_addr=&HWIO_GCC_MDP_CMD_RCGR_ADDR
    &clk_cfg_rcgr_addr=&HWIO_GCC_MDP_CFG_RCGR_ADDR

    print "Choose frequency (MHz) from list below: " 

    print "50.0           80.0           100.0          " 
    print "145.454545     160.0          160.0          " 
    print "177.777778     200.0          266.666667     " 
    print "266.666667     320.0          320.0          " 

    print " "
    print "Enter desired frequency (r to return): "
    enter &clk_desired_freq
    print " "

    if ("&clk_desired_freq"=="50.0")
    (
      &clk_src_name="GPLL0_OUT_MAIN"
      &clk_src_sel=SRC_SEL TODO.
      &clk_src_div=32.
      &clk_m_val=0.
      &clk_n_val=0.
      &clk_2d_val=0.
      
      gosub Set_Clock_Freq
      return
    )
    else if ("&clk_desired_freq"=="80.0")
    (
      &clk_src_name="GPLL0_OUT_MAIN"
      &clk_src_sel=SRC_SEL TODO.
      &clk_src_div=20.
      &clk_m_val=0.
      &clk_n_val=0.
      &clk_2d_val=0.
      
      gosub Set_Clock_Freq
      return
    )
    else if ("&clk_desired_freq"=="100.0")
    (
      &clk_src_name="GPLL0_OUT_MAIN"
      &clk_src_sel=SRC_SEL TODO.
      &clk_src_div=16.
      &clk_m_val=0.
      &clk_n_val=0.
      &clk_2d_val=0.
      
      gosub Set_Clock_Freq
      return
    )
    else if ("&clk_desired_freq"=="145.454545")
    (
      &clk_src_name="GPLL0_OUT_MAIN"
      &clk_src_sel=SRC_SEL TODO.
      &clk_src_div=11.
      &clk_m_val=0.
      &clk_n_val=0.
      &clk_2d_val=0.
      
      gosub Set_Clock_Freq
      return
    )
    else if ("&clk_desired_freq"=="160.0")
    (
      &clk_src_name="GPLL0_OUT_MAIN"
      &clk_src_sel=SRC_SEL TODO.
      &clk_src_div=10.
      &clk_m_val=0.
      &clk_n_val=0.
      &clk_2d_val=0.
      
      gosub Set_Clock_Freq
      return
    )
    else if ("&clk_desired_freq"=="160.0")
    (
      &clk_src_name="EXTERNAL"
      &clk_src_sel=SRC_SEL TODO.
      &clk_src_div=2.
      &clk_m_val=0.
      &clk_n_val=0.
      &clk_2d_val=0.
      
      gosub Set_Clock_Freq
      return
    )
    else if ("&clk_desired_freq"=="177.777778")
    (
      &clk_src_name="GPLL0_OUT_MAIN"
      &clk_src_sel=SRC_SEL TODO.
      &clk_src_div=9.
      &clk_m_val=0.
      &clk_n_val=0.
      &clk_2d_val=0.
      
      gosub Set_Clock_Freq
      return
    )
    else if ("&clk_desired_freq"=="200.0")
    (
      &clk_src_name="GPLL0_OUT_MAIN"
      &clk_src_sel=SRC_SEL TODO.
      &clk_src_div=8.
      &clk_m_val=0.
      &clk_n_val=0.
      &clk_2d_val=0.
      
      gosub Set_Clock_Freq
      return
    )
    else if ("&clk_desired_freq"=="266.666667")
    (
      &clk_src_name="GPLL0_OUT_MAIN"
      &clk_src_sel=SRC_SEL TODO.
      &clk_src_div=6.
      &clk_m_val=0.
      &clk_n_val=0.
      &clk_2d_val=0.
      
      gosub Set_Clock_Freq
      return
    )
    else if ("&clk_desired_freq"=="266.666667")
    (
      &clk_src_name="EXTERNAL"
      &clk_src_sel=SRC_SEL TODO.
      &clk_src_div=2.
      &clk_m_val=0.
      &clk_n_val=0.
      &clk_2d_val=0.
      
      gosub Set_Clock_Freq
      return
    )
    else if ("&clk_desired_freq"=="320.0")
    (
      &clk_src_name="GPLL0_OUT_MAIN"
      &clk_src_sel=SRC_SEL TODO.
      &clk_src_div=5.
      &clk_m_val=0.
      &clk_n_val=0.
      &clk_2d_val=0.
      
      gosub Set_Clock_Freq
      return
    )
    else if ("&clk_desired_freq"=="320.0")
    (
      &clk_src_name="EXTERNAL"
      &clk_src_sel=SRC_SEL TODO.
      &clk_src_div=2.
      &clk_m_val=0.
      &clk_n_val=0.
      &clk_2d_val=0.
      
      gosub Set_Clock_Freq
      return
    )
    else if ("&clk_desired_freq"=="r")
    (
      return
    )
    else
    (
      print "Invalid selection."
      goto Set_Clock_Freq_Enter
    )
  )

  if ("&clk"=="gcc_bimc_mdss_clk")||("&clk"=="gcc_mdp_tbu_clk")||("&clk"=="gcc_mdss_axi_clk")
  (
    gosub PRINT_SET_CLOCK_FREQ_WARNING

    &clk_cmd_rcgr_addr=&HWIO_GCC_MDSS_BIMC_CMD_RCGR_ADDR
    &clk_cfg_rcgr_addr=&HWIO_GCC_MDSS_BIMC_CFG_RCGR_ADDR

    print "Choose frequency (MHz) from list below: " 

    print "19.2           160.0          266.666667     " 
    print "320.0          " 

    print " "
    print "Enter desired frequency (r to return): "
    enter &clk_desired_freq
    print " "

    if ("&clk_desired_freq"=="19.2")
    (
      &clk_src_name="XO"
      &clk_src_sel=SRC_SEL TODO.
      &clk_src_div=2.
      &clk_m_val=0.
      &clk_n_val=0.
      &clk_2d_val=0.
      
      gosub Set_Clock_Freq
      return
    )
    else if ("&clk_desired_freq"=="160.0")
    (
      &clk_src_name="GPLL0_OUT_MAIN"
      &clk_src_sel=SRC_SEL TODO.
      &clk_src_div=10.
      &clk_m_val=0.
      &clk_n_val=0.
      &clk_2d_val=0.
      
      gosub Set_Clock_Freq
      return
    )
    else if ("&clk_desired_freq"=="266.666667")
    (
      &clk_src_name="GPLL0_OUT_MAIN"
      &clk_src_sel=SRC_SEL TODO.
      &clk_src_div=6.
      &clk_m_val=0.
      &clk_n_val=0.
      &clk_2d_val=0.
      
      gosub Set_Clock_Freq
      return
    )
    else if ("&clk_desired_freq"=="320.0")
    (
      &clk_src_name="GPLL0_OUT_MAIN"
      &clk_src_sel=SRC_SEL TODO.
      &clk_src_div=5.
      &clk_m_val=0.
      &clk_n_val=0.
      &clk_2d_val=0.
      
      gosub Set_Clock_Freq
      return
    )
    else if ("&clk_desired_freq"=="r")
    (
      return
    )
    else
    (
      print "Invalid selection."
      goto Set_Clock_Freq_Enter
    )
  )

  if ("&clk"=="gcc_pcie_0_aux_clk")
  (
    gosub PRINT_SET_CLOCK_FREQ_WARNING

    &clk_cmd_rcgr_addr=&HWIO_GCC_PCIE_0_AUX_CMD_RCGR_ADDR
    &clk_cfg_rcgr_addr=&HWIO_GCC_PCIE_0_AUX_CFG_RCGR_ADDR

    print "Choose frequency (MHz) from list below: " 

    print "1.2            " 

    print " "
    print "Enter desired frequency (r to return): "
    enter &clk_desired_freq
    print " "

    if ("&clk_desired_freq"=="1.2")
    (
      &clk_src_name="XO"
      &clk_src_sel=SRC_SEL TODO.
      &clk_src_div=32.
      &clk_m_val=0.
      &clk_n_val=0.
      &clk_2d_val=0.
      
      gosub Set_Clock_Freq
      return
    )
    else if ("&clk_desired_freq"=="r")
    (
      return
    )
    else
    (
      print "Invalid selection."
      goto Set_Clock_Freq_Enter
    )
  )

  if ("&clk"=="gcc_pcie_0_pipe_clk")
  (
    gosub PRINT_SET_CLOCK_FREQ_WARNING

    &clk_cmd_rcgr_addr=&HWIO_GCC_PCIE_0_PIPE_CMD_RCGR_ADDR
    &clk_cfg_rcgr_addr=&HWIO_GCC_PCIE_0_PIPE_CFG_RCGR_ADDR

    print "Choose frequency (MHz) from list below: " 

    print "19.2           125.0          250.0          " 

    print " "
    print "Enter desired frequency (r to return): "
    enter &clk_desired_freq
    print " "

    if ("&clk_desired_freq"=="19.2")
    (
      &clk_src_name="XO"
      &clk_src_sel=SRC_SEL TODO.
      &clk_src_div=2.
      &clk_m_val=0.
      &clk_n_val=0.
      &clk_2d_val=0.
      
      gosub Set_Clock_Freq
      return
    )
    else if ("&clk_desired_freq"=="125.0")
    (
      &clk_src_name="EXTERNAL"
      &clk_src_sel=SRC_SEL TODO.
      &clk_src_div=2.
      &clk_m_val=0.
      &clk_n_val=0.
      &clk_2d_val=0.
      
      gosub Set_Clock_Freq
      return
    )
    else if ("&clk_desired_freq"=="250.0")
    (
      &clk_src_name="EXTERNAL"
      &clk_src_sel=SRC_SEL TODO.
      &clk_src_div=2.
      &clk_m_val=0.
      &clk_n_val=0.
      &clk_2d_val=0.
      
      gosub Set_Clock_Freq
      return
    )
    else if ("&clk_desired_freq"=="r")
    (
      return
    )
    else
    (
      print "Invalid selection."
      goto Set_Clock_Freq_Enter
    )
  )

  if ("&clk"=="gcc_mdss_pclk0_clk")
  (
    gosub PRINT_SET_CLOCK_FREQ_WARNING

    &clk_cmd_rcgr_addr=&HWIO_GCC_PCLK0_CMD_RCGR_ADDR
    &clk_cfg_rcgr_addr=&HWIO_GCC_PCLK0_CFG_RCGR_ADDR

    print "Choose frequency (MHz) from list below: " 

    print "19.2           166.666667     250.0          " 

    print " "
    print "Enter desired frequency (r to return): "
    enter &clk_desired_freq
    print " "

    if ("&clk_desired_freq"=="19.2")
    (
      &clk_src_name="XO"
      &clk_src_sel=SRC_SEL TODO.
      &clk_src_div=2.
      &clk_m_val=0.
      &clk_n_val=0.
      &clk_2d_val=0.
      
      gosub Set_Clock_Freq
      return
    )
    else if ("&clk_desired_freq"=="166.666667")
    (
      &clk_src_name="EXTERNAL"
      &clk_src_sel=SRC_SEL TODO.
      &clk_src_div=2.
      &clk_m_val=0.
      &clk_n_val=0.
      &clk_2d_val=0.
      
      gosub Set_Clock_Freq
      return
    )
    else if ("&clk_desired_freq"=="250.0")
    (
      &clk_src_name="EXTERNAL"
      &clk_src_sel=SRC_SEL TODO.
      &clk_src_div=2.
      &clk_m_val=0.
      &clk_n_val=0.
      &clk_2d_val=0.
      
      gosub Set_Clock_Freq
      return
    )
    else if ("&clk_desired_freq"=="r")
    (
      return
    )
    else
    (
      print "Invalid selection."
      goto Set_Clock_Freq_Enter
    )
  )

  if ("&clk"=="gcc_ahb_clk")||("&clk"=="gcc_bimc_cfg_ahb_clk")||("&clk"=="gcc_blsp1_ahb_clk")||("&clk"=="gcc_blsp2_ahb_clk")||("&clk"=="gcc_boot_rom_ahb_clk")||("&clk"=="gcc_cdsp_cfg_ahb_clk")||("&clk"=="gcc_crypto_ahb_clk")||("&clk"=="gcc_crypto_axi_clk")||("&clk"=="gcc_dcc_clk")||("&clk"=="gcc_eth_slave_ahb_clk")||("&clk"=="gcc_geni_ir_h_clk")||("&clk"=="gcc_geni_ir_xpu_clk")||("&clk"=="gcc_gtcu_ahb_clk")||("&clk"=="gcc_imem_cfg_ahb_clk")||("&clk"=="gcc_lpass_agnoc_cfg_clk")||("&clk"=="gcc_lpass_agnoc_mpu_cfg_clk")||("&clk"=="gcc_lpass_mpu_cfg_clk")||("&clk"=="gcc_mdss_ahb_clk")||("&clk"=="gcc_mpm_ahb_clk")||("&clk"=="gcc_msg_ram_ahb_clk")||("&clk"=="gcc_noc_conf_xpu_ahb_clk")||("&clk"=="gcc_oxili_ahb_clk")||("&clk"=="gcc_pcie_0_cfg_ahb_clk")||("&clk"=="gcc_pcnoc_ahb_clk")||("&clk"=="gcc_pcnoc_bus_timeout0_ahb_clk")||("&clk"=="gcc_pcnoc_bus_timeout1_ahb_clk")||("&clk"=="gcc_pcnoc_bus_timeout2_ahb_clk")||("&clk"=="gcc_pcnoc_bus_timeout3_ahb_clk")||("&clk"=="gcc_pcnoc_bus_timeout4_ahb_clk")||("&clk"=="gcc_pcnoc_bus_timeout6_ahb_clk")||("&clk"=="gcc_pcnoc_bus_timeout7_ahb_clk")||("&clk"=="gcc_pcnoc_bus_timeout8_ahb_clk")||("&clk"=="gcc_pcnoc_bus_timeout9_ahb_clk")||("&clk"=="gcc_pcnoc_ddr_cfg_clk")||("&clk"=="gcc_pcnoc_east_ahb_clk")||("&clk"=="gcc_pcnoc_mpu_cfg_ahb_clk")||("&clk"=="gcc_pcnoc_mst_rpm_bridge_clk")||("&clk"=="gcc_pcnoc_north_ahb_clk")||("&clk"=="gcc_pcnoc_slv_rpm_bridge_clk")||("&clk"=="gcc_pcnoc_south_ahb_clk")||("&clk"=="gcc_pcnoc_tbu_clk")||("&clk"=="gcc_pcnoc_west_ahb_clk")||("&clk"=="gcc_pdm_ahb_clk")||("&clk"=="gcc_prng_ahb_clk")||("&clk"=="gcc_qdss_cfg_ahb_clk")||("&clk"=="gcc_qdss_dap_ahb_clk")||("&clk"=="gcc_qpic_ahb_clk")||("&clk"=="gcc_rbcpr_ahb_clk")||("&clk"=="gcc_rpm_cfg_xpu_clk")||("&clk"=="gcc_sdcc1_ahb_clk")||("&clk"=="gcc_sdcc2_ahb_clk")||("&clk"=="gcc_sec_ctrl_ahb_clk")||("&clk"=="gcc_sec_ctrl_boot_rom_patch_clk")||("&clk"=="gcc_smmu_cfg_clk")||("&clk"=="gcc_smmu_xpu_clk")||("&clk"=="gcc_snoc_pcnoc_ahb_clk")||("&clk"=="gcc_spdm_cfg_ahb_clk")||("&clk"=="gcc_spdm_mstr_ahb_clk")||("&clk"=="gcc_spdm_pcnoc_cy_clk")||("&clk"=="gcc_spmi_pcnoc_ahb_clk")||("&clk"=="gcc_tcsr_ahb_clk")||("&clk"=="gcc_tic_cfg_ahb_clk")||("&clk"=="gcc_tlmm_clk")||("&clk"=="gcc_tlmm_east_ahb_clk")||("&clk"=="gcc_tlmm_east_clk")||("&clk"=="gcc_tlmm_north_ahb_clk")||("&clk"=="gcc_tlmm_north_clk")||("&clk"=="gcc_tlmm_south_ahb_clk")||("&clk"=="gcc_tlmm_south_clk")||("&clk"=="gcc_usb_hs_phy_cfg_ahb_clk")||("&clk"=="gcc_wdsp_q6ss_ahbs_clk")
  (
    gosub PRINT_SET_CLOCK_FREQ_WARNING

    &clk_cmd_rcgr_addr=&HWIO_GCC_PCNOC_BFDCD_CMD_RCGR_ADDR
    &clk_cfg_rcgr_addr=&HWIO_GCC_PCNOC_BFDCD_CFG_RCGR_ADDR

    print "Choose frequency (MHz) from list below: " 

    print "19.2           50.0           100.0          " 
    print "133.333333     " 

    print " "
    print "Enter desired frequency (r to return): "
    enter &clk_desired_freq
    print " "

    if ("&clk_desired_freq"=="19.2")
    (
      &clk_src_name="XO"
      &clk_src_sel=SRC_SEL TODO.
      &clk_src_div=2.
      &clk_m_val=0.
      &clk_n_val=0.
      &clk_2d_val=0.
      
      gosub Set_Clock_Freq
      return
    )
    else if ("&clk_desired_freq"=="50.0")
    (
      &clk_src_name="GPLL0_OUT_MAIN"
      &clk_src_sel=SRC_SEL TODO.
      &clk_src_div=32.
      &clk_m_val=0.
      &clk_n_val=0.
      &clk_2d_val=0.
      
      gosub Set_Clock_Freq
      return
    )
    else if ("&clk_desired_freq"=="100.0")
    (
      &clk_src_name="GPLL0_OUT_MAIN"
      &clk_src_sel=SRC_SEL TODO.
      &clk_src_div=16.
      &clk_m_val=0.
      &clk_n_val=0.
      &clk_2d_val=0.
      
      gosub Set_Clock_Freq
      return
    )
    else if ("&clk_desired_freq"=="133.333333")
    (
      &clk_src_name="GPLL0_OUT_MAIN"
      &clk_src_sel=SRC_SEL TODO.
      &clk_src_div=12.
      &clk_m_val=0.
      &clk_n_val=0.
      &clk_2d_val=0.
      
      gosub Set_Clock_Freq
      return
    )
    else if ("&clk_desired_freq"=="r")
    (
      return
    )
    else
    (
      print "Invalid selection."
      goto Set_Clock_Freq_Enter
    )
  )

  if ("&clk"=="gcc_pdm2_clk")
  (
    gosub PRINT_SET_CLOCK_FREQ_WARNING

    &clk_cmd_rcgr_addr=&HWIO_GCC_PDM2_CMD_RCGR_ADDR
    &clk_cfg_rcgr_addr=&HWIO_GCC_PDM2_CFG_RCGR_ADDR

    print "Choose frequency (MHz) from list below: " 

    print "19.2           64.0           " 

    print " "
    print "Enter desired frequency (r to return): "
    enter &clk_desired_freq
    print " "

    if ("&clk_desired_freq"=="19.2")
    (
      &clk_src_name="XO"
      &clk_src_sel=SRC_SEL TODO.
      &clk_src_div=2.
      &clk_m_val=0.
      &clk_n_val=0.
      &clk_2d_val=0.
      
      gosub Set_Clock_Freq
      return
    )
    else if ("&clk_desired_freq"=="64.0")
    (
      &clk_src_name="GPLL0_OUT_MAIN"
      &clk_src_sel=SRC_SEL TODO.
      &clk_src_div=25.
      &clk_m_val=0.
      &clk_n_val=0.
      &clk_2d_val=0.
      
      gosub Set_Clock_Freq
      return
    )
    else if ("&clk_desired_freq"=="r")
    (
      return
    )
    else
    (
      print "Invalid selection."
      goto Set_Clock_Freq_Enter
    )
  )

  if ("&clk"=="gcc_qdss_apb2jtag_clk")||("&clk"=="gcc_qdss_dap_clk")||("&clk"=="gcc_qdss_tsctr_clk")||("&clk"=="gcc_wcss_apb_clk")||("&clk"=="gcc_wcss_tsctr_clk")
  (
    gosub PRINT_SET_CLOCK_FREQ_WARNING

    &clk_cmd_rcgr_addr=&HWIO_GCC_QDSS_APB_TSCTR_CMD_RCGR_ADDR
    &clk_cfg_rcgr_addr=&HWIO_GCC_QDSS_APB_TSCTR_CFG_RCGR_ADDR

    print "Choose frequency (MHz) from list below: " 

    print "19.2           " 

    print " "
    print "Enter desired frequency (r to return): "
    enter &clk_desired_freq
    print " "

    if ("&clk_desired_freq"=="19.2")
    (
      &clk_src_name="XO"
      &clk_src_sel=SRC_SEL TODO.
      &clk_src_div=2.
      &clk_m_val=0.
      &clk_n_val=0.
      &clk_2d_val=0.
      
      gosub Set_Clock_Freq
      return
    )
    else if ("&clk_desired_freq"=="r")
    (
      return
    )
    else
    (
      print "Invalid selection."
      goto Set_Clock_Freq_Enter
    )
  )

  if ("&clk"=="gcc_lpass_at_clk")||("&clk"=="gcc_pcnoc_at_clk")||("&clk"=="gcc_qdss_at_clk")||("&clk"=="gcc_sys_noc_at_clk")||("&clk"=="gcc_wcss_at_clk")
  (
    gosub PRINT_SET_CLOCK_FREQ_WARNING

    &clk_cmd_rcgr_addr=&HWIO_GCC_QDSS_AT_CMD_RCGR_ADDR
    &clk_cfg_rcgr_addr=&HWIO_GCC_QDSS_AT_CFG_RCGR_ADDR

    print "Choose frequency (MHz) from list below: " 

    print "19.2           133.333333     266.666667     " 

    print " "
    print "Enter desired frequency (r to return): "
    enter &clk_desired_freq
    print " "

    if ("&clk_desired_freq"=="19.2")
    (
      &clk_src_name="XO"
      &clk_src_sel=SRC_SEL TODO.
      &clk_src_div=2.
      &clk_m_val=0.
      &clk_n_val=0.
      &clk_2d_val=0.
      
      gosub Set_Clock_Freq
      return
    )
    else if ("&clk_desired_freq"=="133.333333")
    (
      &clk_src_name="GPLL0_OUT_MAIN"
      &clk_src_sel=SRC_SEL TODO.
      &clk_src_div=12.
      &clk_m_val=0.
      &clk_n_val=0.
      &clk_2d_val=0.
      
      gosub Set_Clock_Freq
      return
    )
    else if ("&clk_desired_freq"=="266.666667")
    (
      &clk_src_name="GPLL0_OUT_MAIN"
      &clk_src_sel=SRC_SEL TODO.
      &clk_src_div=6.
      &clk_m_val=0.
      &clk_n_val=0.
      &clk_2d_val=0.
      
      gosub Set_Clock_Freq
      return
    )
    else if ("&clk_desired_freq"=="r")
    (
      return
    )
    else
    (
      print "Invalid selection."
      goto Set_Clock_Freq_Enter
    )
  )

  if ("&clk"=="gcc_qdss_stm_clk")||("&clk"=="gcc_sys_noc_qdss_stm_axi_clk")
  (
    gosub PRINT_SET_CLOCK_FREQ_WARNING

    &clk_cmd_rcgr_addr=&HWIO_GCC_QDSS_STM_CMD_RCGR_ADDR
    &clk_cfg_rcgr_addr=&HWIO_GCC_QDSS_STM_CFG_RCGR_ADDR

    print "Choose frequency (MHz) from list below: " 

    print "19.2           100.0          200.0          " 

    print " "
    print "Enter desired frequency (r to return): "
    enter &clk_desired_freq
    print " "

    if ("&clk_desired_freq"=="19.2")
    (
      &clk_src_name="XO"
      &clk_src_sel=SRC_SEL TODO.
      &clk_src_div=2.
      &clk_m_val=0.
      &clk_n_val=0.
      &clk_2d_val=0.
      
      gosub Set_Clock_Freq
      return
    )
    else if ("&clk_desired_freq"=="100.0")
    (
      &clk_src_name="GPLL0_OUT_MAIN"
      &clk_src_sel=SRC_SEL TODO.
      &clk_src_div=16.
      &clk_m_val=0.
      &clk_n_val=0.
      &clk_2d_val=0.
      
      gosub Set_Clock_Freq
      return
    )
    else if ("&clk_desired_freq"=="200.0")
    (
      &clk_src_name="GPLL0_OUT_MAIN"
      &clk_src_sel=SRC_SEL TODO.
      &clk_src_div=8.
      &clk_m_val=0.
      &clk_n_val=0.
      &clk_2d_val=0.
      
      gosub Set_Clock_Freq
      return
    )
    else if ("&clk_desired_freq"=="r")
    (
      return
    )
    else
    (
      print "Invalid selection."
      goto Set_Clock_Freq_Enter
    )
  )

  if ("&clk"=="gcc_qdss_traceclkin_clk")
  (
    gosub PRINT_SET_CLOCK_FREQ_WARNING

    &clk_cmd_rcgr_addr=&HWIO_GCC_QDSS_TRACECLKIN_CMD_RCGR_ADDR
    &clk_cfg_rcgr_addr=&HWIO_GCC_QDSS_TRACECLKIN_CFG_RCGR_ADDR

    print "Choose frequency (MHz) from list below: " 

    print "19.2           154.285714     308.571429     " 

    print " "
    print "Enter desired frequency (r to return): "
    enter &clk_desired_freq
    print " "

    if ("&clk_desired_freq"=="19.2")
    (
      &clk_src_name="XO"
      &clk_src_sel=SRC_SEL TODO.
      &clk_src_div=2.
      &clk_m_val=0.
      &clk_n_val=0.
      &clk_2d_val=0.
      
      gosub Set_Clock_Freq
      return
    )
    else if ("&clk_desired_freq"=="154.285714")
    (
      &clk_src_name="GPLL6_OUT_AUX"
      &clk_src_sel=SRC_SEL TODO.
      &clk_src_div=14.
      &clk_m_val=0.
      &clk_n_val=0.
      &clk_2d_val=0.
      
      gosub Set_Clock_Freq
      return
    )
    else if ("&clk_desired_freq"=="308.571429")
    (
      &clk_src_name="GPLL6_OUT_AUX"
      &clk_src_sel=SRC_SEL TODO.
      &clk_src_div=7.
      &clk_m_val=0.
      &clk_n_val=0.
      &clk_2d_val=0.
      
      gosub Set_Clock_Freq
      return
    )
    else if ("&clk_desired_freq"=="r")
    (
      return
    )
    else
    (
      print "Invalid selection."
      goto Set_Clock_Freq_Enter
    )
  )

  if ("&clk"=="gcc_qdss_trig_clk")
  (
    gosub PRINT_SET_CLOCK_FREQ_WARNING

    &clk_cmd_rcgr_addr=&HWIO_GCC_QDSS_TRIG_CMD_RCGR_ADDR
    &clk_cfg_rcgr_addr=&HWIO_GCC_QDSS_TRIG_CFG_RCGR_ADDR

    print "Choose frequency (MHz) from list below: " 

    print "19.2           80.0           160.0          " 

    print " "
    print "Enter desired frequency (r to return): "
    enter &clk_desired_freq
    print " "

    if ("&clk_desired_freq"=="19.2")
    (
      &clk_src_name="XO"
      &clk_src_sel=SRC_SEL TODO.
      &clk_src_div=2.
      &clk_m_val=0.
      &clk_n_val=0.
      &clk_2d_val=0.
      
      gosub Set_Clock_Freq
      return
    )
    else if ("&clk_desired_freq"=="80.0")
    (
      &clk_src_name="GPLL0_OUT_MAIN"
      &clk_src_sel=SRC_SEL TODO.
      &clk_src_div=20.
      &clk_m_val=0.
      &clk_n_val=0.
      &clk_2d_val=0.
      
      gosub Set_Clock_Freq
      return
    )
    else if ("&clk_desired_freq"=="160.0")
    (
      &clk_src_name="GPLL0_OUT_MAIN"
      &clk_src_sel=SRC_SEL TODO.
      &clk_src_div=10.
      &clk_m_val=0.
      &clk_n_val=0.
      &clk_2d_val=0.
      
      gosub Set_Clock_Freq
      return
    )
    else if ("&clk_desired_freq"=="r")
    (
      return
    )
    else
    (
      print "Invalid selection."
      goto Set_Clock_Freq_Enter
    )
  )

  if ("&clk"=="gcc_qpic_clk")
  (
    gosub PRINT_SET_CLOCK_FREQ_WARNING

    &clk_cmd_rcgr_addr=&HWIO_GCC_QPIC_CMD_RCGR_ADDR
    &clk_cfg_rcgr_addr=&HWIO_GCC_QPIC_CFG_RCGR_ADDR

    print "Choose frequency (MHz) from list below: " 

    print "50.0           100.0          " 

    print " "
    print "Enter desired frequency (r to return): "
    enter &clk_desired_freq
    print " "

    if ("&clk_desired_freq"=="50.0")
    (
      &clk_src_name="GPLL0_OUT_MAIN"
      &clk_src_sel=SRC_SEL TODO.
      &clk_src_div=32.
      &clk_m_val=0.
      &clk_n_val=0.
      &clk_2d_val=0.
      
      gosub Set_Clock_Freq
      return
    )
    else if ("&clk_desired_freq"=="100.0")
    (
      &clk_src_name="GPLL0_OUT_MAIN"
      &clk_src_sel=SRC_SEL TODO.
      &clk_src_div=16.
      &clk_m_val=0.
      &clk_n_val=0.
      &clk_2d_val=0.
      
      gosub Set_Clock_Freq
      return
    )
    else if ("&clk_desired_freq"=="r")
    (
      return
    )
    else
    (
      print "Invalid selection."
      goto Set_Clock_Freq_Enter
    )
  )

  if ("&clk"=="gcc_rbcpr_clk")
  (
    gosub PRINT_SET_CLOCK_FREQ_WARNING

    &clk_cmd_rcgr_addr=&HWIO_GCC_RBCPR_CMD_RCGR_ADDR
    &clk_cfg_rcgr_addr=&HWIO_GCC_RBCPR_CFG_RCGR_ADDR

    print "Choose frequency (MHz) from list below: " 

    print "19.2           50.0           " 

    print " "
    print "Enter desired frequency (r to return): "
    enter &clk_desired_freq
    print " "

    if ("&clk_desired_freq"=="19.2")
    (
      &clk_src_name="XO"
      &clk_src_sel=SRC_SEL TODO.
      &clk_src_div=2.
      &clk_m_val=0.
      &clk_n_val=0.
      &clk_2d_val=0.
      
      gosub Set_Clock_Freq
      return
    )
    else if ("&clk_desired_freq"=="50.0")
    (
      &clk_src_name="GPLL0_OUT_MAIN"
      &clk_src_sel=SRC_SEL TODO.
      &clk_src_div=32.
      &clk_m_val=0.
      &clk_n_val=0.
      &clk_2d_val=0.
      
      gosub Set_Clock_Freq
      return
    )
    else if ("&clk_desired_freq"=="r")
    (
      return
    )
    else
    (
      print "Invalid selection."
      goto Set_Clock_Freq_Enter
    )
  )

  if ("&clk"=="gcc_rpm_bus_ahb_clk")||("&clk"=="gcc_rpm_proc_fclk")||("&clk"=="gcc_rpm_proc_hclk")
  (
    gosub PRINT_SET_CLOCK_FREQ_WARNING

    &clk_cmd_rcgr_addr=&HWIO_GCC_RPM_CMD_RCGR_ADDR
    &clk_cfg_rcgr_addr=&HWIO_GCC_RPM_CFG_RCGR_ADDR

    print "Choose frequency (MHz) from list below: " 

    print "19.2           177.777778     308.571429     " 
    print "360.0          " 

    print " "
    print "Enter desired frequency (r to return): "
    enter &clk_desired_freq
    print " "

    if ("&clk_desired_freq"=="19.2")
    (
      &clk_src_name="XO"
      &clk_src_sel=SRC_SEL TODO.
      &clk_src_div=2.
      &clk_m_val=0.
      &clk_n_val=0.
      &clk_2d_val=0.
      
      gosub Set_Clock_Freq
      return
    )
    else if ("&clk_desired_freq"=="177.777778")
    (
      &clk_src_name="GPLL0_OUT_MAIN"
      &clk_src_sel=SRC_SEL TODO.
      &clk_src_div=9.
      &clk_m_val=0.
      &clk_n_val=0.
      &clk_2d_val=0.
      
      gosub Set_Clock_Freq
      return
    )
    else if ("&clk_desired_freq"=="308.571429")
    (
      &clk_src_name="GPLL6_OUT_MAIN"
      &clk_src_sel=SRC_SEL TODO.
      &clk_src_div=7.
      &clk_m_val=0.
      &clk_n_val=0.
      &clk_2d_val=0.
      
      gosub Set_Clock_Freq
      return
    )
    else if ("&clk_desired_freq"=="360.0")
    (
      &clk_src_name="GPLL6_OUT_MAIN"
      &clk_src_sel=SRC_SEL TODO.
      &clk_src_div=6.
      &clk_m_val=0.
      &clk_n_val=0.
      &clk_2d_val=0.
      
      gosub Set_Clock_Freq
      return
    )
    else if ("&clk_desired_freq"=="r")
    (
      return
    )
    else
    (
      print "Invalid selection."
      goto Set_Clock_Freq_Enter
    )
  )

  if ("&clk"=="gcc_sdcc1_apps_clk")
  (
    gosub PRINT_SET_CLOCK_FREQ_WARNING

    &clk_cmd_rcgr_addr=&HWIO_GCC_SDCC1_APPS_CMD_RCGR_ADDR
    &clk_cfg_rcgr_addr=&HWIO_GCC_SDCC1_APPS_CFG_RCGR_ADDR

    print "Choose frequency (MHz) from list below: " 

    print "0.144          0.4            20.0           " 
    print "25.0           50.0           100.0          " 
    print "177.777778     192.0          200.0          " 
    print "384.0          " 

    print " "
    print "Enter desired frequency (r to return): "
    enter &clk_desired_freq
    print " "

    if ("&clk_desired_freq"=="0.144")
    (
      &clk_src_name="XO"
      &clk_src_sel=SRC_SEL TODO.
      &clk_src_div=32.
      &clk_m_val=3.
      &clk_n_val=25.
      &clk_2d_val=25.
      
      gosub Set_Clock_Freq
      return
    )
    else if ("&clk_desired_freq"=="0.4")
    (
      &clk_src_name="XO"
      &clk_src_sel=SRC_SEL TODO.
      &clk_src_div=24.
      &clk_m_val=1.
      &clk_n_val=4.
      &clk_2d_val=4.
      
      gosub Set_Clock_Freq
      return
    )
    else if ("&clk_desired_freq"=="20.0")
    (
      &clk_src_name="GPLL0_OUT_MAIN"
      &clk_src_sel=SRC_SEL TODO.
      &clk_src_div=20.
      &clk_m_val=1.
      &clk_n_val=4.
      &clk_2d_val=4.
      
      gosub Set_Clock_Freq
      return
    )
    else if ("&clk_desired_freq"=="25.0")
    (
      &clk_src_name="GPLL0_OUT_MAIN"
      &clk_src_sel=SRC_SEL TODO.
      &clk_src_div=32.
      &clk_m_val=1.
      &clk_n_val=2.
      &clk_2d_val=2.
      
      gosub Set_Clock_Freq
      return
    )
    else if ("&clk_desired_freq"=="50.0")
    (
      &clk_src_name="GPLL0_OUT_MAIN"
      &clk_src_sel=SRC_SEL TODO.
      &clk_src_div=32.
      &clk_m_val=0.
      &clk_n_val=0.
      &clk_2d_val=0.
      
      gosub Set_Clock_Freq
      return
    )
    else if ("&clk_desired_freq"=="100.0")
    (
      &clk_src_name="GPLL0_OUT_MAIN"
      &clk_src_sel=SRC_SEL TODO.
      &clk_src_div=16.
      &clk_m_val=0.
      &clk_n_val=0.
      &clk_2d_val=0.
      
      gosub Set_Clock_Freq
      return
    )
    else if ("&clk_desired_freq"=="177.777778")
    (
      &clk_src_name="GPLL0_OUT_MAIN"
      &clk_src_sel=SRC_SEL TODO.
      &clk_src_div=9.
      &clk_m_val=0.
      &clk_n_val=0.
      &clk_2d_val=0.
      
      gosub Set_Clock_Freq
      return
    )
    else if ("&clk_desired_freq"=="192.0")
    (
      &clk_src_name="GPLL4_OUT_MAIN"
      &clk_src_sel=SRC_SEL TODO.
      &clk_src_div=12.
      &clk_m_val=0.
      &clk_n_val=0.
      &clk_2d_val=0.
      
      gosub Set_Clock_Freq
      return
    )
    else if ("&clk_desired_freq"=="200.0")
    (
      &clk_src_name="GPLL0_OUT_MAIN"
      &clk_src_sel=SRC_SEL TODO.
      &clk_src_div=8.
      &clk_m_val=0.
      &clk_n_val=0.
      &clk_2d_val=0.
      
      gosub Set_Clock_Freq
      return
    )
    else if ("&clk_desired_freq"=="384.0")
    (
      &clk_src_name="GPLL4_OUT_MAIN"
      &clk_src_sel=SRC_SEL TODO.
      &clk_src_div=6.
      &clk_m_val=0.
      &clk_n_val=0.
      &clk_2d_val=0.
      
      gosub Set_Clock_Freq
      return
    )
    else if ("&clk_desired_freq"=="r")
    (
      return
    )
    else
    (
      print "Invalid selection."
      goto Set_Clock_Freq_Enter
    )
  )

  if ("&clk"=="gcc_sdcc1_ice_core_clk")
  (
    gosub PRINT_SET_CLOCK_FREQ_WARNING

    &clk_cmd_rcgr_addr=&HWIO_GCC_SDCC1_ICE_CORE_CMD_RCGR_ADDR
    &clk_cfg_rcgr_addr=&HWIO_GCC_SDCC1_ICE_CORE_CFG_RCGR_ADDR

    print "Choose frequency (MHz) from list below: " 

    print "160.0          266.666667     " 

    print " "
    print "Enter desired frequency (r to return): "
    enter &clk_desired_freq
    print " "

    if ("&clk_desired_freq"=="160.0")
    (
      &clk_src_name="GPLL0_OUT_MAIN"
      &clk_src_sel=SRC_SEL TODO.
      &clk_src_div=10.
      &clk_m_val=0.
      &clk_n_val=0.
      &clk_2d_val=0.
      
      gosub Set_Clock_Freq
      return
    )
    else if ("&clk_desired_freq"=="266.666667")
    (
      &clk_src_name="GPLL0_OUT_MAIN"
      &clk_src_sel=SRC_SEL TODO.
      &clk_src_div=6.
      &clk_m_val=0.
      &clk_n_val=0.
      &clk_2d_val=0.
      
      gosub Set_Clock_Freq
      return
    )
    else if ("&clk_desired_freq"=="r")
    (
      return
    )
    else
    (
      print "Invalid selection."
      goto Set_Clock_Freq_Enter
    )
  )

  if ("&clk"=="gcc_sdcc2_apps_clk")
  (
    gosub PRINT_SET_CLOCK_FREQ_WARNING

    &clk_cmd_rcgr_addr=&HWIO_GCC_SDCC2_APPS_CMD_RCGR_ADDR
    &clk_cfg_rcgr_addr=&HWIO_GCC_SDCC2_APPS_CFG_RCGR_ADDR

    print "Choose frequency (MHz) from list below: " 

    print "0.144          0.4            20.0           " 
    print "25.0           50.0           100.0          " 
    print "177.777778     200.0          " 

    print " "
    print "Enter desired frequency (r to return): "
    enter &clk_desired_freq
    print " "

    if ("&clk_desired_freq"=="0.144")
    (
      &clk_src_name="XO"
      &clk_src_sel=SRC_SEL TODO.
      &clk_src_div=32.
      &clk_m_val=3.
      &clk_n_val=25.
      &clk_2d_val=25.
      
      gosub Set_Clock_Freq
      return
    )
    else if ("&clk_desired_freq"=="0.4")
    (
      &clk_src_name="XO"
      &clk_src_sel=SRC_SEL TODO.
      &clk_src_div=24.
      &clk_m_val=1.
      &clk_n_val=4.
      &clk_2d_val=4.
      
      gosub Set_Clock_Freq
      return
    )
    else if ("&clk_desired_freq"=="20.0")
    (
      &clk_src_name="GPLL0_OUT_MAIN"
      &clk_src_sel=SRC_SEL TODO.
      &clk_src_div=20.
      &clk_m_val=1.
      &clk_n_val=4.
      &clk_2d_val=4.
      
      gosub Set_Clock_Freq
      return
    )
    else if ("&clk_desired_freq"=="25.0")
    (
      &clk_src_name="GPLL0_OUT_MAIN"
      &clk_src_sel=SRC_SEL TODO.
      &clk_src_div=32.
      &clk_m_val=1.
      &clk_n_val=2.
      &clk_2d_val=2.
      
      gosub Set_Clock_Freq
      return
    )
    else if ("&clk_desired_freq"=="50.0")
    (
      &clk_src_name="GPLL0_OUT_MAIN"
      &clk_src_sel=SRC_SEL TODO.
      &clk_src_div=32.
      &clk_m_val=0.
      &clk_n_val=0.
      &clk_2d_val=0.
      
      gosub Set_Clock_Freq
      return
    )
    else if ("&clk_desired_freq"=="100.0")
    (
      &clk_src_name="GPLL0_OUT_MAIN"
      &clk_src_sel=SRC_SEL TODO.
      &clk_src_div=16.
      &clk_m_val=0.
      &clk_n_val=0.
      &clk_2d_val=0.
      
      gosub Set_Clock_Freq
      return
    )
    else if ("&clk_desired_freq"=="177.777778")
    (
      &clk_src_name="GPLL0_OUT_MAIN"
      &clk_src_sel=SRC_SEL TODO.
      &clk_src_div=9.
      &clk_m_val=0.
      &clk_n_val=0.
      &clk_2d_val=0.
      
      gosub Set_Clock_Freq
      return
    )
    else if ("&clk_desired_freq"=="200.0")
    (
      &clk_src_name="GPLL0_OUT_MAIN"
      &clk_src_sel=SRC_SEL TODO.
      &clk_src_div=8.
      &clk_m_val=0.
      &clk_n_val=0.
      &clk_2d_val=0.
      
      gosub Set_Clock_Freq
      return
    )
    else if ("&clk_desired_freq"=="r")
    (
      return
    )
    else
    (
      print "Invalid selection."
      goto Set_Clock_Freq_Enter
    )
  )

  if ("&clk"=="gcc_sec_ctrl_clk")||("&clk"=="gcc_sec_ctrl_sense_clk")
  (
    gosub PRINT_SET_CLOCK_FREQ_WARNING

    &clk_cmd_rcgr_addr=&HWIO_GCC_SEC_CTRL_CMD_RCGR_ADDR
    &clk_cfg_rcgr_addr=&HWIO_GCC_SEC_CTRL_CFG_RCGR_ADDR

    print "Choose frequency (MHz) from list below: " 

    print "4.8            19.2           " 

    print " "
    print "Enter desired frequency (r to return): "
    enter &clk_desired_freq
    print " "

    if ("&clk_desired_freq"=="4.8")
    (
      &clk_src_name="XO"
      &clk_src_sel=SRC_SEL TODO.
      &clk_src_div=8.
      &clk_m_val=0.
      &clk_n_val=0.
      &clk_2d_val=0.
      
      gosub Set_Clock_Freq
      return
    )
    else if ("&clk_desired_freq"=="19.2")
    (
      &clk_src_name="XO"
      &clk_src_sel=SRC_SEL TODO.
      &clk_src_div=2.
      &clk_m_val=0.
      &clk_n_val=0.
      &clk_2d_val=0.
      
      gosub Set_Clock_Freq
      return
    )
    else if ("&clk_desired_freq"=="r")
    (
      return
    )
    else
    (
      print "Invalid selection."
      goto Set_Clock_Freq_Enter
    )
  )

  if ("&clk"=="gcc_spmi_ahb_clk")
  (
    gosub PRINT_SET_CLOCK_FREQ_WARNING

    &clk_cmd_rcgr_addr=&HWIO_GCC_SPMI_AHB_CMD_RCGR_ADDR
    &clk_cfg_rcgr_addr=&HWIO_GCC_SPMI_AHB_CFG_RCGR_ADDR

    print "Choose frequency (MHz) from list below: " 

    print "50.0           100.0          133.333333     " 

    print " "
    print "Enter desired frequency (r to return): "
    enter &clk_desired_freq
    print " "

    if ("&clk_desired_freq"=="50.0")
    (
      &clk_src_name="GPLL0_OUT_MAIN"
      &clk_src_sel=SRC_SEL TODO.
      &clk_src_div=32.
      &clk_m_val=0.
      &clk_n_val=0.
      &clk_2d_val=0.
      
      gosub Set_Clock_Freq
      return
    )
    else if ("&clk_desired_freq"=="100.0")
    (
      &clk_src_name="GPLL0_OUT_MAIN"
      &clk_src_sel=SRC_SEL TODO.
      &clk_src_div=16.
      &clk_m_val=0.
      &clk_n_val=0.
      &clk_2d_val=0.
      
      gosub Set_Clock_Freq
      return
    )
    else if ("&clk_desired_freq"=="133.333333")
    (
      &clk_src_name="GPLL0_OUT_MAIN"
      &clk_src_sel=SRC_SEL TODO.
      &clk_src_div=12.
      &clk_m_val=0.
      &clk_n_val=0.
      &clk_2d_val=0.
      
      gosub Set_Clock_Freq
      return
    )
    else if ("&clk_desired_freq"=="r")
    (
      return
    )
    else
    (
      print "Invalid selection."
      goto Set_Clock_Freq_Enter
    )
  )

  if ("&clk"=="gcc_spmi_ser_clk")
  (
    gosub PRINT_SET_CLOCK_FREQ_WARNING

    &clk_cmd_rcgr_addr=&HWIO_GCC_SPMI_SER_CMD_RCGR_ADDR
    &clk_cfg_rcgr_addr=&HWIO_GCC_SPMI_SER_CFG_RCGR_ADDR

    print "Choose frequency (MHz) from list below: " 

    print "19.2           " 

    print " "
    print "Enter desired frequency (r to return): "
    enter &clk_desired_freq
    print " "

    if ("&clk_desired_freq"=="19.2")
    (
      &clk_src_name="XO"
      &clk_src_sel=SRC_SEL TODO.
      &clk_src_div=2.
      &clk_m_val=0.
      &clk_n_val=0.
      &clk_2d_val=0.
      
      gosub Set_Clock_Freq
      return
    )
    else if ("&clk_desired_freq"=="r")
    (
      return
    )
    else
    (
      print "Invalid selection."
      goto Set_Clock_Freq_Enter
    )
  )

  if ("&clk"=="gcc_bimc_sysnoc_axi_clk")||("&clk"=="gcc_emac_tbu_axi_clk")||("&clk"=="gcc_eth_axi_clk")||("&clk"=="gcc_imem_axi_clk")||("&clk"=="gcc_lpass_q6_axis_clk")||("&clk"=="gcc_lpass_sway_clk")||("&clk"=="gcc_pcie_0_mstr_axi_clk")||("&clk"=="gcc_pcie_0_slv_axi_clk")||("&clk"=="gcc_pcie_tbu_clk")||("&clk"=="gcc_qdss_etr_usb_clk")||("&clk"=="gcc_snoc_bus_timeout1_ahb_clk")||("&clk"=="gcc_snoc_bus_timeout2_ahb_clk")||("&clk"=="gcc_spdm_snoc_cy_clk")||("&clk"=="gcc_sys_noc_axi_clk")||("&clk"=="gcc_sys_noc_lpass_clk")||("&clk"=="gcc_sys_noc_tprb_clk")||("&clk"=="gcc_sys_noc_wcss_clk")||("&clk"=="gcc_wcss_ahb_s0_clk")||("&clk"=="gcc_wcss_axi_m_clk")||("&clk"=="gcc_wcss_ecahb_clk")||("&clk"=="gcc_wcss_shdreg_ahb_clk")||("&clk"=="gcc_wcss_tbu_clk")||("&clk"=="gcc_wdsp_q6ss_axim_clk")||("&clk"=="gcc_wdsp_xpu_clk")
  (
    gosub PRINT_SET_CLOCK_FREQ_WARNING

    &clk_cmd_rcgr_addr=&HWIO_GCC_SYSTEM_NOC_BFDCD_CMD_RCGR_ADDR
    &clk_cfg_rcgr_addr=&HWIO_GCC_SYSTEM_NOC_BFDCD_CFG_RCGR_ADDR

    print "Choose frequency (MHz) from list below: " 

    print "19.2           50.0           100.0          " 
    print "200.0          266.666667     " 

    print " "
    print "Enter desired frequency (r to return): "
    enter &clk_desired_freq
    print " "

    if ("&clk_desired_freq"=="19.2")
    (
      &clk_src_name="XO"
      &clk_src_sel=SRC_SEL TODO.
      &clk_src_div=2.
      &clk_m_val=0.
      &clk_n_val=0.
      &clk_2d_val=0.
      
      gosub Set_Clock_Freq
      return
    )
    else if ("&clk_desired_freq"=="50.0")
    (
      &clk_src_name="GPLL0_OUT_MAIN"
      &clk_src_sel=SRC_SEL TODO.
      &clk_src_div=32.
      &clk_m_val=0.
      &clk_n_val=0.
      &clk_2d_val=0.
      
      gosub Set_Clock_Freq
      return
    )
    else if ("&clk_desired_freq"=="100.0")
    (
      &clk_src_name="GPLL0_OUT_MAIN"
      &clk_src_sel=SRC_SEL TODO.
      &clk_src_div=16.
      &clk_m_val=0.
      &clk_n_val=0.
      &clk_2d_val=0.
      
      gosub Set_Clock_Freq
      return
    )
    else if ("&clk_desired_freq"=="200.0")
    (
      &clk_src_name="GPLL0_OUT_MAIN"
      &clk_src_sel=SRC_SEL TODO.
      &clk_src_div=8.
      &clk_m_val=0.
      &clk_n_val=0.
      &clk_2d_val=0.
      
      gosub Set_Clock_Freq
      return
    )
    else if ("&clk_desired_freq"=="266.666667")
    (
      &clk_src_name="GPLL0_OUT_MAIN"
      &clk_src_sel=SRC_SEL TODO.
      &clk_src_div=6.
      &clk_m_val=0.
      &clk_n_val=0.
      &clk_2d_val=0.
      
      gosub Set_Clock_Freq
      return
    )
    else if ("&clk_desired_freq"=="r")
    (
      return
    )
    else
    (
      print "Invalid selection."
      goto Set_Clock_Freq_Enter
    )
  )

  if ("&clk"=="gcc_usb20_mock_utmi_clk")
  (
    gosub PRINT_SET_CLOCK_FREQ_WARNING

    &clk_cmd_rcgr_addr=&HWIO_GCC_USB20_MOCK_UTMI_CMD_RCGR_ADDR
    &clk_cfg_rcgr_addr=&HWIO_GCC_USB20_MOCK_UTMI_CFG_RCGR_ADDR

    print "Choose frequency (MHz) from list below: " 

    print "19.2           " 

    print " "
    print "Enter desired frequency (r to return): "
    enter &clk_desired_freq
    print " "

    if ("&clk_desired_freq"=="19.2")
    (
      &clk_src_name="XO"
      &clk_src_sel=SRC_SEL TODO.
      &clk_src_div=2.
      &clk_m_val=0.
      &clk_n_val=0.
      &clk_2d_val=0.
      
      gosub Set_Clock_Freq
      return
    )
    else if ("&clk_desired_freq"=="r")
    (
      return
    )
    else
    (
      print "Invalid selection."
      goto Set_Clock_Freq_Enter
    )
  )

  if ("&clk"=="gcc_pcnoc_bus_timeout11_ahb_clk")||("&clk"=="gcc_pcnoc_usb3_clk")||("&clk"=="gcc_sys_noc_usb3_clk")||("&clk"=="gcc_usb30_master_clk")||("&clk"=="gcc_usb3_tbu_axi_clk")
  (
    gosub PRINT_SET_CLOCK_FREQ_WARNING

    &clk_cmd_rcgr_addr=&HWIO_GCC_USB30_MASTER_CMD_RCGR_ADDR
    &clk_cfg_rcgr_addr=&HWIO_GCC_USB30_MASTER_CFG_RCGR_ADDR

    print "Choose frequency (MHz) from list below: " 

    print "19.2           100.0          200.0          " 
    print "266.666667     " 

    print " "
    print "Enter desired frequency (r to return): "
    enter &clk_desired_freq
    print " "

    if ("&clk_desired_freq"=="19.2")
    (
      &clk_src_name="XO"
      &clk_src_sel=SRC_SEL TODO.
      &clk_src_div=2.
      &clk_m_val=0.
      &clk_n_val=0.
      &clk_2d_val=0.
      
      gosub Set_Clock_Freq
      return
    )
    else if ("&clk_desired_freq"=="100.0")
    (
      &clk_src_name="GPLL0_OUT_MAIN"
      &clk_src_sel=SRC_SEL TODO.
      &clk_src_div=16.
      &clk_m_val=0.
      &clk_n_val=0.
      &clk_2d_val=0.
      
      gosub Set_Clock_Freq
      return
    )
    else if ("&clk_desired_freq"=="200.0")
    (
      &clk_src_name="GPLL0_OUT_MAIN"
      &clk_src_sel=SRC_SEL TODO.
      &clk_src_div=8.
      &clk_m_val=0.
      &clk_n_val=0.
      &clk_2d_val=0.
      
      gosub Set_Clock_Freq
      return
    )
    else if ("&clk_desired_freq"=="266.666667")
    (
      &clk_src_name="GPLL0_OUT_MAIN"
      &clk_src_sel=SRC_SEL TODO.
      &clk_src_div=6.
      &clk_m_val=0.
      &clk_n_val=0.
      &clk_2d_val=0.
      
      gosub Set_Clock_Freq
      return
    )
    else if ("&clk_desired_freq"=="r")
    (
      return
    )
    else
    (
      print "Invalid selection."
      goto Set_Clock_Freq_Enter
    )
  )

  if ("&clk"=="gcc_usb30_mock_utmi_clk")
  (
    gosub PRINT_SET_CLOCK_FREQ_WARNING

    &clk_cmd_rcgr_addr=&HWIO_GCC_USB30_MOCK_UTMI_CMD_RCGR_ADDR
    &clk_cfg_rcgr_addr=&HWIO_GCC_USB30_MOCK_UTMI_CFG_RCGR_ADDR

    print "Choose frequency (MHz) from list below: " 

    print "19.2           " 

    print " "
    print "Enter desired frequency (r to return): "
    enter &clk_desired_freq
    print " "

    if ("&clk_desired_freq"=="19.2")
    (
      &clk_src_name="XO"
      &clk_src_sel=SRC_SEL TODO.
      &clk_src_div=2.
      &clk_m_val=0.
      &clk_n_val=0.
      &clk_2d_val=0.
      
      gosub Set_Clock_Freq
      return
    )
    else if ("&clk_desired_freq"=="r")
    (
      return
    )
    else
    (
      print "Invalid selection."
      goto Set_Clock_Freq_Enter
    )
  )

  if ("&clk"=="gcc_usb3_phy_aux_clk")
  (
    gosub PRINT_SET_CLOCK_FREQ_WARNING

    &clk_cmd_rcgr_addr=&HWIO_GCC_USB3_PHY_AUX_CMD_RCGR_ADDR
    &clk_cfg_rcgr_addr=&HWIO_GCC_USB3_PHY_AUX_CFG_RCGR_ADDR

    print "Choose frequency (MHz) from list below: " 

    print "1.2            " 

    print " "
    print "Enter desired frequency (r to return): "
    enter &clk_desired_freq
    print " "

    if ("&clk_desired_freq"=="1.2")
    (
      &clk_src_name="XO"
      &clk_src_sel=SRC_SEL TODO.
      &clk_src_div=32.
      &clk_m_val=0.
      &clk_n_val=0.
      &clk_2d_val=0.
      
      gosub Set_Clock_Freq
      return
    )
    else if ("&clk_desired_freq"=="r")
    (
      return
    )
    else
    (
      print "Invalid selection."
      goto Set_Clock_Freq_Enter
    )
  )

  if ("&clk"=="gcc_pcnoc_bus_timeout10_ahb_clk")||("&clk"=="gcc_pcnoc_usb2_clk")||("&clk"=="gcc_usb_hs_system_clk")
  (
    gosub PRINT_SET_CLOCK_FREQ_WARNING

    &clk_cmd_rcgr_addr=&HWIO_GCC_USB_HS_SYSTEM_CMD_RCGR_ADDR
    &clk_cfg_rcgr_addr=&HWIO_GCC_USB_HS_SYSTEM_CFG_RCGR_ADDR

    print "Choose frequency (MHz) from list below: " 

    print "19.2           80.0           100.0          " 
    print "133.333333     177.777778     " 

    print " "
    print "Enter desired frequency (r to return): "
    enter &clk_desired_freq
    print " "

    if ("&clk_desired_freq"=="19.2")
    (
      &clk_src_name="XO"
      &clk_src_sel=SRC_SEL TODO.
      &clk_src_div=2.
      &clk_m_val=0.
      &clk_n_val=0.
      &clk_2d_val=0.
      
      gosub Set_Clock_Freq
      return
    )
    else if ("&clk_desired_freq"=="80.0")
    (
      &clk_src_name="GPLL0_OUT_MAIN"
      &clk_src_sel=SRC_SEL TODO.
      &clk_src_div=20.
      &clk_m_val=0.
      &clk_n_val=0.
      &clk_2d_val=0.
      
      gosub Set_Clock_Freq
      return
    )
    else if ("&clk_desired_freq"=="100.0")
    (
      &clk_src_name="GPLL0_OUT_MAIN"
      &clk_src_sel=SRC_SEL TODO.
      &clk_src_div=16.
      &clk_m_val=0.
      &clk_n_val=0.
      &clk_2d_val=0.
      
      gosub Set_Clock_Freq
      return
    )
    else if ("&clk_desired_freq"=="133.333333")
    (
      &clk_src_name="GPLL0_OUT_MAIN"
      &clk_src_sel=SRC_SEL TODO.
      &clk_src_div=12.
      &clk_m_val=0.
      &clk_n_val=0.
      &clk_2d_val=0.
      
      gosub Set_Clock_Freq
      return
    )
    else if ("&clk_desired_freq"=="177.777778")
    (
      &clk_src_name="GPLL0_OUT_MAIN"
      &clk_src_sel=SRC_SEL TODO.
      &clk_src_div=9.
      &clk_m_val=0.
      &clk_n_val=0.
      &clk_2d_val=0.
      
      gosub Set_Clock_Freq
      return
    )
    else if ("&clk_desired_freq"=="r")
    (
      return
    )
    else
    (
      print "Invalid selection."
      goto Set_Clock_Freq_Enter
    )
  )

  if ("&clk"=="gcc_mdss_vsync_clk")
  (
    gosub PRINT_SET_CLOCK_FREQ_WARNING

    &clk_cmd_rcgr_addr=&HWIO_GCC_VSYNC_CMD_RCGR_ADDR
    &clk_cfg_rcgr_addr=&HWIO_GCC_VSYNC_CFG_RCGR_ADDR

    print "Choose frequency (MHz) from list below: " 

    print "19.2           " 

    print " "
    print "Enter desired frequency (r to return): "
    enter &clk_desired_freq
    print " "

    if ("&clk_desired_freq"=="19.2")
    (
      &clk_src_name="XO"
      &clk_src_sel=SRC_SEL TODO.
      &clk_src_div=2.
      &clk_m_val=0.
      &clk_n_val=0.
      &clk_2d_val=0.
      
      gosub Set_Clock_Freq
      return
    )
    else if ("&clk_desired_freq"=="r")
    (
      return
    )
    else
    (
      print "Invalid selection."
      goto Set_Clock_Freq_Enter
    )
  )

  if ("&clk"=="gcc_wdsp_q6ss_aon_clk")
  (
    gosub PRINT_SET_CLOCK_FREQ_WARNING

    &clk_cmd_rcgr_addr=&HWIO_GCC_WDSP_Q6SS_AON_CMD_RCGR_ADDR
    &clk_cfg_rcgr_addr=&HWIO_GCC_WDSP_Q6SS_AON_CFG_RCGR_ADDR

    print "Choose frequency (MHz) from list below: " 

    print "100.0          200.0          266.666667     " 

    print " "
    print "Enter desired frequency (r to return): "
    enter &clk_desired_freq
    print " "

    if ("&clk_desired_freq"=="100.0")
    (
      &clk_src_name="GPLL0_OUT_MAIN"
      &clk_src_sel=SRC_SEL TODO.
      &clk_src_div=16.
      &clk_m_val=0.
      &clk_n_val=0.
      &clk_2d_val=0.
      
      gosub Set_Clock_Freq
      return
    )
    else if ("&clk_desired_freq"=="200.0")
    (
      &clk_src_name="GPLL0_OUT_MAIN"
      &clk_src_sel=SRC_SEL TODO.
      &clk_src_div=8.
      &clk_m_val=0.
      &clk_n_val=0.
      &clk_2d_val=0.
      
      gosub Set_Clock_Freq
      return
    )
    else if ("&clk_desired_freq"=="266.666667")
    (
      &clk_src_name="GPLL0_OUT_MAIN"
      &clk_src_sel=SRC_SEL TODO.
      &clk_src_div=6.
      &clk_m_val=0.
      &clk_n_val=0.
      &clk_2d_val=0.
      
      gosub Set_Clock_Freq
      return
    )
    else if ("&clk_desired_freq"=="r")
    (
      return
    )
    else
    (
      print "Invalid selection."
      goto Set_Clock_Freq_Enter
    )
  )

  if ("&clk"=="gcc_wdsp_q6ss_qos_clk")
  (
    gosub PRINT_SET_CLOCK_FREQ_WARNING

    &clk_cmd_rcgr_addr=&HWIO_GCC_WDSP_Q6SS_QOS_CMD_RCGR_ADDR
    &clk_cfg_rcgr_addr=&HWIO_GCC_WDSP_Q6SS_QOS_CFG_RCGR_ADDR

    print "Choose frequency (MHz) from list below: " 

    print "133.333333     " 

    print " "
    print "Enter desired frequency (r to return): "
    enter &clk_desired_freq
    print " "

    if ("&clk_desired_freq"=="133.333333")
    (
      &clk_src_name="GPLL0_OUT_MAIN"
      &clk_src_sel=SRC_SEL TODO.
      &clk_src_div=12.
      &clk_m_val=0.
      &clk_n_val=0.
      &clk_2d_val=0.
      
      gosub Set_Clock_Freq
      return
    )
    else if ("&clk_desired_freq"=="r")
    (
      return
    )
    else
    (
      print "Invalid selection."
      goto Set_Clock_Freq_Enter
    )
  )


  return

