
;============================================================================
;
; *************** THIS SCRIPT WAS AUTOGENERATED ****************
;
; TARGET
;
;
; SCRIPT
;   TESTPLL.CMM
;
; GENERAL DESCRIPTION
;   This script can be used to lookup PLL config/status/frequency values.
;
; FUNCTIONS
;   N/A
;
;    Copyright (c) 2018 by QUALCOMM Technologies Inc.  All Rights Reserved.
;============================================================================


;-----------------------------------------------------------------------------
; Local variables
;-----------------------------------------------------------------------------

local &clk_err
local &success
local &chipset_name
local &testpll_main_area
local &log_filename
local &logging

local &subscript
local &pre_div
local &post_div
local &access_mode

; PLLs available in this version of the script
local &pll0
local &pll1
local &pll2
local &bpll
local &pll3
local &pll4
local &pll5
local &pll6


;-----------------------------------------------------------------------------
; Go initialize constants
;-----------------------------------------------------------------------------

goto Init_Constants
Init_Constants_Done:


;-----------------------------------------------------------------------------
; Parse commandline arguments
;-----------------------------------------------------------------------------

; These arguments are passed in from testclock.cmm to enable a PLL
&testpll_cmd_arg0=""
&testpll_cmd_arg1=""

ENTRY &testpll_cmd_arg0 &testpll_cmd_arg1

if ("&testpll_cmd_arg0"=="on")||("&testpll_cmd_arg0"=="off")
(
  &pll_on_off_choice="&testpll_cmd_arg0"
  &pll_name_choice="&testpll_cmd_arg1"
  
  gosub Enable_Disable_PLL
  
  ; Nothing else to be done
  goto SCRIPT_END
)

;-----------------------------------------------------------------------------
; Define the window
;-----------------------------------------------------------------------------

; Check if testpll was invoked by another script ('super_script_area' mode).
&testpll_main_area=string.ScanAndExtract("&testpll_cmd_arg0", "super_script_area=", "TESTPLL")

; Create new areas.
if ("&testpll_main_area"=="TESTPLL")
(
  &subscript=0
  gosub wa_area_create_list 1 &testpll_main_area 180. 1000.
  entry &success

  if (&success==0)
  (
    area.select
    print %ERROR "ERROR: Failed to create areas for testclock.cmm."
    enddo FALSE()
  )
)
else
(
  &subscript=1
)

; Create a new window if needed.
if (WIN.EXIST("testpll_main_window")==FALSE())
(
  local &x_start
  local &y_start
  local &x_len
  local &y_len

  ; Check if there are previously saved window settings.
  gosub wa_find_saved_window_settings testpll_main_window
  entry &x_start &y_start &x_len &y_len

  if (&x_start!=-1)
  (
    ; Use the previous window settings.
    winpos &x_start &y_start &x_len &y_len 0. 0. testpll_main_window
  )
  else
  (
    gosub Default_WINPOS_Main
  )
)

AREA.view &testpll_main_area
AREA.Select &testpll_main_area


;-----------------------------------------------------------------------------
; Generic Top-Level Error Handler
;-----------------------------------------------------------------------------

on ERROR gosub
(
  print %ERROR "ERROR: Caught error in 'testpll.cmm'."
  return
)


;-----------------------------------------------------------------------------
; Main Menu
;-----------------------------------------------------------------------------

print " "
print " "
print "[-------------------- [&chipset_name] TEST PLL --------------------]"
print " "

gosub Display_Help  ; print help message upon launch

&logging=0

Main_Loop:
(
  print " "
  print "[testpll.cmm] Version: <04/30/2015>" 
  print "Enter command (? for help):"
  enter &choice
  print " "

  gosub wa_save_window_settings testpll_main_window

  if ("&choice"=="?")
  (
    gosub Display_Help
  )
  else if ("&choice"=="x")
  (
    winclear testpll_main_window

    if (&logging!=0)
    (
      area.close &testpll_main_area
    )

    area.select   ; select default area

    print "Exited [&chipset_name] 'testpll.cmm'."
    enddo TRUE()
  )
  else if ("&choice"=="log")
  (
    gosub Open_Output_Log
  )
  else if ("&choice"=="wr")
  (
    ; Reset the window size/position to default settings.
    winclear testpll_main_window

    gosub Default_WINPOS_Main
    area.view &testpll_main_area
  )
  else if ("&choice"=="1")
  (
    gosub Display_Configurations
  )
  else if ("&choice"=="2")
  (
    gosub Display_Votes
  )
  else if ("&choice"=="3")
  (
    gosub Display_Dump
  )
  else if ("&choice"=="4")
  (
    gosub Configure_PLL_Enter
  )
  else if ("&choice"=="5")
  (
    gosub Enable_Disable_PLL_Enter
  )
  else if ("&choice"=="6")
  (
    gosub Route_PLL_To_Pad
  )
  else
  (
    print %ERROR "ERROR: Invalid command '&choice'. Enter '?' for help."
  )

  goto Main_Loop
)

Display_Help:
(
  print " "
  print "*** Commands ***"
  print " "
  print " 1   : Configurations."
  print " 2   : Votes."
  print " 3   : Register Dump."
  print " 4   : Configure PLLs.         [beta]"
  print " 5   : Turn PLLs on/off.       [beta]"
  print " 6   : Route PLLs to test pad. [beta]"
  print " "
  print " log : Start logging output to a file."
  print " x   : Exit."
  print " wr  : Reset window size/position."
  print " "

  return
)

Default_WINPOS_Main:
(
  winpos 0. 0. 50% 100% 0. 0. testpll_main_window
  return
)

;
; Begins logging output to a file.
;
Open_Output_Log:
(
  ; Check if an output log is already open.
  if (&logging==0)
  (
    print "Enter log file [c:\temp\testpll.log]: "
    enter &log_filename

    if ("&log_filename"=="")
    (
      &log_filename="c:\temp\testpll.log"
    )
    print "Logging output to '&log_filename'."

    ; Open the output log.
    (
      ON ERROR gosub
      (
        print %ERROR "ERROR: Failed to open clock output log '&log_filename'."
        &clk_err="failed_to_open_output_log"
        return
      )

      &clk_err=""
      area.open &testpll_main_area &log_filename
    )

    if ("&clk_err"!="failed_to_open_output_log")
    (
      &logging=1
    )
  )
  else
  (
    ; Does not currently support multiple output logs per single session.
    print "Already logging output to '&log_filename'. The log will close upon 'x' exit."
  )

  return
)

;-----------------------------------------------------------------------------
; Initialize constants
;-----------------------------------------------------------------------------

Init_Constants:

  ; Chipset Name
  &chipset_name="qcs405"

  ; Access mode
  &access_mode="ezaxi"

  ; L, M, N, ALPHA, ALPHA_U mask values
  &HWIO_PLL_L_VAL_MASK=0xFFFF
  &HWIO_PLL_M_VAL_MASK=0x7FFFF
  &HWIO_PLL_N_VAL_MASK=0x7FFFF
  &HWIO_PLL_ALPHA_VAL_MASK=0xFFFFFFFF
  &HWIO_PLL_ALPHA_U_VAL_MASK=0xFF

  ; PLL vote registers
  &HWIO_GCC_APCS_HYP_GPLL_ENA_VOTE_ADDR=0x1861000
  &HWIO_GCC_WDSP_GPLL_ENA_VOTE_ADDR=0x1870000
  &HWIO_GCC_LPASS_DSP_GPLL_ENA_VOTE_ADDR=0x1873010
  &HWIO_GCC_CDSP_GPLL_ENA_VOTE_ADDR=0x181b000
  &HWIO_GCC_SPARE_GPLL_ENA_VOTE_ADDR=0x1800000
  &HWIO_GCC_APCS_GPLL_ENA_VOTE_ADDR=0x1845000
  &HWIO_GCC_APCS_TZ_GPLL_ENA_VOTE_ADDR=0x1813010
  &HWIO_GCC_RPM_GPLL_ENA_VOTE_ADDR=0x1836000

  ; GPLL0 registers
  &HWIO_GCC_GPLL0_MODE_ADDR=0x1821000
  &HWIO_GCC_GPLL0_L_VAL_ADDR=0x1821004
  &HWIO_GCC_GPLL0_ALPHA_VAL_ADDR=0x1821008
  &HWIO_GCC_GPLL0_ALPHA_VAL_U_ADDR=0x182100c
  &HWIO_GCC_GPLL0_USER_CTL_ADDR=0x1821010
  &HWIO_GCC_GPLL0_USER_CTL_U_ADDR=0x1821014
  &HWIO_GCC_GPLL0_CONFIG_CTL_ADDR=0x1821018
  &HWIO_GCC_GPLL0_TEST_CTL_ADDR=0x182101c
  &HWIO_GCC_GPLL0_TEST_CTL_U_ADDR=0x1821020
  &HWIO_GCC_GPLL0_STATUS_ADDR=0x1821024

  ; GPLL1 registers
  &HWIO_GCC_GPLL1_MODE_ADDR=0x1820000
  &HWIO_GCC_GPLL1_L_VAL_ADDR=0x1820004
  &HWIO_GCC_GPLL1_ALPHA_VAL_ADDR=0x1820008
  &HWIO_GCC_GPLL1_ALPHA_VAL_U_ADDR=0x182000c
  &HWIO_GCC_GPLL1_USER_CTL_ADDR=0x1820010
  &HWIO_GCC_GPLL1_USER_CTL_U_ADDR=0x1820014
  &HWIO_GCC_GPLL1_CONFIG_CTL_ADDR=0x1820018
  &HWIO_GCC_GPLL1_TEST_CTL_ADDR=0x182001c
  &HWIO_GCC_GPLL1_TEST_CTL_U_ADDR=0x1820020
  &HWIO_GCC_GPLL1_STATUS_ADDR=0x1820024

  ; GPLL3 registers
  &HWIO_GCC_GPLL3_MODE_ADDR=0x1822000
  &HWIO_GCC_GPLL3_L_VAL_ADDR=0x1822004
  &HWIO_GCC_GPLL3_ALPHA_VAL_ADDR=0x1822008
  &HWIO_GCC_GPLL3_ALPHA_VAL_U_ADDR=0x182200c
  &HWIO_GCC_GPLL3_USER_CTL_ADDR=0x1822010
  &HWIO_GCC_GPLL3_USER_CTL_U_ADDR=0x1822014
  &HWIO_GCC_GPLL3_CONFIG_CTL_ADDR=0x1822018
  &HWIO_GCC_GPLL3_TEST_CTL_ADDR=0x182201c
  &HWIO_GCC_GPLL3_TEST_CTL_U_ADDR=0x1822020
  &HWIO_GCC_GPLL3_STATUS_ADDR=0x1822024

  ; GPLL4 registers
  &HWIO_GCC_GPLL4_MODE_ADDR=0x1824000
  &HWIO_GCC_GPLL4_L_VAL_ADDR=0x1824004
  &HWIO_GCC_GPLL4_ALPHA_VAL_ADDR=0x1824008
  &HWIO_GCC_GPLL4_ALPHA_VAL_U_ADDR=0x182400c
  &HWIO_GCC_GPLL4_USER_CTL_ADDR=0x1824010
  &HWIO_GCC_GPLL4_USER_CTL_U_ADDR=0x1824014
  &HWIO_GCC_GPLL4_CONFIG_CTL_ADDR=0x1824018
  &HWIO_GCC_GPLL4_TEST_CTL_ADDR=0x182401c
  &HWIO_GCC_GPLL4_TEST_CTL_U_ADDR=0x1824020
  &HWIO_GCC_GPLL4_STATUS_ADDR=0x1824024

  ; GPLL5 registers
  &HWIO_GCC_GPLL5_MODE_ADDR=0x1825000
  &HWIO_GCC_GPLL5_L_VAL_ADDR=0x1825004
  &HWIO_GCC_GPLL5_M_VAL_ADDR=0x1825008
  &HWIO_GCC_GPLL5_N_VAL_ADDR=0x182500c
  &HWIO_GCC_GPLL5_USER_CTL_ADDR=0x1825010
  &HWIO_GCC_GPLL5_CONFIG_CTL_ADDR=0x1825014
  &HWIO_GCC_GPLL5_TEST_CTL_ADDR=0x1825018
  &HWIO_GCC_GPLL5_STATUS_ADDR=0x182501c

  ; GPLL6 registers
  &HWIO_GCC_GPLL6_MODE_ADDR=0x1837000
  &HWIO_GCC_GPLL6_L_VAL_ADDR=0x1837004
  &HWIO_GCC_GPLL6_M_VAL_ADDR=0x1837008
  &HWIO_GCC_GPLL6_N_VAL_ADDR=0x183700c
  &HWIO_GCC_GPLL6_USER_CTL_ADDR=0x1837010
  &HWIO_GCC_GPLL6_CONFIG_CTL_ADDR=0x1837014
  &HWIO_GCC_GPLL6_TEST_CTL_ADDR=0x1837018
  &HWIO_GCC_GPLL6_STATUS_ADDR=0x183701c

  ; BIMC_PLL registers
  &HWIO_GCC_BIMC_PLL_MODE_ADDR=0x1823000
  &HWIO_GCC_BIMC_PLL_L_VAL_ADDR=0x1823004
  &HWIO_GCC_BIMC_PLL_M_VAL_ADDR=0x1823008
  &HWIO_GCC_BIMC_PLL_N_VAL_ADDR=0x182300c
  &HWIO_GCC_BIMC_PLL_USER_CTL_ADDR=0x1823010
  &HWIO_GCC_BIMC_PLL_CONFIG_CTL_ADDR=0x1823014
  &HWIO_GCC_BIMC_PLL_TEST_CTL_ADDR=0x1823018
  &HWIO_GCC_BIMC_PLL_STATUS_ADDR=0x182301c

  goto Init_Constants_Done


;-----------------------------------------------------------------------------
; Calculate Pre-div and Post-Div for SR PLLs; where
; Pre-Div  [14:12]
; Post-Div [9:8]
;-----------------------------------------------------------------------------

Calculate_Pre_Post_Div_SR:

  if (&user_ctl_val&0x7000)==0x0000
    &pre_div=1
  else if (&user_ctl_val&0x7000)==0x1000
    &pre_div=2
  else if (&user_ctl_val&0x7000)==0x2000
    &pre_div=3
  else if (&user_ctl_val&0x7000)==0x3000
    &pre_div=4
  else if (&user_ctl_val&0x7000)==0x4000
    &pre_div=5
  else if (&user_ctl_val&0x7000)==0x5000
    &pre_div=6
  else if (&user_ctl_val&0x7000)==0x6000
    &pre_div=7
  else
    &pre_div=8

  if (&user_ctl_val&0x300)==0x000
    &post_div=1
  else if (&user_ctl_val&0x300)==0x100
    &post_div=2
  else
    &post_div=4

  return


;-----------------------------------------------------------------------------
; Calculate Pre-div and Post-Div for SR2/HF PLLs; where
; Pre-Div  [12]
; Post-Div [9:8]
;-----------------------------------------------------------------------------

Calculate_Pre_Post_Div_SR2_HF:

  if (&user_ctl_val&0x1000)==0x0000
    &pre_div=1
  else
    &pre_div=2

  if (&user_ctl_val&0x300)==0x000
    &post_div=1
  else if (&user_ctl_val&0x300)==0x100
    &post_div=2
  else
    &post_div=4

  return


;-----------------------------------------------------------------------------
; Calculate Pre-div and Post-Div for PRIUS/TESLA PLLs; where
; Pre-Div  [??]
; Post-Div [??]
;-----------------------------------------------------------------------------

Calculate_Pre_Post_Div_PRIUS_TESLA:

  if (&user_ctl_val&0x7000)==0x1000
    &pre_div=2
  else
    &pre_div=1
  
  if (&user_ctl_val&0xF00)==0x100
    &post_div=2
  else if (&user_ctl_val&0xF00)==0x300
    &post_div=4
  else if (&user_ctl_val&0xF00)==0x700
    &post_div=8
  else if (&user_ctl_val&0xF00)==0xF00
    &post_div=16
  else
    &post_div=1

  return



;-----------------------------------------------------------------------------
; Display the PLL settings
;-----------------------------------------------------------------------------

Display_PLL:

  ENTRY &pll_name &pll_num &pll_type &mode_reg &l_reg &alpha_reg &alpha_u_reg &m_reg &n_reg &user_ctl_reg &status_reg &clk_ref

  local &mode_val
  local &l_val
  local &alpha_val
  local &alpha_u_val
  local &m_val
  local &n_val
  local &user_ctl_val
  local &user_ctl_u_val
  local &status_val
  local &pll_state
  local &pll_votable
  local &pll_main
  local &pll_test
  local &pll_aux
  local &pll_aux2
  local &pll_early
  local &pll_freq
  local &alpha_combined_hex
  local &alpha_divisor
  local &alpha_float
  local &pll_num_formatted
  local &pll_name_formatted

  &mode_val=data.long(&access_mode:&mode_reg)
  &l_val=data.long(&access_mode:&l_reg)&(&HWIO_PLL_L_VAL_MASK)

  ; Get m value
  if (&m_reg!=0)
    &m_val=data.long(&access_mode:&m_reg)&(&HWIO_PLL_M_VAL_MASK)
  else
    &m_val=0

  ; Get n value
  if (&n_reg!=0)
  (
    &n_val=data.long(&access_mode:&n_reg)&(&HWIO_PLL_N_VAL_MASK)
    if &n_val==0
      &n_val=1
  )
  else
    &n_val=0

  ; Get alpha value
  if (&alpha_reg!=0)
    &alpha_val=data.long(&access_mode:&alpha_reg)&(&HWIO_PLL_ALPHA_VAL_MASK)
  else
    &alpha_val=0

  ; Get alpha_u value
  if (&alpha_u_reg!=0)
    &alpha_u_val=data.long(&access_mode:&alpha_u_reg)&(&HWIO_PLL_ALPHA_U_VAL_MASK)
  else
    &alpha_u_val=0

  &status_val=data.long(&access_mode:&status_reg)
  &user_ctl_val=data.long(&access_mode:&user_ctl_reg)

 ; Check for ON/OFF status
  if (&mode_val&0x80000000)==0x80000000
    &pll_state="ON "
  else
    &pll_state="OFF"

 ; Check the status register for sr/sr2 PLLs' ON/OFF status 
  if (("&pll_type"=="sr_pll")||("&pll_type"=="sr2_pll"))
  (
    if (&status_val&0x10000)==0x10000
      &pll_state="ON "
    else
      &pll_state="OFF"
  )

  ; Check for FSM mode
  if (&mode_val&0x100000)==0x100000
    &pll_votable="YES"
  else
    &pll_votable="NO "

  ; Check for test output
  if (&user_ctl_val&0x10)==0x10
    &pll_test="ON "
  else
    &pll_test="OFF"

  ; Check for early output
  if (&user_ctl_val&0x08)==0x08
    &pll_early="ON "
  else
    &pll_early="OFF"

  ; Check for aux2 output
  if (&user_ctl_val&0x04)==0x04
    &pll_aux2="ON "
  else
    &pll_aux2="OFF"

  ; Check for aux output
  if (&user_ctl_val&0x02)==0x02
    &pll_aux="ON "
  else
    &pll_aux="OFF"

 ; Check for main output
  if (&user_ctl_val&0x01)==0x01
    &pll_main="ON "
  else
    &pll_main="OFF"

  ; Check pre-div and post-div
  if ("&pll_type"=="sr_pll")
  (
    gosub Calculate_Pre_Post_Div_SR
  )
  else if ("&pll_type"=="sr2_pll")||("&pll_type"=="hf_pll")
  (
    gosub Calculate_Pre_Post_Div_SR2_HF
  )
  else
  (
    gosub Calculate_Pre_Post_Div_PRIUS_TESLA
  )

  ; Calculate the PLL frequency based on PLL type.
  if (&m_reg!=0)
  (
    &pll_freq=FORMAT.FLOAT(10, 6, (&clk_ref*&l_val+&clk_ref*&m_val/&n_val)/&pre_div/&post_div)
  )
  else
  (
    ; Combine alpha lower + upper
    &alpha_combined_hex=&alpha_val+(&alpha_u_val<<32.)
    &alpha_float=(&alpha_combined_hex*1.0)/((1<<40.)*1.0)

    &pll_freq=FORMAT.FLOAT(10, 6, (&clk_ref/&pre_div)*((&l_val+&alpha_float)/&post_div))
  )

  ; Format the pll num and name strings
  ;&pll_num_formatted=FORMAT.DECIMAL(2., &pll_num)
  &pll_num_formatted=&pll_num

  ;&pll_name_formatted=STRING.CUT("        ", STRING.LEN("&pll_name"))
  ;&pll_name_formatted="&pll_name&pll_name_formatted"
  &pll_name_formatted=&pll_name

  print "&pll_num_formatted  &pll_name_formatted    &pll_state        &pll_votable        &pll_main        &pll_test        &pll_aux        &pll_aux2        &pll_early  &pll_freq"

  return


;-----------------------------------------------------------------------------
; Format dump registers 
;-----------------------------------------------------------------------------

Format_Dump_Registers:

  ENTRY &num &use &mode_reg &user_ctl_reg &user_ctl_u_reg &config_ctl_reg &test_ctl_reg &test_ctl_u_reg &status_reg &l_reg &alpha_reg &alpha_u_reg &m_reg &n_reg

  local &mode_val
  local &user_ctl_val
  local &user_ctl_u_val
  local &config_ctl_val
  local &test_ctl_val
  local &test_ctl_u_val
  local &status_val
  local &l_val
  local &alpha_val
  local &alpha_u_val
  local &m_val
  local &n_val
  local &left_width
  local &temp_string
  local &temp_string_formatted

  ; Format PLL num and use
  &num=FORMAT.DECIMAL(0x2, &num)

  ; Format mode
  &mode_val=FORMAT.HEX(0x8, data.long(&access_mode:&mode_reg))
  &mode_reg=FORMAT.HEX(0x9, &mode_reg)

  ; Format l 
  &l_val=FORMAT.HEX(0x8, data.long(&access_mode:&l_reg))
  &l_reg=FORMAT.HEX(0x9, &l_reg)

  ; Format alpha if the register address is not zero
  if (&alpha_reg!=0)
  (
    &alpha_val=FORMAT.HEX(0x8, data.long(&access_mode:&alpha_reg))
    &alpha_reg=FORMAT.HEX(0x9, &alpha_reg)
  )

  ; Format alpha_u if the register address is not zero
  if (&alpha_u_reg!=0)
  (
    &alpha_u_val=FORMAT.HEX(0x8, data.long(&access_mode:&alpha_u_reg))
    &alpha_u_reg=FORMAT.HEX(0x9, &alpha_u_reg)
  )

  ; Format m if the register address is not zero
  if (&m_reg!=0)
  (
    &m_val=FORMAT.HEX(0x8, data.long(&access_mode:&m_reg))
    &m_reg=FORMAT.HEX(0x9, &m_reg)
  )

  ; Format n if the register address is not zero
  if (&n_reg!=0)
  (
    &n_val=FORMAT.HEX(0x8, data.long(&access_mode:&n_reg))
    &n_reg=FORMAT.HEX(0x9, &n_reg)
  )

  ; Format user_ctl
  &user_ctl_val=FORMAT.HEX(0x8, data.long(&access_mode:&user_ctl_reg))
  &user_ctl_reg=FORMAT.HEX(0x9, &user_ctl_reg)

  ; Format user_ctl_u if the register address is not zero
  if (&user_ctl_u_reg!=0)
  (
    &user_ctl_u_val=FORMAT.HEX(0x8, data.long(&access_mode:&user_ctl_u_reg))
    &user_ctl_u_reg=FORMAT.HEX(0x9, &user_ctl_u_reg)
  )

  ; Format config_ctl
  &config_ctl_val=FORMAT.HEX(0x8, data.long(&access_mode:&config_ctl_reg))
  &config_ctl_reg=FORMAT.HEX(0x9, &config_ctl_reg)

  ; Format test_ctl
  &test_ctl_val=FORMAT.HEX(0x8, data.long(&access_mode:&test_ctl_reg))
  &test_ctl_reg=FORMAT.HEX(0x9, &test_ctl_reg)

  ; Format test_ctl_u if the register address is not zero
  if (&test_ctl_u_reg!=0)
  (
    &test_ctl_u_val=FORMAT.HEX(0x8, data.long(&access_mode:&test_ctl_u_reg))
    &test_ctl_u_reg=FORMAT.HEX(0x9, &test_ctl_u_reg)
  )

  ; Format status
  &status_val=FORMAT.HEX(0x8, data.long(&access_mode:&status_reg))
  &status_reg=FORMAT.HEX(0x9, &status_reg)

  &left_width="                                     "

  print "__________________________________________________________________"
  &temp_string="[PLL&num : &use]"
  &temp_string_formatted=STRING.CUT("&left_width", STRING.LEN("&temp_string"))
  &temp_string_formatted="&temp_string&temp_string_formatted"
  print "&temp_string_formatted | |     Address : Value"

  &temp_string="MODE"
  &temp_string_formatted=STRING.CUT("&left_width", STRING.LEN("&temp_string"))
  &temp_string_formatted="&temp_string_formatted&temp_string"
  print "&temp_string_formatted | | 0x&mode_reg : 0x&mode_val"

  &temp_string="L"
  &temp_string_formatted=STRING.CUT("&left_width", STRING.LEN("&temp_string"))
  &temp_string_formatted="&temp_string_formatted&temp_string"
  print "&temp_string_formatted | | 0x&l_reg : 0x&l_val"

  if (&alpha_reg!=0)
  (
    &temp_string="ALPHA"
    &temp_string_formatted=STRING.CUT("&left_width", STRING.LEN("&temp_string"))
    &temp_string_formatted="&temp_string_formatted&temp_string"
    print "&temp_string_formatted | | 0x&alpha_reg : 0x&alpha_val"
  )

  if (&alpha_u_reg!=0)
  (
    &temp_string="ALPHA_U"
    &temp_string_formatted=STRING.CUT("&left_width", STRING.LEN("&temp_string"))
    &temp_string_formatted="&temp_string_formatted&temp_string"
    print "&temp_string_formatted | | 0x&alpha_u_reg : 0x&alpha_u_val"
  )

  if (&m_reg!=0)
  (
    &temp_string="M"
    &temp_string_formatted=STRING.CUT("&left_width", STRING.LEN("&temp_string"))
    &temp_string_formatted="&temp_string_formatted&temp_string"
    print "&temp_string_formatted | | 0x&m_reg : 0x&m_val"
  )

  if (&n_reg!=0)
  (
    &temp_string="N"
    &temp_string_formatted=STRING.CUT("&left_width", STRING.LEN("&temp_string"))
    &temp_string_formatted="&temp_string_formatted&temp_string"
    print "&temp_string_formatted | | 0x&n_reg : 0x&n_val"
  )

  &temp_string="USER_CTL"
  &temp_string_formatted=STRING.CUT("&left_width", STRING.LEN("&temp_string"))
  &temp_string_formatted="&temp_string_formatted&temp_string"
  print "&temp_string_formatted | | 0x&user_ctl_reg : 0x&user_ctl_val"

  if (&user_ctl_u_reg!=0)
  (
    &temp_string="USER_CTL_U"
    &temp_string_formatted=STRING.CUT("&left_width", STRING.LEN("&temp_string"))
    &temp_string_formatted="&temp_string_formatted&temp_string"
    print "&temp_string_formatted | | 0x&user_ctl_u_reg : 0x&user_ctl_u_val"
  )

  &temp_string="CONFIG_CTL"
  &temp_string_formatted=STRING.CUT("&left_width", STRING.LEN("&temp_string"))
  &temp_string_formatted="&temp_string_formatted&temp_string"
  print "&temp_string_formatted | | 0x&config_ctl_reg : 0x&config_ctl_val"

  &temp_string="TEST_CTL"
  &temp_string_formatted=STRING.CUT("&left_width", STRING.LEN("&temp_string"))
  &temp_string_formatted="&temp_string_formatted&temp_string"
  print "&temp_string_formatted | | 0x&test_ctl_reg : 0x&test_ctl_val"

  if (&test_ctl_u_reg!=0)
  (
    &temp_string="TEST_CTL_U"
    &temp_string_formatted=STRING.CUT("&left_width", STRING.LEN("&temp_string"))
    &temp_string_formatted="&temp_string_formatted&temp_string"
    print "&temp_string_formatted | | 0x&test_ctl_u_reg : 0x&test_ctl_u_val"
  )

  &temp_string="STATUS"
  &temp_string_formatted=STRING.CUT("&left_width", STRING.LEN("&temp_string"))
  &temp_string_formatted="&temp_string_formatted&temp_string"
  print "&temp_string_formatted | | 0x&status_reg : 0x&status_val"

  return



;;;;;;;;;;;;;;;;;;;;;;;;;;;;;;;;;;;;;;;;;;;;;;;;;;;;;;;;;;;;;;;;;;;;;;;;;;;;;;
;
; Lauterbach T32 "Window/Area" Utility Subs:
;
;   bool    wa_does_area_exist ( string area )
;
;   bool    wa_try_area_create ( string area, [int cols, int rows] )
;
;   bool    wa_area_create_list (
;             int num, [string area, int cols, int rows], ... )
;
;   string  wa_get_substr_ws ( string src_str, int read_idx )
;
;   int[4]  wa_extract_stored_win_dim ( string file_name, string window_name )
;
;   bool    wa_save_window_settings ( string window_name, [flag print_error] )
;
;   int[4]  wa_find_saved_window_settings ( string window_name )
;
;   bool    wa_delete_saved_window_settings (
;             string window_name, [flag print_error] )
;
;   bool    wa_delete_saved_window_settings_ext (
;             string window, string script, [flag print_error] )
;
;;;;;;;;;;;;;;;;;;;;;;;;;;;;;;;;;;;;;;;;;;;;;;;;;;;;;;;;;;;;;;;;;;;;;;;;;;;;;;

;
; bool wa_does_area_exist ( string area )
;
; Returns non-zero if the given area currently exists.
;
; SIDE EFFECTS:  Selects the tested area if it exists, or the default area.
;
wa_does_area_exist:
(
  local &area_name
  entry &area_name

  ON ERROR gosub
  (
    ; Clear the error message.
    area.select
    print " "

    &clk_err="!"
    return
  )

  &clk_err=""
  area.select &area_name

  if ("&clk_err"=="")
  (
    return 1
  )
  else
  (
    return 0
  )
)

;
; bool wa_try_area_create ( string area, [int cols, int rows] )
;
; Attempts to create an area (see 'area.create'). Returns non-zero if the 
; area is successfully created. If the 'area.create' operation fails, the
; caller may run 'area.reset' then re-try creating the area. The 'rows' and
; 'cols' arguments can be bypassed by omitting both.
;
; T32 has a maximum number of concurrent areas (only 10 at the time of
; writing this sub). Unfortunately these areas can only be deleted in bulk
; with the highly destructive 'area.reset' (although some T32 documentation
; incorrectly states that 'area.close <area_name>' destroys the area, it
; doesn't--it only closes the area's output logging).
;
; Furthermore, areas aren't destroyed automatically upon script exit, so
; if a user were to run multiple scripts with multiple areas they could
; quickly exhaust the 10-area limit and then find that subsequent script
; launches always fail, potentially with confusing error messages. This
; utility sub is intended to mitigate this risk without having to immidiately
; resort to running a global 'area.reset' during script initialization.
;
wa_try_area_create:
(
  local &area_name
  local &cols
  local &rows

  entry &area_name &cols &rows

  ON ERROR gosub
  (
    &clk_err="!"
    return
  )

  &clk_err=""
  area.create &area_name &cols &rows

  if ("&clk_err"=="")
  (
    return 1
  )
  else
  (
    return 0
  )
)

;
; bool wa_area_create_list ( int num, [string area, int cols, int rows], ... )
;
; Attempts to create a list of areas. Will run the global 'area.reset' command
; upon the first failure, and return 0 upon the second failure. Otherwise
; returns non-zero upon success.
;
wa_area_create_list:
(
  local &success
  local &already_failed
  local &area_name
  local &cols
  local &rows
  local &area_idx
  local &num
  local &input_line
  local &line_idx
  local &area_list_line_idx

  entry %LINE &input_line

  ; Get the number of areas to create.
  gosub wa_get_substr_ws "&input_line" 0.
  entry &num &area_list_line_idx
  if ("&num"=="")
  (
    print %ERROR "ERROR: wa_area_create_list() detected invalid input: '&input_line'."
    return 0
  )

  &already_failed=0

wa_area_create_list_process_areas:

  ; Create each area.
  &area_idx=0
  &line_idx=&area_list_line_idx
  while (&area_idx<&num)
  (
    ; Read in the area information.
    gosub wa_get_substr_ws "&input_line" &line_idx
    entry &area_name &line_idx
    if ("&area_name"=="")
    (
      goto wa_area_create_list_too_few_args
    )
    gosub wa_get_substr_ws "&input_line" &line_idx
    entry &cols &line_idx
    if ("&cols"=="")
    (
      goto wa_area_create_list_too_few_args
    )
    gosub wa_get_substr_ws "&input_line" &line_idx
    entry &rows &line_idx
    if ("&rows"=="")
    (
      goto wa_area_create_list_too_few_args
    )

    ; Check if the row/col argument was bypassed.
    if (("&cols"==",")||("&rows"==","))
    (
      ; Apply a sanity check for row/col bypass.
      if (("&cols"!=",")||("&rows"!=","))
      (
        print %ERROR "ERROR: wa_area_create_list() detected invalid row/col settings for '&area_name'."
        print %ERROR "       Row/col must both be an integer or both be ',' (got row='&row', col='&col'). "
        return 0
      )

      &cols=""
      &rows=""
    )

    ; Attempt to create the area.
    gosub wa_try_area_create &area_name &cols &rows
    entry &success

    if (&success==0)
    (
      ; Already failed => infinite impending failures.
      if (&already_failed!=0)
      (
        print %ERROR %Decimal "ERROR: wa_area_create_list() failed to create &num areas."
        return 0
      )

      ; Delete all areas and try creating the area list once more.
      &already_failed=1
      area.reset
      winclear
      goto wa_area_create_list_process_areas
    )

    &area_idx=&area_idx+1
  )

  return 1

wa_area_create_list_too_few_args:

  print %ERROR "ERROR: wa_area_create_list() detected too few arguments (num_areas='&num')."
  return 0
)

;
; string wa_get_substr_ws ( string src_str, int read_idx )
;
; Returns the next sub-string word from a source string, or nothing if there
; is no such word. The words are split by spaces.
;
; Example: <gosub args_get_next_substr_ws "a  bc  de" 1.>
;          Returns "bc 5" (sans quotes).
;
wa_get_substr_ws:
(
  local &src_str
  local &src_len
  local &read_idx
  local &sub_str
  local &start_idx

  entry &src_str &read_idx

  if (&read_idx<0)
  (
    ; Negative read index--return empty string (and no index).
    return
  )

  &src_len=string.length(&src_str)

  ; Find the start of non-whitespace segment.
  while (&read_idx<&src_len)
  (
    if (string.char(&src_str, &read_idx)!=' ')
    (
      &start_idx=&read_idx
      goto wa_get_substr_ws_find_end_idx
    )

    &read_idx=&read_idx+1
  )

  ; No non-whitespace found--return empty string (and no index).
  return

wa_get_substr_ws_find_end_idx:

  ; Find the end of non-whitespace segment.
  &read_idx=&read_idx+1
  while (&read_idx<&src_len)
  (
    if (string.char(&src_str, &read_idx)==' ')
    (
      ; Cut out leading and trailing whitespace
      &sub_str=string.mid(&src_str, &start_idx, &read_idx-&start_idx)

      goto wa_get_substr_ws_return_substr
    )

    &read_idx=&read_idx+1
  )

  ; No trailing white-space found--cut out any leading whitespace.
  &sub_str=string.cut(&src_str, &start_idx)

wa_get_substr_ws_return_substr:

  return &sub_str &read_idx
)

;
; int[2] wa_extract_stored_win_dim ( string file_name,  string window_name )
;
; Returns the settings for the given window extracted from a previously
; stored file. Returns -1 if the window settings aren't found.
;
; Returns: {x_start, y_start, x_length, y_length}
;          (all values are in row or column units).
;
wa_extract_stored_win_dim:
(
  local &window_name
  local &file_name
  local &x_start
  local &y_start
  local &x_len
  local &y_len
  local &line_in
  local &idx

  entry &file_name &window_name

  &x_start=-1
  &y_start=-1
  &y_len=-1
  &x_start=-1

  ; Open the input file.
  (
    &clk_err=""
    ON ERROR gosub
    (
      print %ERROR "ERROR: wa_extract_stored_win_dim() failed to open '&file_name'."
      &clk_err="!"
      return
    )
    OPEN #1 &file_name /Read
  )

  if ("&clk_err"!="")
  (
    goto wa_extract_stored_win_dim_error
  )

  ; Scan the input file for "winpos ... window_name".
  WHILE TRUE()
  (
    READ #1 %line &line_in
    if (EOF()==TRUE())
    (
      goto wa_extract_stored_win_dim_error
    )
    &line_in=string.lower("&line_in")

    ; Search for 'winpos' line header and cut it out if found.
    &idx=string.scan("&line_in", "winpos", 0)
    if (&idx!=-1)
    (
      &line_in=string.cut("&line_in", &idx+6.)

      ; Search for the specified window name.
      if (string.scan("&line_in", "&window_name", 0)!=-1)
      (
        ; Extract the specified window's settings.
        gosub wa_get_substr_ws "&line_in" 0.
        entry &x_start &idx
        if ("&x_start"=="")
        (
          goto wa_extract_stored_win_dim_error
        )
        gosub wa_get_substr_ws "&line_in" &idx
        entry &y_start &idx
        if ("&y_start"=="")
        (
          goto wa_extract_stored_win_dim_error
        )
        gosub wa_get_substr_ws "&line_in" &idx
        entry &x_len &idx
        if ("&x_len"=="")
        (
          goto wa_extract_stored_win_dim_error
        )
        gosub wa_get_substr_ws "&line_in" &idx
        entry &y_len &idx
        if ("&y_len"=="")
        (
          goto wa_extract_stored_win_dim_error
        )

        CLOSE #1
        return &x_start &y_start &x_len &y_len
      )
    )
  )

wa_extract_stored_win_dim_error:

  CLOSE #1
  return -1 -1 -1 -1
)

;
; bool wa_save_window_settings ( string window_name, [flag print_error] )
;
; Saves a script's window configuration (position + size).
; See restore_window_settings() for the restore operation.
; Returns non-zero if the store operation succeeded.
;
; This is provided as a method to allow scripts to save/restore their window
; settings accross multiple script sessions. T32's "store <file> win" tool
; is insufficient to do this since it will only save/restore *all* T32 windows,
; not targeted windows.
;
wa_save_window_settings:
(
  local &file
  local &window_name
  local &script_name
  local &extn_less_dim_fname
  local &print_error

  &clk_err=""
  ON ERROR gosub
  (
    &clk_err="!"
    return
  )

  entry &window_name &print_error

  ; Store the full window configuration in a file under the temporary directory.
  &script_name=os.ppf()
  &script_name=os.file.name("&script_name")
  &extn_less_dim_fname="__&(script_name)_&(window_name)_dim"
  &extn_less_dim_fname=string.replace("&extn_less_dim_fname", ".", "_", 0.)

  &file=os.ptd()
  &file="&(file)\&(extn_less_dim_fname).cmm"
  store &file win

  if ("&clk_err"=="")
  (
    return 1
  )
  else
  (
    if ("&print_error"!="")
    (
      print %ERROR "ERROR: wa_save_window_settings() failed to store settings for '&window_name'."
    )
    return 0
  )
)

;
; int[4] wa_find_saved_window_settings ( string window_name )
;
; Returns the settings for the given window extracted from a previously
; save. Returns -1 if the window settings aren't found.
;
; Returns: {x_start, y_start, x_length, y_length}
;          (all values are in row or column units).
;
; This is provided as a method to allow scripts to save/restore their window
; settings accross multiple script sessions. T32's "store <file> win" tool
; is insufficient to do this since it will only save/restore *all* T32 windows,
; not targeted windows.
;
wa_find_saved_window_settings:
(
  local &x_start
  local &y_start
  local &x_len
  local &y_len
  local &window_name
  local &file
  local &script_name
  local &extn_less_dim_fname
  local &first

  entry &window_name

  &script_name=os.ppf()
  &script_name=os.file.name("&script_name")
  &extn_less_dim_fname="__&(script_name)_&(window_name)_dim"
  &extn_less_dim_fname=string.replace("&extn_less_dim_fname", ".", "_", 0.)

  &first=0.
  (
    ON ERROR gosub
    (
      var.newglobal char \&extn_less_dim_fname
      &first=1.
      return
    )

    var.assign \&extn_less_dim_fname = 0
  )

  &file=os.ptd()
  &file="&(file)\&(extn_less_dim_fname).cmm"

  if (&first!=0.)
  (
    ;
    ; Don't attempt to restore on the first time--instead delete the save.
    ; This prevents issues where a new T32 session is opened in a smaller
    ; window but the launched script maintains its old oversize dimensions.
    ;
    (
      ON ERROR continue
      del &file
    )
    return -1 -1 -1 -1
  )

  if (os.file.access("&file", "R")==FALSE())
  (
    return -1 -1 -1 -1
  )

  ; Search for previously saved settings for this window.
  gosub wa_extract_stored_win_dim &file &window_name
  entry &x_start &y_start &x_len &y_len

  return &x_start &y_start &x_len &y_len
)

;
; bool wa_delete_saved_window_settings ( string window_name, [flag print_error] )
;
; Deletes a window settings file.
;
wa_delete_saved_window_settings:
(
  local &success
  local &file
  local &script_name
  local &window_name
  local &extn_less_dim_fname
  local &print_error

  entry &window_name &print_error

  ; Check if the window's saved settings file exists.
  &script_name=os.ppf()
  &script_name=os.file.name("&script_name")
  &extn_less_dim_fname="__&(script_name)_&(window_name)_dim"
  &extn_less_dim_fname=string.replace("&extn_less_dim_fname", ".", "_", 0.)

  &file=os.ptd()
  &file="&(file)\&(extn_less_dim_fname).cmm"
  if (os.file.access("&file", "W")==TRUE())
  (
    ; Delete the file.
    del &file
    &success=1
  )
  else
  (
    if ("&print_error"!="")
    (
      print %ERROR "ERROR: wa_delete_saved_window_settings() failed to delete window settings for '&window_name'."
    )
    &success=0
  )

  return &success
)

;
; bool wa_delete_saved_window_settings_ext ( string window, string script, [flag print_error] )
;
; Deletes a window settings file.
;
wa_delete_saved_window_settings_ext:
(
  local &success
  local &file
  local &script_name
  local &extn_less_dim_fname
  local &window_name
  local &print_error

  entry &window_name &script_name &print_error

  &extn_less_dim_fname="__&(script_name)_&(window_name)_dim"
  &extn_less_dim_fname=string.replace("&extn_less_dim_fname", ".", "_", 0.)

  &file=os.ptd()
  &file="&(file)\&(extn_less_dim_fname).cmm"
  if (os.file.access("&file", "W")==TRUE())
  (
    ; Delete the file.
    del &file
    &success=1
  )
  else
  (
    if ("&print_error"!="")
    (
      print %ERROR "ERROR: delete_saved_window_settings() failed to delete window settings for '&window_name'."
    )
    &success=0
  )

  return &success
)

;;;;;;;;;;;;; End of "Lauterbach T32 "Window/Area" Utility Subs" ;;;;;;;;;;;;;


;-----------------------------------------------------------------------
; Display Configurations
;-----------------------------------------------------------------------

Display_Configurations:

  local &pll_name
  local &pll_num
  local &pll_type
  local &l_reg
  local &m_reg
  local &n_reg
  local &alpha_reg
  local &alpha_u_reg
  local &mode_reg
  local &user_ctl_reg
  local &status_reg

  print "PLL            USE                   STATE     VOTABLE   MAIN_OUT   TEST_OUT    AUX_OUT   AUX2_OUT   EARLY_OUT   CALC FREQ (MHz)"
  print "--- ------------------------------   -----     -------   --------   --------    -------   --------   ---------   ---------------"


  &pll_name="GPLL0                       "
  &pll_num="0  "
  &pll_type="stromer_pll"
  &mode_reg=&HWIO_GCC_GPLL0_MODE_ADDR
  &l_reg=&HWIO_GCC_GPLL0_L_VAL_ADDR
  &alpha_reg=0
  &alpha_u_reg=0
  &m_reg=0
  &n_reg=0
  &user_ctl_reg=&HWIO_GCC_GPLL0_USER_CTL_ADDR
  &status_reg=&HWIO_GCC_GPLL0_STATUS_ADDR
  &clk_ref=19.2


  &alpha_reg=&HWIO_GCC_GPLL0_ALPHA_VAL_ADDR
  &alpha_u_reg=&HWIO_GCC_GPLL0_ALPHA_VAL_U_ADDR
  &user_ctl_u_reg=&HWIO_GCC_GPLL0_USER_CTL_U_ADDR
  gosub Display_PLL "&pll_name" "&pll_num" &pll_type &mode_reg &l_reg &alpha_reg &alpha_u_reg &m_reg &n_reg &user_ctl_reg &status_reg &clk_ref


  &pll_name="GPLL1                       "
  &pll_num="1  "
  &pll_type="stromer_pll"
  &mode_reg=&HWIO_GCC_GPLL1_MODE_ADDR
  &l_reg=&HWIO_GCC_GPLL1_L_VAL_ADDR
  &alpha_reg=0
  &alpha_u_reg=0
  &m_reg=0
  &n_reg=0
  &user_ctl_reg=&HWIO_GCC_GPLL1_USER_CTL_ADDR
  &status_reg=&HWIO_GCC_GPLL1_STATUS_ADDR
  &clk_ref=19.2


  &alpha_reg=&HWIO_GCC_GPLL1_ALPHA_VAL_ADDR
  &alpha_u_reg=&HWIO_GCC_GPLL1_ALPHA_VAL_U_ADDR
  &user_ctl_u_reg=&HWIO_GCC_GPLL1_USER_CTL_U_ADDR
  gosub Display_PLL "&pll_name" "&pll_num" &pll_type &mode_reg &l_reg &alpha_reg &alpha_u_reg &m_reg &n_reg &user_ctl_reg &status_reg &clk_ref


  &pll_name="GPLL3                       "
  &pll_num="2  "
  &pll_type="stromer_pll"
  &mode_reg=&HWIO_GCC_GPLL3_MODE_ADDR
  &l_reg=&HWIO_GCC_GPLL3_L_VAL_ADDR
  &alpha_reg=0
  &alpha_u_reg=0
  &m_reg=0
  &n_reg=0
  &user_ctl_reg=&HWIO_GCC_GPLL3_USER_CTL_ADDR
  &status_reg=&HWIO_GCC_GPLL3_STATUS_ADDR
  &clk_ref=19.2


  &alpha_reg=&HWIO_GCC_GPLL3_ALPHA_VAL_ADDR
  &alpha_u_reg=&HWIO_GCC_GPLL3_ALPHA_VAL_U_ADDR
  &user_ctl_u_reg=&HWIO_GCC_GPLL3_USER_CTL_U_ADDR
  gosub Display_PLL "&pll_name" "&pll_num" &pll_type &mode_reg &l_reg &alpha_reg &alpha_u_reg &m_reg &n_reg &user_ctl_reg &status_reg &clk_ref


  &pll_name="GPLL4                       "
  &pll_num="3  "
  &pll_type="stromer_pll"
  &mode_reg=&HWIO_GCC_GPLL4_MODE_ADDR
  &l_reg=&HWIO_GCC_GPLL4_L_VAL_ADDR
  &alpha_reg=0
  &alpha_u_reg=0
  &m_reg=0
  &n_reg=0
  &user_ctl_reg=&HWIO_GCC_GPLL4_USER_CTL_ADDR
  &status_reg=&HWIO_GCC_GPLL4_STATUS_ADDR
  &clk_ref=19.2


  &alpha_reg=&HWIO_GCC_GPLL4_ALPHA_VAL_ADDR
  &alpha_u_reg=&HWIO_GCC_GPLL4_ALPHA_VAL_U_ADDR
  &user_ctl_u_reg=&HWIO_GCC_GPLL4_USER_CTL_U_ADDR
  gosub Display_PLL "&pll_name" "&pll_num" &pll_type &mode_reg &l_reg &alpha_reg &alpha_u_reg &m_reg &n_reg &user_ctl_reg &status_reg &clk_ref


  &pll_name="GPLL5                       "
  &pll_num="4  "
  &pll_type="sr2_pll"
  &mode_reg=&HWIO_GCC_GPLL5_MODE_ADDR
  &l_reg=&HWIO_GCC_GPLL5_L_VAL_ADDR
  &alpha_reg=0
  &alpha_u_reg=0
  &m_reg=0
  &n_reg=0
  &user_ctl_reg=&HWIO_GCC_GPLL5_USER_CTL_ADDR
  &status_reg=&HWIO_GCC_GPLL5_STATUS_ADDR
  &clk_ref=19.2


  &m_reg=&HWIO_GCC_GPLL5_M_VAL_ADDR
  &n_reg=&HWIO_GCC_GPLL5_N_VAL_ADDR
  gosub Display_PLL "&pll_name" "&pll_num" &pll_type &mode_reg &l_reg &alpha_reg &alpha_u_reg &m_reg &n_reg &user_ctl_reg &status_reg &clk_ref


  &pll_name="GPLL6                       "
  &pll_num="5  "
  &pll_type="sr_pll"
  &mode_reg=&HWIO_GCC_GPLL6_MODE_ADDR
  &l_reg=&HWIO_GCC_GPLL6_L_VAL_ADDR
  &alpha_reg=0
  &alpha_u_reg=0
  &m_reg=0
  &n_reg=0
  &user_ctl_reg=&HWIO_GCC_GPLL6_USER_CTL_ADDR
  &status_reg=&HWIO_GCC_GPLL6_STATUS_ADDR
  &clk_ref=19.2


  &m_reg=&HWIO_GCC_GPLL6_M_VAL_ADDR
  &n_reg=&HWIO_GCC_GPLL6_N_VAL_ADDR
  gosub Display_PLL "&pll_name" "&pll_num" &pll_type &mode_reg &l_reg &alpha_reg &alpha_u_reg &m_reg &n_reg &user_ctl_reg &status_reg &clk_ref


  &pll_name="BIMC_PLL                    "
  &pll_num="6  "
  &pll_type="sr2_pll"
  &mode_reg=&HWIO_GCC_BIMC_PLL_MODE_ADDR
  &l_reg=&HWIO_GCC_BIMC_PLL_L_VAL_ADDR
  &alpha_reg=0
  &alpha_u_reg=0
  &m_reg=0
  &n_reg=0
  &user_ctl_reg=&HWIO_GCC_BIMC_PLL_USER_CTL_ADDR
  &status_reg=&HWIO_GCC_BIMC_PLL_STATUS_ADDR
  &clk_ref=19.2


  &m_reg=&HWIO_GCC_BIMC_PLL_M_VAL_ADDR
  &n_reg=&HWIO_GCC_BIMC_PLL_N_VAL_ADDR
  gosub Display_PLL "&pll_name" "&pll_num" &pll_type &mode_reg &l_reg &alpha_reg &alpha_u_reg &m_reg &n_reg &user_ctl_reg &status_reg &clk_ref


  print " "
  print " "

  return


;-----------------------------------------------------------------------------
; Display the dump of mode/status registers.
;-----------------------------------------------------------------------------

Display_Dump:

  local &mode_reg
  local &user_ctl_reg
  local &user_ctl_u_reg
  local &config_ctl_reg
  local &test_ctl_reg
  local &test_ctl_u_reg
  local &status_reg

  ; Display the PLL mode, status, user, and test registers.


  &mode_reg=&HWIO_GCC_GPLL0_MODE_ADDR
  &status_reg=&HWIO_GCC_GPLL0_STATUS_ADDR
  &user_ctl_reg=&HWIO_GCC_GPLL0_USER_CTL_ADDR
  &config_ctl_reg=&HWIO_GCC_GPLL0_CONFIG_CTL_ADDR
  &test_ctl_reg=&HWIO_GCC_GPLL0_TEST_CTL_ADDR
  &l_reg=&HWIO_GCC_GPLL0_L_VAL_ADDR
  &alpha_reg=0
  &alpha_u_reg=0
  &m_reg=0
  &n_reg=0
  &user_ctl_u_reg=0
  &test_ctl_u_reg=0
  &alpha_reg=&HWIO_GCC_GPLL0_ALPHA_VAL_ADDR
  &alpha_u_reg=&HWIO_GCC_GPLL0_ALPHA_VAL_U_ADDR
  &user_ctl_u_reg=&HWIO_GCC_GPLL0_USER_CTL_U_ADDR
  &test_ctl_u_reg=&HWIO_GCC_GPLL0_TEST_CTL_U_ADDR
  gosub Format_Dump_Registers   0. GPLL0                        &mode_reg &user_ctl_reg &user_ctl_u_reg &config_ctl_reg &test_ctl_reg &test_ctl_u_reg &status_reg &l_reg &alpha_reg &alpha_u_reg &m_reg &n_reg

  &mode_reg=&HWIO_GCC_GPLL1_MODE_ADDR
  &status_reg=&HWIO_GCC_GPLL1_STATUS_ADDR
  &user_ctl_reg=&HWIO_GCC_GPLL1_USER_CTL_ADDR
  &config_ctl_reg=&HWIO_GCC_GPLL1_CONFIG_CTL_ADDR
  &test_ctl_reg=&HWIO_GCC_GPLL1_TEST_CTL_ADDR
  &l_reg=&HWIO_GCC_GPLL1_L_VAL_ADDR
  &alpha_reg=0
  &alpha_u_reg=0
  &m_reg=0
  &n_reg=0
  &user_ctl_u_reg=0
  &test_ctl_u_reg=0
  &alpha_reg=&HWIO_GCC_GPLL1_ALPHA_VAL_ADDR
  &alpha_u_reg=&HWIO_GCC_GPLL1_ALPHA_VAL_U_ADDR
  &user_ctl_u_reg=&HWIO_GCC_GPLL1_USER_CTL_U_ADDR
  &test_ctl_u_reg=&HWIO_GCC_GPLL1_TEST_CTL_U_ADDR
  gosub Format_Dump_Registers   1. GPLL1                        &mode_reg &user_ctl_reg &user_ctl_u_reg &config_ctl_reg &test_ctl_reg &test_ctl_u_reg &status_reg &l_reg &alpha_reg &alpha_u_reg &m_reg &n_reg

  &mode_reg=&HWIO_GCC_GPLL3_MODE_ADDR
  &status_reg=&HWIO_GCC_GPLL3_STATUS_ADDR
  &user_ctl_reg=&HWIO_GCC_GPLL3_USER_CTL_ADDR
  &config_ctl_reg=&HWIO_GCC_GPLL3_CONFIG_CTL_ADDR
  &test_ctl_reg=&HWIO_GCC_GPLL3_TEST_CTL_ADDR
  &l_reg=&HWIO_GCC_GPLL3_L_VAL_ADDR
  &alpha_reg=0
  &alpha_u_reg=0
  &m_reg=0
  &n_reg=0
  &user_ctl_u_reg=0
  &test_ctl_u_reg=0
  &alpha_reg=&HWIO_GCC_GPLL3_ALPHA_VAL_ADDR
  &alpha_u_reg=&HWIO_GCC_GPLL3_ALPHA_VAL_U_ADDR
  &user_ctl_u_reg=&HWIO_GCC_GPLL3_USER_CTL_U_ADDR
  &test_ctl_u_reg=&HWIO_GCC_GPLL3_TEST_CTL_U_ADDR
  gosub Format_Dump_Registers   2. GPLL3                        &mode_reg &user_ctl_reg &user_ctl_u_reg &config_ctl_reg &test_ctl_reg &test_ctl_u_reg &status_reg &l_reg &alpha_reg &alpha_u_reg &m_reg &n_reg

  &mode_reg=&HWIO_GCC_GPLL4_MODE_ADDR
  &status_reg=&HWIO_GCC_GPLL4_STATUS_ADDR
  &user_ctl_reg=&HWIO_GCC_GPLL4_USER_CTL_ADDR
  &config_ctl_reg=&HWIO_GCC_GPLL4_CONFIG_CTL_ADDR
  &test_ctl_reg=&HWIO_GCC_GPLL4_TEST_CTL_ADDR
  &l_reg=&HWIO_GCC_GPLL4_L_VAL_ADDR
  &alpha_reg=0
  &alpha_u_reg=0
  &m_reg=0
  &n_reg=0
  &user_ctl_u_reg=0
  &test_ctl_u_reg=0
  &alpha_reg=&HWIO_GCC_GPLL4_ALPHA_VAL_ADDR
  &alpha_u_reg=&HWIO_GCC_GPLL4_ALPHA_VAL_U_ADDR
  &user_ctl_u_reg=&HWIO_GCC_GPLL4_USER_CTL_U_ADDR
  &test_ctl_u_reg=&HWIO_GCC_GPLL4_TEST_CTL_U_ADDR
  gosub Format_Dump_Registers   3. GPLL4                        &mode_reg &user_ctl_reg &user_ctl_u_reg &config_ctl_reg &test_ctl_reg &test_ctl_u_reg &status_reg &l_reg &alpha_reg &alpha_u_reg &m_reg &n_reg

  &mode_reg=&HWIO_GCC_GPLL5_MODE_ADDR
  &status_reg=&HWIO_GCC_GPLL5_STATUS_ADDR
  &user_ctl_reg=&HWIO_GCC_GPLL5_USER_CTL_ADDR
  &config_ctl_reg=&HWIO_GCC_GPLL5_CONFIG_CTL_ADDR
  &test_ctl_reg=&HWIO_GCC_GPLL5_TEST_CTL_ADDR
  &l_reg=&HWIO_GCC_GPLL5_L_VAL_ADDR
  &alpha_reg=0
  &alpha_u_reg=0
  &m_reg=0
  &n_reg=0
  &user_ctl_u_reg=0
  &test_ctl_u_reg=0
  &m_reg=&HWIO_GCC_GPLL5_M_VAL_ADDR
  &n_reg=&HWIO_GCC_GPLL5_N_VAL_ADDR
  gosub Format_Dump_Registers   4. GPLL5                        &mode_reg &user_ctl_reg &user_ctl_u_reg &config_ctl_reg &test_ctl_reg &test_ctl_u_reg &status_reg &l_reg &alpha_reg &alpha_u_reg &m_reg &n_reg

  &mode_reg=&HWIO_GCC_GPLL6_MODE_ADDR
  &status_reg=&HWIO_GCC_GPLL6_STATUS_ADDR
  &user_ctl_reg=&HWIO_GCC_GPLL6_USER_CTL_ADDR
  &config_ctl_reg=&HWIO_GCC_GPLL6_CONFIG_CTL_ADDR
  &test_ctl_reg=&HWIO_GCC_GPLL6_TEST_CTL_ADDR
  &l_reg=&HWIO_GCC_GPLL6_L_VAL_ADDR
  &alpha_reg=0
  &alpha_u_reg=0
  &m_reg=0
  &n_reg=0
  &user_ctl_u_reg=0
  &test_ctl_u_reg=0
  &m_reg=&HWIO_GCC_GPLL6_M_VAL_ADDR
  &n_reg=&HWIO_GCC_GPLL6_N_VAL_ADDR
  gosub Format_Dump_Registers   5. GPLL6                        &mode_reg &user_ctl_reg &user_ctl_u_reg &config_ctl_reg &test_ctl_reg &test_ctl_u_reg &status_reg &l_reg &alpha_reg &alpha_u_reg &m_reg &n_reg

  &mode_reg=&HWIO_GCC_BIMC_PLL_MODE_ADDR
  &status_reg=&HWIO_GCC_BIMC_PLL_STATUS_ADDR
  &user_ctl_reg=&HWIO_GCC_BIMC_PLL_USER_CTL_ADDR
  &config_ctl_reg=&HWIO_GCC_BIMC_PLL_CONFIG_CTL_ADDR
  &test_ctl_reg=&HWIO_GCC_BIMC_PLL_TEST_CTL_ADDR
  &l_reg=&HWIO_GCC_BIMC_PLL_L_VAL_ADDR
  &alpha_reg=0
  &alpha_u_reg=0
  &m_reg=0
  &n_reg=0
  &user_ctl_u_reg=0
  &test_ctl_u_reg=0
  &m_reg=&HWIO_GCC_BIMC_PLL_M_VAL_ADDR
  &n_reg=&HWIO_GCC_BIMC_PLL_N_VAL_ADDR
  gosub Format_Dump_Registers   6. BIMC_PLL                     &mode_reg &user_ctl_reg &user_ctl_u_reg &config_ctl_reg &test_ctl_reg &test_ctl_u_reg &status_reg &l_reg &alpha_reg &alpha_u_reg &m_reg &n_reg

  print " " 
  print " " 
    
  return


;-----------------------------------------------------------------------
; Get votes for GCC's
;-----------------------------------------------------------------------

Get_PLL_Vote_GCC:

  ENTRY &vote_reg

  &temp_reg=data.long(&access_mode:&vote_reg)

  if (&temp_reg&0x80)==0x80
    &pll6="Y"
  else
    &pll6=" "

  if (&temp_reg&0x40)==0x40
    &pll5="Y"
  else
    &pll5=" "

  if (&temp_reg&0x20)==0x20
    &pll4="Y"
  else
    &pll4=" "

  if (&temp_reg&0x10)==0x10
    &pll3="Y"
  else
    &pll3=" "

  if (&temp_reg&0x8)==0x8
    &bpll="Y"
  else
    &bpll=" "

  if (&temp_reg&0x2)==0x2
    &pll1="Y"
  else
    &pll1=" "

  if (&temp_reg&0x1)==0x1
    &pll0="Y"
  else
    &pll0=" "

  return


;-----------------------------------------------------------------------
; Display PLL vote headline
;-----------------------------------------------------------------------

Display_PLL_Vote:
  
  print "&image |  &pll0  |  &pll1  |  &pll2  |  &bpll  |  &pll3  |  &pll4  |  &pll5  |  &pll6  |   "

  return


;-----------------------------------------------------------------------
; Reset PLL votes
;-----------------------------------------------------------------------

Reset_PLL_Votes:

  &pll0=" "
  &pll1=" "
  &pll2=" "
  &bpll=" "
  &pll3=" "
  &pll4=" "
  &pll5=" "
  &pll6=" "


  return


;-----------------------------------------------------------------------
; Display PLL voting table
;-----------------------------------------------------------------------

Display_Votes:

  local &vote_reg

  print " _________________________________       _____ _____ _____ _____ _____ _____ _____ _____    "
  print "|\                                \    |\     \     \     \     \     \     \     \     \   "
  print "| \                                \   | \  0  \  1  \  2  \  b  \  3  \  4  \  5  \  6  \  "
  print "|  \________________________________\__|  \_____\_____\_____\____ \_____\_____\_____\_____\ "
  print "|  |                                |  |  |     |     |     |     |     |     |     |     | "


  ; Display GCC_APCS_GPLL_ENA_VOTE votes
  gosub Reset_PLL_Votes
  &image="|\ |  GCC_APCS_GPLL_ENA_VOTE        |  |\"

  ; Get GCC_APCS_GPLL_ENA_VOTE votes on GCC's
  &vote_reg=&HWIO_GCC_APCS_GPLL_ENA_VOTE_ADDR
  gosub Get_PLL_Vote_GCC &vote_reg

  gosub Display_PLL_Vote

  print "| \|________________________________|__| \|_____|_____|_____|_____|_____|_____|_____|_____| "
  print "|  |                                |  |  |     |     |     |     |     |     |     |     | "


  ; Display GCC_APCS_HYP_GPLL_ENA_VOTE votes
  gosub Reset_PLL_Votes
  &image="|\ |  GCC_APCS_HYP_GPLL_ENA_VOTE    |  |\"

  ; Get GCC_APCS_HYP_GPLL_ENA_VOTE votes on GCC's
  &vote_reg=&HWIO_GCC_APCS_HYP_GPLL_ENA_VOTE_ADDR
  gosub Get_PLL_Vote_GCC &vote_reg

  gosub Display_PLL_Vote

  print "| \|________________________________|__| \|_____|_____|_____|_____|_____|_____|_____|_____| "
  print "|  |                                |  |  |     |     |     |     |     |     |     |     | "


  ; Display GCC_APCS_TZ_GPLL_ENA_VOTE votes
  gosub Reset_PLL_Votes
  &image="|\ |  GCC_APCS_TZ_GPLL_ENA_VOTE     |  |\"

  ; Get GCC_APCS_TZ_GPLL_ENA_VOTE votes on GCC's
  &vote_reg=&HWIO_GCC_APCS_TZ_GPLL_ENA_VOTE_ADDR
  gosub Get_PLL_Vote_GCC &vote_reg

  gosub Display_PLL_Vote

  print "| \|________________________________|__| \|_____|_____|_____|_____|_____|_____|_____|_____| "
  print "|  |                                |  |  |     |     |     |     |     |     |     |     | "


  ; Display GCC_CDSP_GPLL_ENA_VOTE votes
  gosub Reset_PLL_Votes
  &image="|\ |  GCC_CDSP_GPLL_ENA_VOTE        |  |\"

  ; Get GCC_CDSP_GPLL_ENA_VOTE votes on GCC's
  &vote_reg=&HWIO_GCC_CDSP_GPLL_ENA_VOTE_ADDR
  gosub Get_PLL_Vote_GCC &vote_reg

  gosub Display_PLL_Vote

  print "| \|________________________________|__| \|_____|_____|_____|_____|_____|_____|_____|_____| "
  print "|  |                                |  |  |     |     |     |     |     |     |     |     | "


  ; Display GCC_LPASS_DSP_GPLL_ENA_VOTE votes
  gosub Reset_PLL_Votes
  &image="|\ |  GCC_LPASS_DSP_GPLL_ENA_VOTE   |  |\"

  ; Get GCC_LPASS_DSP_GPLL_ENA_VOTE votes on GCC's
  &vote_reg=&HWIO_GCC_LPASS_DSP_GPLL_ENA_VOTE_ADDR
  gosub Get_PLL_Vote_GCC &vote_reg

  gosub Display_PLL_Vote

  print "| \|________________________________|__| \|_____|_____|_____|_____|_____|_____|_____|_____| "
  print "|  |                                |  |  |     |     |     |     |     |     |     |     | "


  ; Display GCC_RPM_GPLL_ENA_VOTE votes
  gosub Reset_PLL_Votes
  &image="|\ |  GCC_RPM_GPLL_ENA_VOTE         |  |\"

  ; Get GCC_RPM_GPLL_ENA_VOTE votes on GCC's
  &vote_reg=&HWIO_GCC_RPM_GPLL_ENA_VOTE_ADDR
  gosub Get_PLL_Vote_GCC &vote_reg

  gosub Display_PLL_Vote

  print "| \|________________________________|__| \|_____|_____|_____|_____|_____|_____|_____|_____| "
  print "|  |                                |  |  |     |     |     |     |     |     |     |     | "


  ; Display GCC_SPARE_GPLL_ENA_VOTE votes
  gosub Reset_PLL_Votes
  &image="|\ |  GCC_SPARE_GPLL_ENA_VOTE       |  |\"

  ; Get GCC_SPARE_GPLL_ENA_VOTE votes on GCC's
  &vote_reg=&HWIO_GCC_SPARE_GPLL_ENA_VOTE_ADDR
  gosub Get_PLL_Vote_GCC &vote_reg

  gosub Display_PLL_Vote

  print "| \|________________________________|__| \|_____|_____|_____|_____|_____|_____|_____|_____| "
  print "|  |                                |  |  |     |     |     |     |     |     |     |     | "


  ; Display GCC_WDSP_GPLL_ENA_VOTE votes
  gosub Reset_PLL_Votes
  &image="|\ |  GCC_WDSP_GPLL_ENA_VOTE        |  |\"

  ; Get GCC_WDSP_GPLL_ENA_VOTE votes on GCC's
  &vote_reg=&HWIO_GCC_WDSP_GPLL_ENA_VOTE_ADDR
  gosub Get_PLL_Vote_GCC &vote_reg

  gosub Display_PLL_Vote

  print "| \|________________________________|__| \|_____|_____|_____|_____|_____|_____|_____|_____| "
  print "|  |                                |  |  |     |     |     |     |     |     |     |     | "


  print " " 
  print " " 
    
  return


;-----------------------------------------------------------------------
; Configure a PLL - Wrapper
;-----------------------------------------------------------------------

Configure_PLL_Enter:

  &pll_name_choice=""
  gosub Configure_PLL

  return


;-----------------------------------------------------------------------
; Configure SR / SR2 / HF / Prius / Tesla PLLs.
; Note:
;-----------------------------------------------------------------------
          
Generic_PLL_Configure:

  ENTRY &mode_reg &user_reg &prediv &postdiv &l_reg &l_val &alpha_reg &alpha_val &alpha_u_reg &alpha_u_val &m_reg &m_val &n_reg &n_val &is_votable &pll_type &cfgctl_reg

  &HWIO_PLL_VOTE_FSM_ENA_MASK=0x100000
  &HWIO_PLL_VOTE_FSM_RESET_MASK=0x200000

  &HWIO_PLL_BIAS_COUNT_MASK=0xfc000
  &HWIO_PLL_LOCK_COUNT_MASK=0x3f00

  &HWIO_PLL_BIAS_COUNT_VAL=(0x1<<0xe)
  &HWIO_PLL_LOCK_COUNT_VAL=0x4

  &HWIO_PLL_ALPHA_EN_MASK=0x1000000
  &HWIO_PLL_VCO_SEL_MASK=0x300000
  &HWIO_PLL_PRE_DIV_RATIO_MASK=0x7000
  &HWIO_PLL_POST_DIV_RATIO_MASK=0xf00

  &HWIO_PLL_VOTE_FSM_ENA_SHIFT=0x14
  &HWIO_PLL_ALPHA_EN_SHIFT=0x18
  &HWIO_PLL_VCO_SEL_SHIFT=0x14
  &HWIO_PLL_PRE_DIV_RATIO_SHIFT=0xc
  &HWIO_PLL_POST_DIV_RATIO_SHIFT=0x8

  local &mode_val
  local &user_val
  local &is_fsm_mode_enabled

  &is_fsm_mode_enabled=0x0
  ;data.set &access_mode:&mode_reg %long 0x0

  &mode_val=data.long(&access_mode:&mode_reg)

  if (&is_votable==0x1)
  (
    ; Disable FSM mode
    if (&mode_val&(&HWIO_PLL_VOTE_FSM_ENA_MASK))==&HWIO_PLL_VOTE_FSM_ENA_MASK
    (
      &is_fsm_mode_enabled=0x1
      &mode_val=&mode_val&~(&HWIO_PLL_VOTE_FSM_ENA_MASK)
      data.set &access_mode:&mode_reg %long &mode_val
    )
  )

  ; Set L
  data.set &access_mode:&l_reg %long &l_val

  ; Set ALPHA if register is non-zero
  if (&alpha_reg!=0)
  (
    data.set &access_mode:&alpha_reg %long &alpha_val
  )

  ; Set ALPHA_U if register is non-zero
  if (&alpha_u_reg!=0)
  (
    data.set &access_mode:&alpha_u_reg %long &alpha_u_val
  )

  ; Set M if register is non-zero
  if (&m_reg!=0)
  (
    data.set &access_mode:&m_reg %long &m_val
  )

  ; Set N if register is non-zero
  if (&n_reg!=0)
  (
    data.set &access_mode:&n_reg %long &n_val
  )

  ; Clear fields in user control register
  &user_val=data.long(&access_mode:&user_reg)
  &user_val=&user_val&~((&HWIO_PLL_ALPHA_EN_MASK)|(&HWIO_PLL_VCO_SEL_MASK)|(&HWIO_PLL_PRE_DIV_RATIO_MASK)|(&HWIO_PLL_POST_DIV_RATIO_MASK))

  ; Set fields in user control register
  &user_val=&user_val|(0x2<<&HWIO_PLL_VCO_SEL_SHIFT)
  &user_val=&user_val|((&prediv-1)<<&HWIO_PLL_PRE_DIV_RATIO_SHIFT)
  &user_val=&user_val|((&postdiv-1)<<&HWIO_PLL_POST_DIV_RATIO_SHIFT)
  ; Enable the main output
  &user_val=&user_val|0x1
  if (&alpha_val!=0)||(&alpha_u_val!=0)
  (
    &user_val=&user_val|(&HWIO_PLL_ALPHA_EN_MASK)
  )

  ; Program the user control register
  data.set &access_mode:&user_reg %long &user_val


  if (&is_votable==0x1)
  (
    ; Put the FSM in reset
    &mode_val=&mode_val|(&HWIO_PLL_VOTE_FSM_RESET_MASK)
    data.set &access_mode:&mode_reg %long &mode_val

    ; Set the lock and bias
    &mode_val=&mode_val&~((&HWIO_PLL_BIAS_COUNT_MASK)|(&HWIO_PLL_LOCK_COUNT_MASK))
    &mode_val=&mode_val|(&HWIO_PLL_BIAS_COUNT_VAL)
    &mode_val=&mode_val|(&HWIO_PLL_LOCK_COUNT_VAL)

    ; Enable the FSM
    &mode_val=&mode_val|(&HWIO_PLL_VOTE_FSM_ENA_MASK)

    ; Program the mode register
    data.set &access_mode:&mode_reg %long &mode_val

    ; Take the FSM out of reset
    &mode_val=&mode_val&~(&HWIO_PLL_VOTE_FSM_RESET_MASK)
    data.set &access_mode:&mode_reg %long &mode_val
  )

  if (("&pll_type"=="sr_pll")||("&pll_type"=="sr2_pll"))
  (
    data.set &access_mode:&cfgctl_reg %long 0x4001055B
  )
  else
  (
    data.set &access_mode:&cfgctl_reg %long 0x4C015765
  )
  return


;-----------------------------------------------------------------------
; Configure a PLL
;-----------------------------------------------------------------------

Configure_PLL:

  local &pll_name_choice

  ; Prompt user to choose PLL if choice not passed in via commandline
  if ("&pll_name_choice"=="")
  (
    print "Available PLLs are: "

  print "  GPLL0                       GPLL1                       GPLL3                       GPLL4                       "

  print "  GPLL5                       GPLL6                       BIMC_PLL                    "

    print " "
    print "Enter PLL: "
    enter &pll_name_choice
  )

  if ("&pll_name_choice"=="GPLL0")
  (
    &mode_reg=&HWIO_GCC_GPLL0_MODE_ADDR
    &user_reg=&HWIO_GCC_GPLL0_USER_CTL_ADDR
    &cfgctl_reg=&HWIO_GCC_GPLL0_CONFIG_CTL_ADDR

    &l_reg=&HWIO_GCC_GPLL0_L_VAL_ADDR
    &l_val=0x0029

    &prediv=0x0001
    &postdiv=0x0001

    &alpha_reg=0
    &alpha_val=0x0

    &alpha_u_reg=0
    &alpha_u_val=0x0

    &m_reg=0
    &m_val=0x0

    &n_reg=0
    &n_val=0x0

    &is_votable=0x1
    &pll_type="stromer_pll"

  &alpha_reg=&HWIO_GCC_GPLL0_ALPHA_VAL_ADDR
    &alpha_val=0xAAAAAAAA
  &alpha_u_reg=&HWIO_GCC_GPLL0_ALPHA_VAL_U_ADDR
    &alpha_u_val=0xAA
    gosub Generic_PLL_Configure &mode_reg &user_reg &prediv &postdiv &l_reg &l_val &alpha_reg &alpha_val &alpha_u_reg &alpha_u_val &m_reg &m_val &n_reg &n_val &is_votable &pll_type &cfgctl_reg

    print "Configured GPLL0 "
    print " "

    return
  )

  if ("&pll_name_choice"=="GPLL1")
  (
    &mode_reg=&HWIO_GCC_GPLL1_MODE_ADDR
    &user_reg=&HWIO_GCC_GPLL1_USER_CTL_ADDR
    &cfgctl_reg=&HWIO_GCC_GPLL1_CONFIG_CTL_ADDR

    &l_reg=&HWIO_GCC_GPLL1_L_VAL_ADDR
    &l_val=0x001A

    &prediv=0x0001
    &postdiv=0x0001

    &alpha_reg=0
    &alpha_val=0x0

    &alpha_u_reg=0
    &alpha_u_val=0x0

    &m_reg=0
    &m_val=0x0

    &n_reg=0
    &n_val=0x0

    &is_votable=0x1
    &pll_type="stromer_pll"

  &alpha_reg=&HWIO_GCC_GPLL1_ALPHA_VAL_ADDR
    &alpha_val=0xAAAAAAAA
  &alpha_u_reg=&HWIO_GCC_GPLL1_ALPHA_VAL_U_ADDR
    &alpha_u_val=0x0A
    gosub Generic_PLL_Configure &mode_reg &user_reg &prediv &postdiv &l_reg &l_val &alpha_reg &alpha_val &alpha_u_reg &alpha_u_val &m_reg &m_val &n_reg &n_val &is_votable &pll_type &cfgctl_reg

    print "Configured GPLL1 "
    print " "

    return
  )

  if ("&pll_name_choice"=="GPLL3")
  (
    &mode_reg=&HWIO_GCC_GPLL3_MODE_ADDR
    &user_reg=&HWIO_GCC_GPLL3_USER_CTL_ADDR
    &cfgctl_reg=&HWIO_GCC_GPLL3_CONFIG_CTL_ADDR

    &l_reg=&HWIO_GCC_GPLL3_L_VAL_ADDR
    &l_val=0x0032

    &prediv=0x0001
    &postdiv=0x0002

    &alpha_reg=0
    &alpha_val=0x0

    &alpha_u_reg=0
    &alpha_u_val=0x0

    &m_reg=0
    &m_val=0x0

    &n_reg=0
    &n_val=0x0

    &is_votable=0x1
    &pll_type="stromer_pll"

  &alpha_reg=&HWIO_GCC_GPLL3_ALPHA_VAL_ADDR
    &alpha_val=0x00000000
  &alpha_u_reg=&HWIO_GCC_GPLL3_ALPHA_VAL_U_ADDR
    &alpha_u_val=0x80
    gosub Generic_PLL_Configure &mode_reg &user_reg &prediv &postdiv &l_reg &l_val &alpha_reg &alpha_val &alpha_u_reg &alpha_u_val &m_reg &m_val &n_reg &n_val &is_votable &pll_type &cfgctl_reg

    print "Configured GPLL3 "
    print " "

    return
  )

  if ("&pll_name_choice"=="GPLL4")
  (
    &mode_reg=&HWIO_GCC_GPLL4_MODE_ADDR
    &user_reg=&HWIO_GCC_GPLL4_USER_CTL_ADDR
    &cfgctl_reg=&HWIO_GCC_GPLL4_CONFIG_CTL_ADDR

    &l_reg=&HWIO_GCC_GPLL4_L_VAL_ADDR
    &l_val=0x003C

    &prediv=0x0001
    &postdiv=0x0001

    &alpha_reg=0
    &alpha_val=0x0

    &alpha_u_reg=0
    &alpha_u_val=0x0

    &m_reg=0
    &m_val=0x0

    &n_reg=0
    &n_val=0x0

    &is_votable=0x1
    &pll_type="stromer_pll"

  &alpha_reg=&HWIO_GCC_GPLL4_ALPHA_VAL_ADDR
    &alpha_val=0x00000000
  &alpha_u_reg=&HWIO_GCC_GPLL4_ALPHA_VAL_U_ADDR
    &alpha_u_val=0x00
    gosub Generic_PLL_Configure &mode_reg &user_reg &prediv &postdiv &l_reg &l_val &alpha_reg &alpha_val &alpha_u_reg &alpha_u_val &m_reg &m_val &n_reg &n_val &is_votable &pll_type &cfgctl_reg

    print "Configured GPLL4 "
    print " "

    return
  )

  if ("&pll_name_choice"=="GPLL5")
  (
    &mode_reg=&HWIO_GCC_GPLL5_MODE_ADDR
    &user_reg=&HWIO_GCC_GPLL5_USER_CTL_ADDR
    &cfgctl_reg=&HWIO_GCC_GPLL5_CONFIG_CTL_ADDR

    &l_reg=&HWIO_GCC_GPLL5_L_VAL_ADDR
    &l_val=0x0016

    &prediv=0x0001
    &postdiv=0x0001

    &alpha_reg=0
    &alpha_val=0x0

    &alpha_u_reg=0
    &alpha_u_val=0x0

    &m_reg=0
    &m_val=0x0

    &n_reg=0
    &n_val=0x0

    &is_votable=0x1
    &pll_type="sr2_pll"

  &m_reg=&HWIO_GCC_GPLL5_M_VAL_ADDR
    &m_val=0x00000000
  &n_reg=&HWIO_GCC_GPLL5_N_VAL_ADDR
    &n_val=0x00000001
    gosub Generic_PLL_Configure &mode_reg &user_reg &prediv &postdiv &l_reg &l_val &alpha_reg &alpha_val &alpha_u_reg &alpha_u_val &m_reg &m_val &n_reg &n_val &is_votable &pll_type &cfgctl_reg

 ; Enabling the early output for BIMC PLLs
  &user_val=data.long(&access_mode:&user_reg)
  &user_val=&user_val|0x8
  data.set &access_mode:&user_reg %long &user_val

    print "Configured GPLL5 "
    print " "

    return
  )

  if ("&pll_name_choice"=="GPLL6")
  (
    &mode_reg=&HWIO_GCC_GPLL6_MODE_ADDR
    &user_reg=&HWIO_GCC_GPLL6_USER_CTL_ADDR
    &cfgctl_reg=&HWIO_GCC_GPLL6_CONFIG_CTL_ADDR

    &l_reg=&HWIO_GCC_GPLL6_L_VAL_ADDR
    &l_val=0x0038

    &prediv=0x0001
    &postdiv=0x0001

    &alpha_reg=0
    &alpha_val=0x0

    &alpha_u_reg=0
    &alpha_u_val=0x0

    &m_reg=0
    &m_val=0x0

    &n_reg=0
    &n_val=0x0

    &is_votable=0x1
    &pll_type="sr_pll"

  &m_reg=&HWIO_GCC_GPLL6_M_VAL_ADDR
    &m_val=0x00000001
  &n_reg=&HWIO_GCC_GPLL6_N_VAL_ADDR
    &n_val=0x00000004
    gosub Generic_PLL_Configure &mode_reg &user_reg &prediv &postdiv &l_reg &l_val &alpha_reg &alpha_val &alpha_u_reg &alpha_u_val &m_reg &m_val &n_reg &n_val &is_votable &pll_type &cfgctl_reg

 ; Enabling the aux output for GPLL6 used by qdss-traceclk-in-clk
  &user_val=data.long(&access_mode:&user_reg)
  &user_val=&user_val|0x2
  data.set &access_mode:&user_reg %long &user_val
    print "Configured GPLL6 "
    print " "

    return
  )

  if ("&pll_name_choice"=="BIMC_PLL")
  (
    &mode_reg=&HWIO_GCC_BIMC_PLL_MODE_ADDR
    &user_reg=&HWIO_GCC_BIMC_PLL_USER_CTL_ADDR
    &cfgctl_reg=&HWIO_GCC_BIMC_PLL_CONFIG_CTL_ADDR

    &l_reg=&HWIO_GCC_BIMC_PLL_L_VAL_ADDR
    &l_val=0x0016

    &prediv=0x0001
    &postdiv=0x0001

    &alpha_reg=0
    &alpha_val=0x0

    &alpha_u_reg=0
    &alpha_u_val=0x0

    &m_reg=0
    &m_val=0x0

    &n_reg=0
    &n_val=0x0

    &is_votable=0x1
    &pll_type="sr2_pll"

  &m_reg=&HWIO_GCC_BIMC_PLL_M_VAL_ADDR
    &m_val=0x00000000
  &n_reg=&HWIO_GCC_BIMC_PLL_N_VAL_ADDR
    &n_val=0x00000001
    gosub Generic_PLL_Configure &mode_reg &user_reg &prediv &postdiv &l_reg &l_val &alpha_reg &alpha_val &alpha_u_reg &alpha_u_val &m_reg &m_val &n_reg &n_val &is_votable &pll_type &cfgctl_reg
  
  ; Enabling the early output for BIMC PLLs
  &user_val=data.long(&access_mode:&user_reg)
  &user_val=&user_val|0x8
  data.set &access_mode:&user_reg %long &user_val
    print "Configured BIMC_PLL "
    print " "

    return
  )

  ; PLL name did not match
  return


;-----------------------------------------------------------------------
; Enable or Disable a PLL - Wrapper
;-----------------------------------------------------------------------

Enable_Disable_PLL_Enter:

  &pll_name_choice=""
  gosub Enable_Disable_PLL

  return


;-----------------------------------------------------------------------
; Enable SR / SR2 / HF / Prius / Tesla PLLs.
; Note: This function turns on the PLLs from OFF state. It does not
; support the 'saved state' feature found on Prius PLLs.
;-----------------------------------------------------------------------
          
Generic_PLL_Enable:

  ENTRY &mode_reg &status_reg &pll_type

  ; Return if PLL is already locked
  if (data.long(&access_mode:&status_reg)&0x10000)==0x10000
  (
    return
  )

  ; Put the PLL in reset
  &mode_val=data.long(&access_mode:&mode_reg)
  &mode_val=&mode_val&~(0x00000001|0x00000002|0x00000004)
  data.set &access_mode:&mode_reg %long &mode_val

  if ("&pll_type"=="sr_pll")
  (
    ; Deassert reset and bypass
    &mode_val=&mode_val|0x00000004|0x00000002
    data.set &access_mode:&mode_reg %long &mode_val
  )
  else if ("&pll_type"=="sr2_pll")||("&pll_type"=="hf_pll")||("&pll_type"=="prius_pll")||("&pll_type"=="tesla_pll")
  (
    ; Deassert bypass
    &mode_val=&mode_val|0x00000002
    data.set &access_mode:&mode_reg %long &mode_val

    ; Wait for PLL to initialize
    ; The actual PLL Init time is 5us, but T32 does not seem to allow this small value
    wait 1.ms
    
    ; Deassert reset
    &mode_val=&mode_val|0x00000004
    data.set &access_mode:&mode_reg %long &mode_val
  )
  
  ; Wait for PLL to warm up
  ; The actual PLL warm-up time is 50us, but T32 does not seem to allow this small value
  wait 1.ms
  
  ; Wait for PLL to lock
  while (data.long(&access_mode:&status_reg)&0x10000)==0x0
  (
    wait 1.ms
  )
  
  ; Assert outctrl
  &mode_val=&mode_val|0x00000001
  data.set &access_mode:&mode_reg %long &mode_val

  return


;-----------------------------------------------------------------------
; Disable PLL
;-----------------------------------------------------------------------
                
Generic_PLL_Disable:

  ENTRY &mode_reg

  ; Put the PLL in reset
  &mode_val=data.long(&access_mode:&mode_reg)
  &mode_val=&mode_val&~(0x00000001|0x00000002|0x00000004)
  data.set &access_mode:&mode_reg %LONG &mode_val
  
  return


;-----------------------------------------------------------------------
; Enable or Disable a PLL
;-----------------------------------------------------------------------

Enable_Disable_PLL:

  local &pll_name_choice
  local &pll_on_off_choice

  print "Warning: PLL must already be configured, or the script will hang while waiting for the PLL to lock."
  print " "

  ; Prompt user to choose PLL if choice not passed in via commandline
  if ("&pll_name_choice"=="")
  (
    print "Available PLLs are: "

  print "  GPLL0                       GPLL1                       GPLL3                       GPLL4                       "

  print "  GPLL5                       GPLL6                       BIMC_PLL                    "

    print " "
    print "Enter PLL: "
    enter &pll_name_choice
    
    print "Enter on/off: "
    enter &pll_on_off_choice
  )

  print "PLL: " "&pll_name_choice" "."

  
  ; Votable PLLs

  if ("&pll_name_choice"=="GPLL0")
  (
    &vote_reg=0
    &mode_reg=&HWIO_GCC_GPLL0_MODE_ADDR
    &mode_val=data.long(&access_mode:&mode_reg)
    &status_reg=&HWIO_GCC_GPLL0_STATUS_ADDR
    &pll_sel=0x1
	&pll_type="stromer_pll"

    ; this votable PLL is in FSM mode
    if (&mode_val&0x100000)==0x100000
    (
      print "This source is votable. Which processor do you want to vote from? Choices are: "
      print "[  APCS  APCS_HYP  APCS_TZ  CDSP  LPASS_DSP  RPM  SPARE  WDSP  ]"

      print " "
      print "Enter your choice: "
      enter &subsystem

      if ("&subsystem"=="APCS")
      (
        &vote_reg=&HWIO_GCC_APCS_GPLL_ENA_VOTE_ADDR
      )
      else if ("&subsystem"=="APCS_HYP")
      (
        &vote_reg=&HWIO_GCC_APCS_HYP_GPLL_ENA_VOTE_ADDR
      )
      else if ("&subsystem"=="APCS_TZ")
      (
        &vote_reg=&HWIO_GCC_APCS_TZ_GPLL_ENA_VOTE_ADDR
      )
      else if ("&subsystem"=="CDSP")
      (
        &vote_reg=&HWIO_GCC_CDSP_GPLL_ENA_VOTE_ADDR
      )
      else if ("&subsystem"=="LPASS_DSP")
      (
        &vote_reg=&HWIO_GCC_LPASS_DSP_GPLL_ENA_VOTE_ADDR
      )
      else if ("&subsystem"=="RPM")
      (
        &vote_reg=&HWIO_GCC_RPM_GPLL_ENA_VOTE_ADDR
      )
      else if ("&subsystem"=="SPARE")
      (
        &vote_reg=&HWIO_GCC_SPARE_GPLL_ENA_VOTE_ADDR
      )
      else if ("&subsystem"=="WDSP")
      (
        &vote_reg=&HWIO_GCC_WDSP_GPLL_ENA_VOTE_ADDR
      )
      else
      (
        print "Invalid selection."
        print " "
        goto Enable_Disable_PLL
      )

      if ("&pll_on_off_choice"=="on")
      (
        data.set &access_mode:&vote_reg %long (data.long(&access_mode:&vote_reg)|(&pll_sel))
      )
      else
      (
        data.set &access_mode:&vote_reg %long (data.long(&access_mode:&vote_reg)&~(&pll_sel))
      )

    )
    ; this PLL supports HW voting, but is currently in legacy mode
    else
    (
      if ("&pll_on_off_choice"=="on")
      (
        gosub Generic_PLL_Enable &mode_reg &status_reg &pll_type
      )
      else
      (
        gosub Generic_PLL_Disable &mode_reg
      )
    )

    print "Turned GPLL0 " "&pll_on_off_choice" "."
    print " "

    return
  )


  if ("&pll_name_choice"=="GPLL1")
  (
    &vote_reg=0
    &mode_reg=&HWIO_GCC_GPLL1_MODE_ADDR
    &mode_val=data.long(&access_mode:&mode_reg)
    &status_reg=&HWIO_GCC_GPLL1_STATUS_ADDR
    &pll_sel=0x2
    &pll_type="stromer_pll"
	
    ; this votable PLL is in FSM mode
    if (&mode_val&0x100000)==0x100000
    (
      print "This source is votable. Which processor do you want to vote from? Choices are: "
      print "[  APCS  APCS_HYP  APCS_TZ  CDSP  LPASS_DSP  RPM  SPARE  WDSP  ]"

      print " "
      print "Enter your choice: "
      enter &subsystem

      if ("&subsystem"=="APCS")
      (
        &vote_reg=&HWIO_GCC_APCS_GPLL_ENA_VOTE_ADDR
      )
      else if ("&subsystem"=="APCS_HYP")
      (
        &vote_reg=&HWIO_GCC_APCS_HYP_GPLL_ENA_VOTE_ADDR
      )
      else if ("&subsystem"=="APCS_TZ")
      (
        &vote_reg=&HWIO_GCC_APCS_TZ_GPLL_ENA_VOTE_ADDR
      )
      else if ("&subsystem"=="CDSP")
      (
        &vote_reg=&HWIO_GCC_CDSP_GPLL_ENA_VOTE_ADDR
      )
      else if ("&subsystem"=="LPASS_DSP")
      (
        &vote_reg=&HWIO_GCC_LPASS_DSP_GPLL_ENA_VOTE_ADDR
      )
      else if ("&subsystem"=="RPM")
      (
        &vote_reg=&HWIO_GCC_RPM_GPLL_ENA_VOTE_ADDR
      )
      else if ("&subsystem"=="SPARE")
      (
        &vote_reg=&HWIO_GCC_SPARE_GPLL_ENA_VOTE_ADDR
      )
      else if ("&subsystem"=="WDSP")
      (
        &vote_reg=&HWIO_GCC_WDSP_GPLL_ENA_VOTE_ADDR
      )
      else
      (
        print "Invalid selection."
        print " "
        goto Enable_Disable_PLL
      )

      if ("&pll_on_off_choice"=="on")
      (
        data.set &access_mode:&vote_reg %long (data.long(&access_mode:&vote_reg)|(&pll_sel))
      )
      else
      (
        data.set &access_mode:&vote_reg %long (data.long(&access_mode:&vote_reg)&~(&pll_sel))
      )

    )
    ; this PLL supports HW voting, but is currently in legacy mode
    else
    (
      if ("&pll_on_off_choice"=="on")
      (
        gosub Generic_PLL_Enable &mode_reg &status_reg &pll_type
      )
      else
      (
        gosub Generic_PLL_Disable &mode_reg
      )
    )

    print "Turned GPLL1 " "&pll_on_off_choice" "."
    print " "

    return
  )


  if ("&pll_name_choice"=="GPLL3")
  (
    &vote_reg=0
    &mode_reg=&HWIO_GCC_GPLL3_MODE_ADDR
    &mode_val=data.long(&access_mode:&mode_reg)
    &status_reg=&HWIO_GCC_GPLL3_STATUS_ADDR
    &pll_sel=0x10
    &pll_type="stromer_pll"
	
    ; this votable PLL is in FSM mode
    if (&mode_val&0x100000)==0x100000
    (
      print "This source is votable. Which processor do you want to vote from? Choices are: "
      print "[  APCS  APCS_HYP  APCS_TZ  CDSP  LPASS_DSP  RPM  SPARE  WDSP  ]"

      print " "
      print "Enter your choice: "
      enter &subsystem

      if ("&subsystem"=="APCS")
      (
        &vote_reg=&HWIO_GCC_APCS_GPLL_ENA_VOTE_ADDR
      )
      else if ("&subsystem"=="APCS_HYP")
      (
        &vote_reg=&HWIO_GCC_APCS_HYP_GPLL_ENA_VOTE_ADDR
      )
      else if ("&subsystem"=="APCS_TZ")
      (
        &vote_reg=&HWIO_GCC_APCS_TZ_GPLL_ENA_VOTE_ADDR
      )
      else if ("&subsystem"=="CDSP")
      (
        &vote_reg=&HWIO_GCC_CDSP_GPLL_ENA_VOTE_ADDR
      )
      else if ("&subsystem"=="LPASS_DSP")
      (
        &vote_reg=&HWIO_GCC_LPASS_DSP_GPLL_ENA_VOTE_ADDR
      )
      else if ("&subsystem"=="RPM")
      (
        &vote_reg=&HWIO_GCC_RPM_GPLL_ENA_VOTE_ADDR
      )
      else if ("&subsystem"=="SPARE")
      (
        &vote_reg=&HWIO_GCC_SPARE_GPLL_ENA_VOTE_ADDR
      )
      else if ("&subsystem"=="WDSP")
      (
        &vote_reg=&HWIO_GCC_WDSP_GPLL_ENA_VOTE_ADDR
      )
      else
      (
        print "Invalid selection."
        print " "
        goto Enable_Disable_PLL
      )

      if ("&pll_on_off_choice"=="on")
      (
        data.set &access_mode:&vote_reg %long (data.long(&access_mode:&vote_reg)|(&pll_sel))
      )
      else
      (
        data.set &access_mode:&vote_reg %long (data.long(&access_mode:&vote_reg)&~(&pll_sel))
      )

    )
    ; this PLL supports HW voting, but is currently in legacy mode
    else
    (
      if ("&pll_on_off_choice"=="on")
      (
        gosub Generic_PLL_Enable &mode_reg &status_reg &pll_type
      )
      else
      (
        gosub Generic_PLL_Disable &mode_reg
      )
    )

    print "Turned GPLL3 " "&pll_on_off_choice" "."
    print " "

    return
  )


  if ("&pll_name_choice"=="GPLL4")
  (
    &vote_reg=0
    &mode_reg=&HWIO_GCC_GPLL4_MODE_ADDR
    &mode_val=data.long(&access_mode:&mode_reg)
    &status_reg=&HWIO_GCC_GPLL4_STATUS_ADDR
    &pll_sel=0x20
    &pll_type="stromer_pll"
	
    ; this votable PLL is in FSM mode
    if (&mode_val&0x100000)==0x100000
    (
      print "This source is votable. Which processor do you want to vote from? Choices are: "
      print "[  APCS  APCS_HYP  APCS_TZ  CDSP  LPASS_DSP  RPM  SPARE  WDSP  ]"

      print " "
      print "Enter your choice: "
      enter &subsystem

      if ("&subsystem"=="APCS")
      (
        &vote_reg=&HWIO_GCC_APCS_GPLL_ENA_VOTE_ADDR
      )
      else if ("&subsystem"=="APCS_HYP")
      (
        &vote_reg=&HWIO_GCC_APCS_HYP_GPLL_ENA_VOTE_ADDR
      )
      else if ("&subsystem"=="APCS_TZ")
      (
        &vote_reg=&HWIO_GCC_APCS_TZ_GPLL_ENA_VOTE_ADDR
      )
      else if ("&subsystem"=="CDSP")
      (
        &vote_reg=&HWIO_GCC_CDSP_GPLL_ENA_VOTE_ADDR
      )
      else if ("&subsystem"=="LPASS_DSP")
      (
        &vote_reg=&HWIO_GCC_LPASS_DSP_GPLL_ENA_VOTE_ADDR
      )
      else if ("&subsystem"=="RPM")
      (
        &vote_reg=&HWIO_GCC_RPM_GPLL_ENA_VOTE_ADDR
      )
      else if ("&subsystem"=="SPARE")
      (
        &vote_reg=&HWIO_GCC_SPARE_GPLL_ENA_VOTE_ADDR
      )
      else if ("&subsystem"=="WDSP")
      (
        &vote_reg=&HWIO_GCC_WDSP_GPLL_ENA_VOTE_ADDR
      )
      else
      (
        print "Invalid selection."
        print " "
        goto Enable_Disable_PLL
      )

      if ("&pll_on_off_choice"=="on")
      (
        data.set &access_mode:&vote_reg %long (data.long(&access_mode:&vote_reg)|(&pll_sel))
      )
      else
      (
        data.set &access_mode:&vote_reg %long (data.long(&access_mode:&vote_reg)&~(&pll_sel))
      )

    )
    ; this PLL supports HW voting, but is currently in legacy mode
    else
    (
      if ("&pll_on_off_choice"=="on")
      (
        gosub Generic_PLL_Enable &mode_reg &status_reg &pll_type
      )
      else
      (
        gosub Generic_PLL_Disable &mode_reg
      )
    )

    print "Turned GPLL4 " "&pll_on_off_choice" "."
    print " "

    return
  )


  if ("&pll_name_choice"=="GPLL5")
  (
    &vote_reg=0
    &mode_reg=&HWIO_GCC_GPLL5_MODE_ADDR
    &mode_val=data.long(&access_mode:&mode_reg)
    &status_reg=&HWIO_GCC_GPLL5_STATUS_ADDR
    &pll_sel=0x40
	&pll_type="sr2_pll"

    ; this votable PLL is in FSM mode
    if (&mode_val&0x100000)==0x100000
    (
      print "This source is votable. Which processor do you want to vote from? Choices are: "
      print "[  APCS  APCS_HYP  APCS_TZ  CDSP  LPASS_DSP  RPM  SPARE  WDSP  ]"

      print " "
      print "Enter your choice: "
      enter &subsystem

      if ("&subsystem"=="APCS")
      (
        &vote_reg=&HWIO_GCC_APCS_GPLL_ENA_VOTE_ADDR
      )
      else if ("&subsystem"=="APCS_HYP")
      (
        &vote_reg=&HWIO_GCC_APCS_HYP_GPLL_ENA_VOTE_ADDR
      )
      else if ("&subsystem"=="APCS_TZ")
      (
        &vote_reg=&HWIO_GCC_APCS_TZ_GPLL_ENA_VOTE_ADDR
      )
      else if ("&subsystem"=="CDSP")
      (
        &vote_reg=&HWIO_GCC_CDSP_GPLL_ENA_VOTE_ADDR
      )
      else if ("&subsystem"=="LPASS_DSP")
      (
        &vote_reg=&HWIO_GCC_LPASS_DSP_GPLL_ENA_VOTE_ADDR
      )
      else if ("&subsystem"=="RPM")
      (
        &vote_reg=&HWIO_GCC_RPM_GPLL_ENA_VOTE_ADDR
      )
      else if ("&subsystem"=="SPARE")
      (
        &vote_reg=&HWIO_GCC_SPARE_GPLL_ENA_VOTE_ADDR
      )
      else if ("&subsystem"=="WDSP")
      (
        &vote_reg=&HWIO_GCC_WDSP_GPLL_ENA_VOTE_ADDR
      )
      else
      (
        print "Invalid selection."
        print " "
        goto Enable_Disable_PLL
      )

      if ("&pll_on_off_choice"=="on")
      (
        data.set &access_mode:&vote_reg %long (data.long(&access_mode:&vote_reg)|(&pll_sel))
      )
      else
      (
        data.set &access_mode:&vote_reg %long (data.long(&access_mode:&vote_reg)&~(&pll_sel))
      )

    )
    ; this PLL supports HW voting, but is currently in legacy mode
    else
    (
      if ("&pll_on_off_choice"=="on")
      (
        gosub Generic_PLL_Enable &mode_reg &status_reg &pll_type
      )
      else
      (
        gosub Generic_PLL_Disable &mode_reg
      )
    )

    print "Turned GPLL5 " "&pll_on_off_choice" "."
    print " "

    return
  )


  if ("&pll_name_choice"=="GPLL6")
  (
    &vote_reg=0
    &mode_reg=&HWIO_GCC_GPLL6_MODE_ADDR
    &mode_val=data.long(&access_mode:&mode_reg)
    &status_reg=&HWIO_GCC_GPLL6_STATUS_ADDR
    &pll_sel=0x80
    &pll_type="sr_pll"

    ; this votable PLL is in FSM mode
    if (&mode_val&0x100000)==0x100000
    (
      print "This source is votable. Which processor do you want to vote from? Choices are: "
      print "[  APCS  APCS_HYP  APCS_TZ  CDSP  LPASS_DSP  RPM  SPARE  WDSP  ]"

      print " "
      print "Enter your choice: "
      enter &subsystem

      if ("&subsystem"=="APCS")
      (
        &vote_reg=&HWIO_GCC_APCS_GPLL_ENA_VOTE_ADDR
      )
      else if ("&subsystem"=="APCS_HYP")
      (
        &vote_reg=&HWIO_GCC_APCS_HYP_GPLL_ENA_VOTE_ADDR
      )
      else if ("&subsystem"=="APCS_TZ")
      (
        &vote_reg=&HWIO_GCC_APCS_TZ_GPLL_ENA_VOTE_ADDR
      )
      else if ("&subsystem"=="CDSP")
      (
        &vote_reg=&HWIO_GCC_CDSP_GPLL_ENA_VOTE_ADDR
      )
      else if ("&subsystem"=="LPASS_DSP")
      (
        &vote_reg=&HWIO_GCC_LPASS_DSP_GPLL_ENA_VOTE_ADDR
      )
      else if ("&subsystem"=="RPM")
      (
        &vote_reg=&HWIO_GCC_RPM_GPLL_ENA_VOTE_ADDR
      )
      else if ("&subsystem"=="SPARE")
      (
        &vote_reg=&HWIO_GCC_SPARE_GPLL_ENA_VOTE_ADDR
      )
      else if ("&subsystem"=="WDSP")
      (
        &vote_reg=&HWIO_GCC_WDSP_GPLL_ENA_VOTE_ADDR
      )
      else
      (
        print "Invalid selection."
        print " "
        goto Enable_Disable_PLL
      )

      if ("&pll_on_off_choice"=="on")
      (
        data.set &access_mode:&vote_reg %long (data.long(&access_mode:&vote_reg)|(&pll_sel))
      )
      else
      (
        data.set &access_mode:&vote_reg %long (data.long(&access_mode:&vote_reg)&~(&pll_sel))
      )

    )
    ; this PLL supports HW voting, but is currently in legacy mode
    else
    (
      if ("&pll_on_off_choice"=="on")
      (
        gosub Generic_PLL_Enable &mode_reg &status_reg &pll_type
      )
      else
      (
        gosub Generic_PLL_Disable &mode_reg
      )
    )

    print "Turned GPLL6 " "&pll_on_off_choice" "."
    print " "

    return
  )


  if ("&pll_name_choice"=="BIMC_PLL")
  (
    &vote_reg=0
    &mode_reg=&HWIO_GCC_BIMC_PLL_MODE_ADDR
    &mode_val=data.long(&access_mode:&mode_reg)
    &status_reg=&HWIO_GCC_BIMC_PLL_STATUS_ADDR
    &pll_sel=0x8
    &pll_type="sr2_pll"
   
    ; this votable PLL is in FSM mode
    if (&mode_val&0x100000)==0x100000
    (
      print "This source is votable. Which processor do you want to vote from? Choices are: "
      print "[  APCS  APCS_HYP  APCS_TZ  CDSP  LPASS_DSP  RPM  SPARE  WDSP  ]"

      print " "
      print "Enter your choice: "
      enter &subsystem

      if ("&subsystem"=="APCS")
      (
        &vote_reg=&HWIO_GCC_APCS_GPLL_ENA_VOTE_ADDR
      )
      else if ("&subsystem"=="APCS_HYP")
      (
        &vote_reg=&HWIO_GCC_APCS_HYP_GPLL_ENA_VOTE_ADDR
      )
      else if ("&subsystem"=="APCS_TZ")
      (
        &vote_reg=&HWIO_GCC_APCS_TZ_GPLL_ENA_VOTE_ADDR
      )
      else if ("&subsystem"=="CDSP")
      (
        &vote_reg=&HWIO_GCC_CDSP_GPLL_ENA_VOTE_ADDR
      )
      else if ("&subsystem"=="LPASS_DSP")
      (
        &vote_reg=&HWIO_GCC_LPASS_DSP_GPLL_ENA_VOTE_ADDR
      )
      else if ("&subsystem"=="RPM")
      (
        &vote_reg=&HWIO_GCC_RPM_GPLL_ENA_VOTE_ADDR
      )
      else if ("&subsystem"=="SPARE")
      (
        &vote_reg=&HWIO_GCC_SPARE_GPLL_ENA_VOTE_ADDR
      )
      else if ("&subsystem"=="WDSP")
      (
        &vote_reg=&HWIO_GCC_WDSP_GPLL_ENA_VOTE_ADDR
      )
      else
      (
        print "Invalid selection."
        print " "
        goto Enable_Disable_PLL
      )

      if ("&pll_on_off_choice"=="on")
      (
        data.set &access_mode:&vote_reg %long (data.long(&access_mode:&vote_reg)|(&pll_sel))
      )
      else
      (
        data.set &access_mode:&vote_reg %long (data.long(&access_mode:&vote_reg)&~(&pll_sel))
      )

    )
    ; this PLL supports HW voting, but is currently in legacy mode
    else
    (
      if ("&pll_on_off_choice"=="on")
      (
        gosub Generic_PLL_Enable &mode_reg &status_reg &pll_type
      )
      else
      (
        gosub Generic_PLL_Disable &mode_reg
      )
    )

    print "Turned BIMC_PLL " "&pll_on_off_choice" "."
    print " "

    return
  )


  ; Non Votable PLLs

  ; PLL name did not match
  return


;-----------------------------------------------------------------------
; Route PLL to PLLTEST_PAD 
;-----------------------------------------------------------------------

Route_PLL_To_Pad:

  local &pll_name_choice
  local &plltest_pad_field_val
  local &user_ctl_reg
  local &test_ctl_u_reg
  local &user_ctl_val
  local &test_ctl_u_val

  ; Prompt user to choose PLL if choice not passed in via commandline
  if ("&pll_name_choice"=="")
  (
    print "Available PLLs are: "

  print "  GPLL0                       GPLL1                       GPLL3                       GPLL4                       "

  print "  GPLL5                       GPLL6                       BIMC_PLL                    "

    print " "
    print "Enter PLL: "
    enter &pll_name_choice
  )

  &plltest_pad_field_val=0x0
  &user_ctl_reg=0x0
  &test_ctl_u_reg=0x0

  if ("&pll_name_choice"=="GPLL0")
  (
    &plltest_pad_field_val=0x1
    &user_ctl_reg=&HWIO_GCC_GPLL0_USER_CTL_ADDR

  &test_ctl_u_reg=&HWIO_GCC_GPLL0_TEST_CTL_U_ADDR
    ; Enable test output in the PLL's user control register
    &user_ctl_val=data.long(&access_mode:&user_ctl_reg)
    &user_ctl_val=&user_ctl_val|0x10
    data.set &access_mode:&user_ctl_reg %long &user_ctl_val

    ; Enable test output in the PLL's test control upper register if available
    if (&test_ctl_u_reg!=0x0)
    (
      &test_ctl_u_val=data.long(&access_mode:&test_ctl_u_reg)
      &test_ctl_u_val=&test_ctl_u_val|0x6
      data.set &access_mode:&test_ctl_u_reg %long &test_ctl_u_val
    )

  )

  if ("&pll_name_choice"=="GPLL1")
  (
    &plltest_pad_field_val=0x3
    &user_ctl_reg=&HWIO_GCC_GPLL1_USER_CTL_ADDR

  &test_ctl_u_reg=&HWIO_GCC_GPLL1_TEST_CTL_U_ADDR
    ; Enable test output in the PLL's user control register
    &user_ctl_val=data.long(&access_mode:&user_ctl_reg)
    &user_ctl_val=&user_ctl_val|0x10
    data.set &access_mode:&user_ctl_reg %long &user_ctl_val

    ; Enable test output in the PLL's test control upper register if available
    if (&test_ctl_u_reg!=0x0)
    (
      &test_ctl_u_val=data.long(&access_mode:&test_ctl_u_reg)
      &test_ctl_u_val=&test_ctl_u_val|0x6
      data.set &access_mode:&test_ctl_u_reg %long &test_ctl_u_val
    )

  )

  if ("&pll_name_choice"=="GPLL3")
  (
    &plltest_pad_field_val=0x5
    &user_ctl_reg=&HWIO_GCC_GPLL3_USER_CTL_ADDR

  &test_ctl_u_reg=&HWIO_GCC_GPLL3_TEST_CTL_U_ADDR
    ; Enable test output in the PLL's user control register
    &user_ctl_val=data.long(&access_mode:&user_ctl_reg)
    &user_ctl_val=&user_ctl_val|0x10
    data.set &access_mode:&user_ctl_reg %long &user_ctl_val

    ; Enable test output in the PLL's test control upper register if available
    if (&test_ctl_u_reg!=0x0)
    (
      &test_ctl_u_val=data.long(&access_mode:&test_ctl_u_reg)
      &test_ctl_u_val=&test_ctl_u_val|0x6
      data.set &access_mode:&test_ctl_u_reg %long &test_ctl_u_val
    )

  )

  if ("&pll_name_choice"=="GPLL4")
  (
    &plltest_pad_field_val=0x6
    &user_ctl_reg=&HWIO_GCC_GPLL4_USER_CTL_ADDR

  &test_ctl_u_reg=&HWIO_GCC_GPLL4_TEST_CTL_U_ADDR
    ; Enable test output in the PLL's user control register
    &user_ctl_val=data.long(&access_mode:&user_ctl_reg)
    &user_ctl_val=&user_ctl_val|0x10
    data.set &access_mode:&user_ctl_reg %long &user_ctl_val

    ; Enable test output in the PLL's test control upper register if available
    if (&test_ctl_u_reg!=0x0)
    (
      &test_ctl_u_val=data.long(&access_mode:&test_ctl_u_reg)
      &test_ctl_u_val=&test_ctl_u_val|0x6
      data.set &access_mode:&test_ctl_u_reg %long &test_ctl_u_val
    )

  )

  if ("&pll_name_choice"=="GPLL5")
  (
    &plltest_pad_field_val=0x7
    &user_ctl_reg=&HWIO_GCC_GPLL5_USER_CTL_ADDR

    ; Enable test output in the PLL's user control register
    &user_ctl_val=data.long(&access_mode:&user_ctl_reg)
    &user_ctl_val=&user_ctl_val|0x10
    data.set &access_mode:&user_ctl_reg %long &user_ctl_val

    ; Enable test output in the PLL's test control upper register if available
    if (&test_ctl_u_reg!=0x0)
    (
      &test_ctl_u_val=data.long(&access_mode:&test_ctl_u_reg)
      &test_ctl_u_val=&test_ctl_u_val|0x6
      data.set &access_mode:&test_ctl_u_reg %long &test_ctl_u_val
    )

  )

  if ("&pll_name_choice"=="GPLL6")
  (
    &plltest_pad_field_val=0x8
    &user_ctl_reg=&HWIO_GCC_GPLL6_USER_CTL_ADDR

    ; Enable test output in the PLL's user control register
    &user_ctl_val=data.long(&access_mode:&user_ctl_reg)
    &user_ctl_val=&user_ctl_val|0x10
    data.set &access_mode:&user_ctl_reg %long &user_ctl_val

    ; Enable test output in the PLL's test control upper register if available
    if (&test_ctl_u_reg!=0x0)
    (
      &test_ctl_u_val=data.long(&access_mode:&test_ctl_u_reg)
      &test_ctl_u_val=&test_ctl_u_val|0x6
      data.set &access_mode:&test_ctl_u_reg %long &test_ctl_u_val
    )

  )

  if ("&pll_name_choice"=="BIMC_PLL")
  (
    &plltest_pad_field_val=0x4
    &user_ctl_reg=&HWIO_GCC_BIMC_PLL_USER_CTL_ADDR

    ; Enable test output in the PLL's user control register
    &user_ctl_val=data.long(&access_mode:&user_ctl_reg)
    &user_ctl_val=&user_ctl_val|0x10
    data.set &access_mode:&user_ctl_reg %long &user_ctl_val

    ; Enable test output in the PLL's test control upper register if available
    if (&test_ctl_u_reg!=0x0)
    (
      &test_ctl_u_val=data.long(&access_mode:&test_ctl_u_reg)
      &test_ctl_u_val=&test_ctl_u_val|0x6
      data.set &access_mode:&test_ctl_u_reg %long &test_ctl_u_val
    )

  )

  if (&user_ctl_reg!=0x0)&&(&plltest_pad_field_val!=0x0)
  (
    ; Get the PLLTEST_PAD register
    &plltest_pad_reg=0x187400c
    &plltest_pad_val=data.long(&access_mode:&plltest_pad_reg)

    ; Clear the source selection field
    &plltest_pad_val=&plltest_pad_val&~(0x3F<<0x0)

    ; Set CORE_OE
    &plltest_pad_val=&plltest_pad_val|0x1000

    ; Write to the testpad's source selection field
    &plltest_pad_val=&plltest_pad_val|((&plltest_pad_field_val&0x3F)<<0x0)
    data.set &access_mode:&plltest_pad_reg %long &plltest_pad_val
  )
  else
  (
    print "Invalid source."
  )

  return

