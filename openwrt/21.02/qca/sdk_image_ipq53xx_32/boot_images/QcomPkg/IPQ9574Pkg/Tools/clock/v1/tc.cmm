;=============================================================================
;
; tc.cmm 
;
; Script to execute a single testclock.cmm sequence (and leave its window
; displayed).
;
; Intended to serve as an alternative to using the interactice testclock.cmm
; directly. This method allows users to avoid PRACTICE script interference and
; to leverage the T32 main command line history utility.
;
; ============================================================================
;
; Copyright (c) 2015, 2021 Qualcomm Technologies Incorporated.  All Rights Reserved.  
; QUALCOMM Proprietary and Confidential. 
;
; ============================================================================
; $Header: //components/rel/boot.xf/0.3.1.1/QcomPkg/IPQ9574Pkg/Tools/clock/v1/tc.cmm#1 $
; $DateTime: 2022/02/24 22:30:26 $
; $Author: pwbldsvc $
; ============================================================================

local &tc_ret
local &script_dir
local &launch_line

entry %LINE &launch_line

; Get the absolute path to this script's directory.
&script_dir=OS.PPD()

; Run a single testclock sequence and leave its window displayed.
do &script_dir\testclock.cmm __help_same_window__ __tc__ &launch_line x .
entry &tc_ret

enddo &tc_ret
