;
; Copyright (c) 2017, 2019 Qualcomm Technologies, Inc.
; All Rights Reserved.
; Confidential and Proprietary - Qualcomm Technologies, Inc.
;

; select CPU and options
SYStem.Reset
SYStem.CPU HEXAGONV56
SYStem.JTAGCLOCK 1MHz
SYStem.CONFIG SLAVE ON
SYStem.CONFIG MEMORYACCESSPORT 0.
SYStem.CONFIG DEBUGACCESSPORT  1.
SYStem.CONFIG JTAGACCESSPORT 8.
SYStem.CONFIG COREJTAGPORT 0.

SYStem.CONFIG DAPIRPOST 0.
SYStem.CONFIG DAPDRPOST 0.
SYStem.CONFIG DAPIRPOST 11.
SYStem.CONFIG DAPDRPOST 1.

sys.mode attach
