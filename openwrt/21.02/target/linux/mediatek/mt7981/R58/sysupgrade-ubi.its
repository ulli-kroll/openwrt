## openwrt/21.02/target/linux/mediatek/mt7981/R58/sysupgrade-ubi.its
```
/dts-v1/;

/ {
        description = "R58";
        images {
				/* the node name ubi is used for uboot upgrade, do not change the name */
                ubi {
                        description = "kernel-rootfs image";
                        data = /incbin/("./openwrt-mediatek-mt7981-R58-squashfs-factory.bin");
                        type = "firmware";
                        arch = "arm";
                        compression = "none";
                        hash@1 { algo = "crc32"; };
                };

        };
};
```
